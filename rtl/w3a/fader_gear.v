`timescale 1ns/1ps
// fader_gear.v · P3 推子档位状态机（2026-10-03）＋ P3.1 档 0 边沿接管（2026-10-03）
//               ＋ P3.2 边沿检测改用【量化档位】⇒ ±1 LSB 抖动不接管（2026-10-03）
//
// ⭐ 来源：files/20-代码/T3-后续计划-20261003.md §P3 ＋
//          files/00-总览/T3变调与推子功能状态机-设计定稿-20261001.md §四
//
// ⭐ 用户裁定（⛔ 不许改）：
//     · 档 0 = 变调：⭐ 左推子（CH2）只管降、⭐ 右推子（CH3）只管升，⭐ 各占半程
//     · 档 1 = 颤音（现状）：CH2 = 颤音深度、CH3 = 颤音速率
//     · 🔴 档 2/3 = 预留摇把 ⇒ 本版【不可达】
//          ⚠️⚠️ **2026-10-18 已作废**：⭐ 摇把档按用户裁定取消，
//                档 2 改为【音量颤音】且**可达**，档 3 删除 ⇒ ⭐ 见下方 2026-10-18 段 ✅
//     · ⭐ 上电默认档 1 ⇒ 与现状逐位一致 ⇒ 零回归
//
// ── ⭐⭐ 2026-10-18（用户裁定）：⭐ 三档 + 每档锁定 + 双颤音共存 ─────────────
//     📌 规格书：`bringup/40-推子三档与双颤音共存-实施方案-20261018.md` §4
//
//  ⭐ **档位表（新）**
//     档 | CH2（左推子）      | CH3（右推子）      | 状态
//     ---+---------------------+---------------------+------------------
//      0 | 降调（参与差分）    | 升调（参与差分）    | 启用
//      1 | 音高颤音 深度       | 音高颤音 速率       | 启用（上电默认）
//      2 | 音量颤音 深度       | 音量颤音 速率       | 启用（本轮新增）
//     ⚠️ 原"档 2 = 摇把 / 档 3 = 主音量"两行**已作废**：摇把档按用户裁定取消，
//        档 3 不再存在（三档循环 0→1→2→0）。
//
//  ⭐ **三个新语义（⭐ 这是本轮的核心，⛔ 不要按旧注释理解）**
//    ① ⭐ **切档不再清零** —— 旧写法"非档 1 ⇒ 颤音输出 = 0"会让两个颤音**互斥**。
//       2026-11-02: 离档后由锁定位决定保留；未锁定归零，已锁定可共存。
//       📌 实现必须是"组合透传 + 影子寄存器"，⛔ 不能把输出改成寄存器
//          —— 否则档 1 会多 1 拍延迟，破坏原契约（见下方 ④ 的注释）✅
//    ② ⭐ **每档一个锁定位**（`hold_o[2:0]`）：置位 ⇒ 该档参数**冻结**，
//       推子怎么动都不影响它 ⇒ ⭐ 用户可以把推子推回 0 为下一档做准备 ✅
//       📌 用途（用户原话）：*"调完推子后…按下锁定键，然后再置零，切另一个档位"*
//          ⇒ ⭐ 这样切档时**不会把上一个参数拉回推子位置**（避免跳变）✅
//    ③ ⭐ **档 0 的"进档接管"也要受 `hold_o[0]` 管** —— 否则锁了变调再切回来
//       仍会被推子位置覆盖（旧代码 `gear0_enter` 是无条件的）✅
//
//  ⭐ **`hold_o` 复位 = `3'b000`（全解锁）** —— 用户裁定。
//     📌 含义：上电后三档都跟随推子（与旧行为一致）⇒ ⭐ 零回归起点 ✅
//     ⚠️ 若推子停在 0：档 1 的颤音深度 = 0（= 关）、档 0 的差分 = 12（= 不变调）
//        ⇒ ⭐ **上电仍然静默**，不会突然出声 ✅
//
// ── 档位表（定稿 §四 · ⭐ 2026-10-18 已被上面那张表取代，此处仅存档）────────
//     档 | CH2（左推子）        | CH3（右推子）        | 状态
//     ---+-----------------------+-----------------------+----------
//      0 | 降调 0 → −12 半音     | 升调 0 → +12 半音     | 启用
//      1 | 颤音深度（现状）      | 颤音速率（现状）      | 启用（默认）
//      2 | 摇把范围              | 摇把速率              | 🔴 已改为音量颤音
//      3 | 主音量微调            | —                     | 🔴 已删除（三档循环）
//
// ── 档 0 映射（⭐ 定稿 §四"各占半程"）────────────────────────────────────
//     ⭐ 左档位  = floor(ch2_i * 12 / 4095)  ⇒ 半音偏移 = −左档位
//     ⭐ 右档位  = floor(ch3_i * 12 / 4095)  ⇒ 半音偏移 = +右档位
//     ⭐ 总半音  = 右档位 − 左档位（⭐ 构造上恒在 −12..+12）
//     ⭐ 每半音行程 = 满程/12（⚠️ 比"居中为零"的 /24 好一倍）
//
// ── ⭐⭐ P3.1（2026-10-03 用户拍板 A′）：⭐ 档 0 的"何时接管" ─────────────
//     ⚠️ P3 版：⭐ 档 0 **每一拍**都写 `fader_enc` ⇒ ⭐ 串口 `'F'`/`'G'`/`'H'`
//        设的值**只活 1 拍**就被推子值覆盖 ⇒ ⭐ 档 0 下串口**完全无效**。
//     ⭐ A′：⭐ 改成「**推子值变化时才接管**」（⭐ 用 `ch2_q`/`ch3_q` 做边沿检测）——
//         · 串口设值   ⇒ ⭐ **生效并保持** ✅
//         · 用户动推子 ⇒ ⭐ 推子**立刻接管**（⭐ 手动优先）✅
//         · 两者都不动 ⇒ ⭐ 保持上次的值 ✅
//       一句话：⭐ **串口和推子不会同时触发** ⇒ ⭐ 谁最后动谁说了算。
//     ⭐ 两个接管边沿（⭐ 都是**单拍**）：
//        ① `fader_moved` = ⭐ **推子的量化档位动过**（⭐ 见下方 P3.2 ——
//           ⚠️ P3.1 原为 `ch2_i != ch2_q || ch3_i != ch3_q`（原始 12 位），
//           🔴 已被 P3.2 替换掉）
//        ② `gear0_enter` = **刚切进档 0**（⭐ 切档瞬间视为"推子已动"）
//           ⚠️ 没有 ② 的话：⭐ 档 1 → 档 0 后档 0 会沿用**切档前的旧编码**
//              ⇒ ⭐ 与当前推子位置不符（⭐ 直到用户再动一下推子才对上）。
//     ⚠️ `fader_enc_q` 的复位值 = `5'd12` —— ⭐ `ch2_i = ch3_i = 0` 时
//        `fader_enc` 正好 = 12（⭐ 左右档位都 0）⇒ ⭐ 与"推子初值"一致，
//        ⛔ 不误判"动过" ✅
//        ⚠️⚠️ **但请注意：该复位值【结构上不可观测】** —— ⭐ 复位后 `gear_o` 恒为 1
//           （⭐ 档 0 的接管分支当拍根本不成立），⭐ 且**切进档 0 的那一拍**
//           由 `gear0_enter` **无条件兜底**，⭐ 加上 `fader_enc_q` 每拍被
//           **无条件刷新** ⇒ ⭐ **1 拍自愈** ⇒ ⭐ 复位值写错也测不出来。
//           📌 所以 tb 的 ③ 组（⭐ 复位后不误触发）是 ⭐ **冒烟检查**，
//              ⛔ **不是"能红"判据**（⭐ 用户 2026-10-03 已裁定取此解释 ✅）。
//     📌 本改动 ⛔ 不改端口、⛔ 不改 `'F'`/`'G'`/`'H'` 的 clamp 语义、
//        ⛔ 不改档 0 的映射（`gear_step_of` 比较链逐位不动）✅
//
// ── ⭐⭐ P3.2（2026-10-03）：⭐ 边沿检测改用【量化档位】 —— ⭐ 修掉"上板才暴露"的真问题 ──
//     🔴 **P3.1 的病灶**：⭐ `fader_moved` 比较的是**原始 12 位**
//        （`(ch2_i != ch2_q) || (ch3_i != ch3_q)`）。
//        ⚠️ 推子**静止**时 ADC 输出抖 ±1 LSB ⇒ ⭐ 该式**每拍为真**
//        ⇒ ⭐ 档 0 下串口 `'F'`/`'G'`/`'H'` 设的值**仍被推子值覆盖**
//        ⇒ 🔴 **A′ 的目的落空**（⭐ 串口在档 0 又失效了）。
//        📌 **这个风险是真的**：⭐ 本项目 `calib` 目前**旁路**
//           （⭐ `rtl/top.v:1637` 附近：`tare`/`span` 未接 ⇒ 输出 = 输入）
//           ⇒ ⭐ **抖动没有任何滤波**。
//     ⭐ **修法（⭐ 用户已批准的最小修法）**：⭐ 把比较对象从"原始 12 位"
//        换成"**量化后的档位**" —— ⭐ 用**已经算出来的** `fader_enc`
//        （⭐ = `12 + right_step − left_step`，⭐ 即 `gear_step_of()` 输出的组合，
//        ⭐ 0..24 编码）：
//          ⭐ 对 `fader_enc` 加一级寄存（`fader_enc_q`）
//          ⭐ `fader_moved = (fader_enc != fader_enc_q)`
//        ⭐ 效果：⭐ ±1 LSB 抖动只要**没跨过半音档边界** ⇒ `fader_enc` 不变
//           ⇒ ⛔ **不触发接管** ✅（⭐ 相当于**天然的迟滞/死区** ✅）
//           ⭐ 而**跨过半音档边界**（⭐ 用户真的推动了推子）⇒ ⭐ 立刻接管 ✅
//     ⚠️ `fader_enc` 是**组合逻辑**（⭐ 由 `gear_step_of()` 的比较链算出）——
//        ⭐ 它的输入 `ch2_i`/`ch3_i` 是 `right_analog_ctrl` 的**寄存器输出**
//        ⇒ ⭐ 同一拍内**稳定**、⛔ 不会中途跳变 ⇒ ⭐ 寄存一拍再比较是安全的 ✅
//     ⚠️ **已知角落（⭐ 不改，⭐ 只记录）**：⭐ `fader_enc` 对
//        (左档位, 右档位) **不是单射**（⭐ 如 (0,0) 与 (1,1) 都得 12）⇒
//        ⭐ 若**同一拍**两推子各走**恰好抵消**的档数 ⇒ ⛔ 不接管。
//        ⭐ 但此时**变调值本来就没变** ⇒ ⭐ 无功能差异（⭐ 故不改）。
//     📌 本改动 ⛔ 不改 `gear_step_of()` 的阈值、⛔ 不改 clamp、
//        ⛔ 不改端口、⛔ 不改档位表 ✅
//
// ── ⭐ 为什么用【比较链】而不是 `/ 4095` ────────────────────────────────
//     ⚠️ `(ch*12)/4095` 里的 `/` 会被综合成【常量除法器】——
//        本机综合器可能拿一个 16×16 乘法器（= 1 个 MULT27X36/DSP）去实现倒数，
//        而本项目 DSP 只剩 5 个可用（基线 T_MULT27X36 = 5）⇒ ⭐ 不能赌。
//     ⭐ 等价改法：⭐ `floor(12c/4095)` 只有 13 个取值（0..12）⇒
//        直接与 12 个**常量阈值**比较即可，⭐ 结果与公式**逐值相等**（⛔ 不是近似）。
//     ⭐ 阈值 = ceil(4095k/12)（⭐ 下表已逐项核对，见 tb 的全量扫描判据）
//        k : 1    2    3    4     5     6     7     8     9     10    11    12
//        t : 342  683  1024 1365  1707  2048  2389  2730  3072  3413  3754  4095
//
// ── ⭐ 半音值的【编码】与 P2 完全一致 ───────────────────────────────────
//     ⭐ 内部寄存器 `enc_r` = 5 位无符号 `0..24`，⭐ `12` = 不变调 ✅
//        （⭐ 与 calib_cmd 的 'H' 载荷、与 P2 版 top.v 的 `trans_semi_r` 同一口径）
//     ⇒ ⭐ 送出去前减 12 ⇒ signed `[4:0]` 的 `−12..+12`
//     ⭐ 为什么用编码而不是 signed：⭐ clamp 变成**纯无符号比较** ⇒
//        ⛔ 不依赖 `signed` 函数/位宽规则，⭐ 综合器与仿真器都不会有歧义 ✅
`default_nettype none

module fader_gear (
    input  wire              clk,
    input  wire              rst_n,
    // ⭐ 'J'（来自 calib_cmd.gear_next_req_o）：⭐ 单拍脉冲 ⇒ 档 0 ⇄ 档 1
    input  wire              gear_next_i,
    // ⭐ 推子原始值（来自 right_analog_ctrl 的 CH2/CH3 输出）
    input  wire [11:0]       ch2_i,           // 左推子
    input  wire [11:0]       ch3_i,           // 右推子
    // ⭐ 串口命令（来自 calib_cmd）：⭐ 都是单拍脉冲
    input  wire              trans_down_i,    // 'F' ⇒ 降 1 半音
    input  wire              trans_up_i,      // 'G' ⇒ 升 1 半音
    input  wire              trans_abs_i,     // 'H' ⇒ 带帧绝对量（与 val 同拍）
    input  wire [7:0]        trans_abs_val_i, // 'H' 载荷：⭐ 编码 0..24，⭐ 12 = 不调
    // ⭐⭐ 2026-10-18 新增：⭐ 屏点选"直接跳档"（⭐ 单周期脉冲，优先级高于 `gear_next_i`）
    //    📌 屏上点某个效果器 ⇒ 推子直接跳到那一档（⛔ 不用连按 'J' 循环过去）✅
    input  wire              gear_sel0_i,     // 跳档 0（变调）
    input  wire              gear_sel1_i,     // 跳档 1（音高颤音）
    input  wire              gear_sel2_i,     // 跳档 2（音量颤音）
    // ⭐⭐ 2026-10-18 新增：⭐ 锁定键（⭐ 单周期脉冲）⇒ ⭐ 翻转【当前档】的锁定位
    input  wire              lock_toggle_i,
    // ⭐ 输出
    output reg  [1:0]        gear_o,          // ⭐ 当前档位（复位 = 1）
    output wire signed [4:0] transpose_semi_o,// ⭐ 半音偏移 −12..+12
    // ⭐⭐ 2026-10-18：⭐ 语义已改 —— 档 1 时逐位透传，**其余档"保持"最后的值**（⛔ 不再清零）
    output reg  [11:0]       vibrato_depth_o, // 音高颤音 深度
    output reg  [11:0]       vibrato_rate_o,  // 音高颤音 速率
    // ⭐⭐ 2026-10-18 新增：⭐ 音量颤音（档 2）
    output reg  [11:0]       trem_depth_o,    // 音量颤音 深度
    output reg  [11:0]       trem_rate_o,     // 音量颤音 速率
    // ⭐⭐ 2026-10-18 新增：⭐ 三档锁定状态（bit0/1/2 = 档 0/1/2）—— 给 LED / 屏用
    //    📌 ⚠️ 这是**唯一**的锁定状态寄存器（⛔ 不再另造一份内部副本 ⇒ 避免两份状态不同步）
    output reg  [2:0]        hold_o
);

    // ═══════════════════════════════════════════════════════════════════════
    //  ① ⭐ 推子 → 档位（0..12）：⭐ `floor(ch * 12 / 4095)` 的等价比较链
    // ═══════════════════════════════════════════════════════════════════════
    function [3:0] gear_step_of;
        input [11:0] ch;
        begin
            if      (ch >= 12'd4095) gear_step_of = 4'd12;
            else if (ch >= 12'd3754) gear_step_of = 4'd11;
            else if (ch >= 12'd3413) gear_step_of = 4'd10;
            else if (ch >= 12'd3072) gear_step_of = 4'd9;
            else if (ch >= 12'd2730) gear_step_of = 4'd8;
            else if (ch >= 12'd2389) gear_step_of = 4'd7;
            else if (ch >= 12'd2048) gear_step_of = 4'd6;
            else if (ch >= 12'd1707) gear_step_of = 4'd5;
            else if (ch >= 12'd1365) gear_step_of = 4'd4;
            else if (ch >= 12'd1024) gear_step_of = 4'd3;
            else if (ch >= 12'd683)  gear_step_of = 4'd2;
            else if (ch >= 12'd342)  gear_step_of = 4'd1;
            else                     gear_step_of = 4'd0;
        end
    endfunction

    wire [3:0] left_step  = gear_step_of(ch2_i);   // ⭐ 左推子档位（0..12）
    wire [3:0] right_step = gear_step_of(ch3_i);   // ⭐ 右推子档位（0..12）

    // ⭐ 档 0 的目标编码 = 12 + 右档位 − 左档位 ∈ [0, 24]
    //   ⚠️ 用 6 位中间量再截低 5 位：⭐ 两档位都在 0..12 ⇒ 结果必在 0..24，
    //      ⛔ 不会回绕（⭐ 12+12−0 = 24 ✅ · 12+0−12 = 0 ✅）
    wire [5:0] fader_enc6 = 6'd12 + {2'b0, right_step} - {2'b0, left_step};
    wire [4:0] fader_enc  = fader_enc6[4:0];
    //   ⭐⭐ P3.2：⭐ 这个**已经算出来的**值**同时**用作"推子动过"的比较对象 ✅
    //      （⭐ 见下面 `fader_moved` —— ⭐ 复用 ⇒ ⛔ 不新增比较链、⛔ 不改阈值）

    // ⭐⭐ 目标寄存器（⭐ 串口与推子【共用这一个】）—— ⚠️ 必须先声明：
    //    `default_nettype none` 下不存在隐式网线，且下面 ② 的候选值要引用它 ✅
    reg [4:0] enc_r;      // ⭐ 编码 0..24（⭐ 12 = 不变调）
    reg [4:0] enc_next;

    // ⭐⭐ P3.2（2026-10-03）：⭐ 边沿检测用的【上一拍】值
    //   ⭐ 比较对象 = ⭐ **量化后的档位编码** `fader_enc`（⭐ 0..24）——
    //      ⛔ 不再是 P3.1 的原始 12 位（⭐ 那会被 ±1 LSB 抖动每拍打真）
    //   ⭐ `fader_enc_q` 复位 = 5'd12（⭐ == `ch2_i = ch3_i = 0` 时的 `fader_enc`）
    //      ⚠️ 该复位值**结构上不可观测**（⭐ 见文件头 ③ 的说明）——
    //         ⭐ 它是**冒烟检查**，⛔ 不是"能红"判据
    //   ⭐ `gear_q` 复位 = 2'd1（⭐ == gear_o 的复位值）
    reg [4:0]  fader_enc_q;
    reg [1:0]  gear_q;
    //  ⭐⭐ 2026-10-18（用户裁定）：⭐ **解锁 = 立即采用推子当前位置** ✅
    //     📌 用户原话：*"我觉得就要跳变比较好，因为我置零就是不想要这个效果"*
    //        ⇒ ⭐ 推子停在 0 就是"这个效果我不要" ⇒ 解锁那一下**就该变成 0**（关掉），
    //           ⛔ 而不是"等你再动一下推子才生效" ✅
    //     📌 为什么需要这一位：⭐ 档 0 的接管原本只在
    //        ① `fader_moved`（推子量化档位动过）
    //        ② `gear0_enter`（刚切进档 0）
    //        两个边沿上发生 ⇒ ⚠️ **"解锁"本身两个都不成立**
    //        ⇒ 解锁后值不变、要再动一下才接管（等于 pickup，用户不要）✅
    //     ✅ 现在补第三个边沿 `unlock_enter`（`hold_o[0]` 的 1→0 那一拍）
    //        ⇒ ⭐ **三档行为统一**：两个颤音档本来就是"解锁立即跟随"（组合 mux），
    //          档 0 现在也一致 ✅
    //     ⚠️ 副作用（⭐ 预期的、用户要的）：⭐ 解锁那一拍变调会**跳到推子当前位置**
    //        ⇒ ⭐ 推子停在 0（两推子都在 0）⇒ 变调回 0 ✅
    //        📌 这正是"置零 = 不要这个效果"的语义 ✅
    reg        hold0_q;

    // ⭐ ① 推子动过 = ⭐ **量化档位**变了（⭐ 与上一拍不同）
    //   ⭐ ±1 LSB 抖动只要没跨过半音档边界 ⇒ `fader_enc` 不变 ⇒ ⛔ 不接管 ✅
    wire fader_moved = (fader_enc != fader_enc_q);
    // ⭐ ② 刚切进档 0（⭐ `gear_q` 是上一拍档位 ⇒ 该条件只成立**一拍**）
    wire gear0_enter = (gear_o == 2'd0) && (gear_q != 2'd0);
    // ⭐ ③ 刚解锁档 0（⭐ `hold0_q` 是上一拍锁定位 ⇒ 该条件只成立**一拍**）
    wire unlock_enter = (gear_o == 2'd0) && (hold_o[0] == 1'b0) && (hold0_q == 1'b1);

    // ═══════════════════════════════════════════════════════════════════════
    //  ② ⭐ 三个串口命令的候选值（⭐ 全部 clamp 到 0..24 ⇒ 即 ±12 半音）
    // ═══════════════════════════════════════════════════════════════════════
    //   ⭐ 'F' 降 1：⭐ 到 0（= −12）就**停住**，⛔ 不回绕
    wire [5:0] enc_down = {1'b0, enc_r} - 6'd1;
    wire [4:0] down_sat = (enc_r == 5'd0) ? 5'd0 : enc_down[4:0];
    //   ⭐ 'G' 升 1：⭐ 到 24（= +12）就**停住**，⛔ 不回绕
    wire [5:0] enc_up   = {1'b0, enc_r} + 6'd1;
    wire [4:0] up_sat   = (enc_r >= 5'd24) ? 5'd24 : enc_up[4:0];
    //   ⭐ 'H' 绝对量：⭐ `> 24` ⇒ clamp 到 24（⭐ 与 P2 版 top.v 同一口径）
    //   ⚠️ 必须用【完整 8 位】比较 —— ⛔ 不能只取 `[4:0]`：
    //      否则 `44`（⭐ 应 clamp 到 +12）会被截成 `12` ⇒ 变成"不调"（⭐ 静默错）
    wire [4:0] abs_sat  = (trans_abs_val_i > 8'd24) ? 5'd24 : trans_abs_val_i[4:0];

    // ═══════════════════════════════════════════════════════════════════════
    //  ③ ⭐⭐ 目标寄存器（⭐ 串口与推子【共用这一个】）
    //
    //   ⭐ 优先级（⭐ 单拍脉冲优先，⭐ 然后才是档 0 的推子接管）：
    //      1. 'F' / 'G' / 'H'（⭐ 显式用户命令）
    //      2. 档 0 ⇒ ⭐ 推子**量化档位变化时**才接管
    //         （⭐ P3.1 A′：⭐ 值没变就保持 · ⭐ P3.2：⭐ 比较的是**档位**，
    //          ⛔ 不是原始 12 位 ⇒ ⭐ ±1 LSB 抖动不接管 ✅）
    //      3. 档 1 / 档 2 ⇒ ⭐ 保持（⭐ 推子不驱动变调）
    //
    //   ⭐⭐ 2026-10-18：⭐ **档 0 的接管额外受 `hold_o[0]` 管** ✅
    //      🔴 旧写法无条件接管 ⇒ ⚠️ 锁了变调之后再切回档 0，
    //         仍会被推子位置覆盖 ⇒ ⭐ 锁定失效 ✅
    //      ✅ 现在：`hold_o[0] == 1` ⇒ ⭐ 档 0 **完全不接管**（值保持）✅
    //      📌 `'F'`/`'G'`/`'H'` **仍然有效**（⭐ 串口是显式命令，与推子锁定无关）——
    //         这是**刻意的**：锁定锁的是"推子"，⛔ 不锁串口 ✅
    // ═══════════════════════════════════════════════════════════════════════
    always @(*) begin
        if      (trans_down_i)   enc_next = down_sat;
        else if (trans_up_i)     enc_next = up_sat;
        else if (trans_abs_i)    enc_next = abs_sat;
        else if (gear_o == 2'd0) enc_next = ((fader_moved || gear0_enter || unlock_enter) && !hold_o[0])
                                          ? fader_enc : enc_r;
        else                     enc_next = enc_r;
    end

    // ═══════════════════════════════════════════════════════════════════════
    //  ⭐⭐ 2026-10-18：⭐ "保持"用的影子寄存器 ＋ 跟随条件
    //
    //  ⭐ **为什么必须"影子寄存器 + 组合 mux"**（⛔ 不能直接把输出改成寄存器）：
    //     · ⭐ 档 1 的输出必须是**组合逐位透传** `ch2_i`/`ch3_i`
    //       ⇒ ⭐ 与旧行为**逐位相同**、⛔ 不引入 1 拍延迟 ✅
    //       （⭐ 旧注释 ④ 明写："保证档 1 时输出 == 输入是逐位恒等，
    //          ⛔ 不引入任何一拍延迟或位宽截断" ✅）
    //     · ⭐ 而"保持"需要**记住最后的值** ⇒ 只能靠寄存器
    //     ⇒ ⭐ 两者兼得：**跟随时走组合**、**不跟随时读影子寄存器** ✅
    //
    //  ⭐ 影子寄存器只在"该档 + 未锁定"时被刷新 ⇒
    //     离开该档的那一刻，里面正好是**最后一次跟随时的值** ⇒ ⭐ "保持"成立 ✅
    // ═══════════════════════════════════════════════════════════════════════
    reg [11:0] vib_d_hold, vib_r_hold;   // 音高颤音 深度/速率 的最后值
    reg [11:0] trm_d_hold, trm_r_hold;   // 音量颤音 深度/速率 的最后值

    wire vib_follow = (gear_o == 2'd1) && !hold_o[1];   // ⭐ 档 1 且未锁 ⇒ 跟随推子
    wire trm_follow = (gear_o == 2'd2) && !hold_o[2];   // ⭐ 档 2 且未锁 ⇒ 跟随推子

    always @(posedge clk) begin
        if (!rst_n) begin
            enc_r  <= 5'd12;      // ⭐ 编码 12 = 不变调（⭐ 与 P2 复位值一致）
            gear_o <= 2'd1;       // ⭐⭐ 上电默认【档 1】⇒ 零回归 ✅
            // ⭐ P3.2：⭐ 边沿检测寄存器复位到"推子初值 / 档位初值"
            //   ⭐ 5'd12 == `ch2_i = ch3_i = 0` 时的 `fader_enc`（⭐ 不误判"动过"）
            //     ⚠️ 该复位值**结构上不可观测**（⭐ 1 拍自愈 + `gear0_enter` 兜底）
            //        ⇒ ⭐ tb 的 ③ 组是**冒烟检查**，⛔ 不是"能红"判据
            //   ⭐ 2'd1  == gear_o 的复位值（⭐ 不误判"刚切进档 0"）
            fader_enc_q <= 5'd12;
            gear_q <= 2'd1;
            // ⭐⭐ 2026-10-18：⭐ 锁定状态复位 = **全解锁**（用户裁定）
            //    📌 含义：上电后三档都跟随推子 ⇒ ⭐ 与旧行为一致（零回归起点）✅
            hold_o <= 3'b000;
            // ⭐ 影子寄存器复位 = 0 ⇒ ⭐ 上电两个颤音都是"关" ✅
            vib_d_hold <= 12'd0; vib_r_hold <= 12'd0;
            trm_d_hold <= 12'd0; trm_r_hold <= 12'd0;
            // ⭐⭐ 2026-10-18：⭐ `unlock_enter` 的边沿检测寄存器
            //    ⭐ 复位到 1（= "视为已锁定过"）⇒ ⚠️ 但 `gear_o` 复位是档 1，
            //       而 `unlock_enter` 还要求 `gear_o == 0` ⇒ ⭐ 复位后**不会误触发** ✅
            hold0_q <= 1'b0;
        end else begin
            enc_r <= enc_next;
            // ⭐ P3.2：⭐ 每拍记下"上一拍的量化档位"（⭐ 供上面的边沿检测用）
            fader_enc_q <= fader_enc;
            gear_q <= gear_o;
            hold0_q <= hold_o[0];   // ⭐ 供 `unlock_enter`（1→0 那一拍）

            // ── ⭐⭐ 锁定键：⭐ 翻转【当前档】那一位（⛔ 只翻一位、⛔ 不影响别档）──
            //   ⭐ `3'b001 << gear_o`：⭐ 档 0/1/2 ⇒ 3'b001/010/100 ✅
            //   📌 `gear_o` 只可能是 0/1/2（三档循环）⇒ ⛔ 不会移出界 ✅
            //   ⚠️ `hold_o` **只在本块被写**（⭐ 复位分支 + 本分支）⇒ ⛔ 无 EX2000 多驱动 ✅
            // Direct screen changes lock the departing gear; physical next stays manual.
            if ((gear_sel0_i && gear_o != 2'd0) ||
                (!gear_sel0_i && gear_sel1_i && gear_o != 2'd1) ||
                (!gear_sel0_i && !gear_sel1_i && gear_sel2_i && gear_o != 2'd2))
                hold_o <= hold_o | (3'b001 << gear_o);
            else if (lock_toggle_i)
                hold_o <= hold_o ^ (3'b001 << gear_o);

            // ── ⭐ 影子寄存器：⭐ 只在"该档 + 未锁定"时跟随；其余时候**保持** ──
            if (vib_follow) begin vib_d_hold <= ch2_i; vib_r_hold <= ch3_i; end
            if (trm_follow) begin trm_d_hold <= ch2_i; trm_r_hold <= ch3_i; end

            // ── ⭐ 切档：⭐ 屏点选（直接跳）优先于 `'J'` 的三档循环 ──────────
            //   ⭐ 三档循环 `0 → 1 → 2 → 0`（⭐ 旧版是 `0 ⇄ 1`，档 2 结构上不可达）
            //   ⚠️ `gear_o + 2'd1` 对 2 会得到 3 ⇒ ⭐ 所以 2 单独判成 0 ✅
            if      (gear_sel0_i) gear_o <= 2'd0;
            else if (gear_sel1_i) gear_o <= 2'd1;
            else if (gear_sel2_i) gear_o <= 2'd2;
            else if (gear_next_i) gear_o <= (gear_o == 2'd2) ? 2'd0 : (gear_o + 2'd1);
        end
    end

    // ⭐ 编码 `0..24` ⇒ signed `−12..+12`
    //   ⭐ `$signed({1'b0, enc_r})`：⭐ 先零扩展成 6 位有符号再减 ⇒
    //      ⭐ `0 − 12 = −12`（⛔ 不是无符号回绕的 20）✅
    assign transpose_semi_o = $signed({1'b0, enc_r}) - 5'sd12;

    // ═══════════════════════════════════════════════════════════════════════
    // Current unlocked gear follows the physical faders without added latency.
    // Off-gear outputs are zero unless their independent hold bit is set.
    // Screen direct selection sets the departing hold bit before changing gear.
    // Physical/J next selection keeps the manual-lock contract.
    // Only the output mux changes; quantization, enc_r and shadows stay intact.
    // ═══════════════════════════════════════════════════════════════════════
    always @(*) begin
        // 音高颤音（档 1）
        vibrato_depth_o = vib_follow ? ch2_i : (hold_o[1] ? vib_d_hold : 12'd0);
        vibrato_rate_o  = vib_follow ? ch3_i : (hold_o[1] ? vib_r_hold : 12'd0);
        // 音量颤音（档 2）—— ⭐ 2026-10-18 新增
        trem_depth_o    = trm_follow ? ch2_i : (hold_o[2] ? trm_d_hold : 12'd0);
        trem_rate_o     = trm_follow ? ch3_i : (hold_o[2] ? trm_r_hold : 12'd0);
    end

endmodule

`default_nettype wire
