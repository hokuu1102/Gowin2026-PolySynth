`timescale 1ns/1ps
// ─────────────────────────────────────────────────────────────────────────────
// event_extract.v · W3a 语义层：触发 / 拨弦 / 不应期（⭐ 先触发后修正）
//
// ⭐ 冻结定义（`files/20-代码/代码总览图.md:196`）：
//    *"触发 / 拨弦 / 不应期（⭐ **先触发后修正**）"*
// ⭐ 产品决议 `A2c`（`产品形态决议清单.md`）：*"不应期是【事后封锁】，⛔ 不是【事前等待】"*
//    ⇒ ⭐ **首次越阈【立即】产生事件**（⛔ 不等稳定）
//
// ── 🔴 本模块的阶段划分（⭐ 2026-09-23 用户拍板："先做 MVP，但预留好接口"）──────
//
//   ⭐ **阶段 1（MVP，本版实现）= 单轴越阈 ⇒ `note_on` / 回落 ⇒ `note_off`**
//      ⇒ ⭐ 目的：⭐ **"按琴键出声"（本周硬指标）**
//
//   ⭐ **阶段 2（接口已预留，逻辑待填）= 滑音 / 双音**
//      · ⭐ **滑音**：`dA < −TH` **且** `dB > +TH`（一减一增 = 反向）
//        ⇒ ⭐ 发一个音，`pitch_upd` 连续改音高，⭐ 最终落到 `B`
//      · ⭐ **双音**：`dA ≥ 0` **且** `dB ≥ 0`（都不减）且都越阈
//        ⇒ ⭐ **同时发两个音**
//      🔴 **预留的接口**（⭐ 见下方 `slide_*` / `two_note_*` 输出）
//         ⇒ ⚠️ **本版恒为 0**，⭐ 阶段 2 填逻辑时**⛔ 不用改端口**
//
// ── ⭐ 输入（← `axis_snapshot`，⭐ 同帧、原子）────────────────────────────────
//   `snap_valid_i`  ⭐ 一帧一次的原子快照脉冲
//   `pos_i`         ⭐ 16 轴行程（轴 i = `[i*POS_W +: POS_W]`）
//   `delta_i`       ⭐ 16 轴**带符号**增量（⭐ 滑音/双音的原料）
//
// ── ⭐ 输出（→ `evt_merge` → `note_manager`）─────────────────────────────────
//   ⭐ **事件通路**（阶段 1 就用）：
//      `evt_valid_o` 单周期脉冲 · `evt_axis_o` · `evt_kind_o`(0=on/1=off/2=pluck)
//      `evt_depth_o`（触发时的行程 ⇒ ⭐ 供 `param_extract` 算力度）
//   ⭐ **滑音/双音预留接口**（阶段 2 填，⛔ 本版恒 0）：
//      `slide_valid_o` · `slide_axis_o` · `slide_dir_o`（+1 = 向右滑、−1 = 向左）
//      `two_note_valid_o` · `two_note_axis_a_o` · `two_note_axis_b_o`
//
// ── ⛔ 纪律 ───────────────────────────────────────────────────────────────────
//   · ⭐ **Verilog-2001**（`K-91`：⛔ 不用 SV 专有构造，否则整模块被静默丢弃）
//   · ⭐ **同步复位、低有效**、⭐ **单时钟域 50 MHz**
//   · ⭐ **`valid` 与数据必须同拍**（`K-109`：⚠️ 本项目已犯过的真缺陷）
// ─────────────────────────────────────────────────────────────────────────────
`default_nettype none

module event_extract #(
    // ⭐ 轴数（⭐ 16 = 2 片 ADC × 8 通道）
    parameter integer AXIS_N = 16,
    // ⭐ 行程位宽（12 = MCP3208 满量程）
    parameter integer POS_W  = 12,
    // ⭐ 增量位宽（⭐ 必须 = `POS_W + 1`，带符号）
    parameter integer DW     = POS_W + 1,
    // ⭐ 轴号位宽（4 ⇒ 最多 16 轴，⭐ 与 `note_manager.AXIS_W` 一致）
    parameter integer AXIS_W = 4,

    // ── ⭐ 阈值参数（⭐ 用户拍板"先按建议写、做成 parameter"）────────────────
    //   ⚠️ **全部上板可调** —— ⛔ 不要写死
    //   ⭐ 触发阈 ≈ 25% 行程（⚠️ 12 位满量程 4095 ⇒ 0x400 = 1024）
    parameter [POS_W-1:0] TRIG_TH   = 12'h400,
    //   ⭐ 释放阈（**迟滞**：⭐ 比触发阈低 ⇒ ⚠️ 防回中弹簧振荡造成多次翻转）
    parameter [POS_W-1:0] REL_TH    = 12'h300,
    //   ⭐ **Δ 阈值**（⭐ 滑音/双音判据用）
    //      ⚠️ 依据：滑动时每帧行程变约 `4096/500 ≈ 8` 个码
    //      ⇒ ⭐ 取 8：**大于手抖/噪声**、**小于真实滑动速度**
    parameter signed [DW-1:0] DELTA_TH = 13'sd8,
    //   ⭐ **不应期**（单位：快照帧数）
    //      🔴 2026-09-25 更正：一帧 = **500 µs**（⛔ 不是原来注释写的 196 µs）
    //         📌 实测证据：`sim/evidence/tb_adc_farm.log` = `frame period=500000 ns`
    //         ⚠️ 196 µs 是【转换耗时】8×24.5 µs，⛔ 不是帧周期（⭐ 见 `K-128`）
    //      ⇒ ⭐ 默认 150 帧 实际 = **75 ms**（⚠️ 原注释声称 30 ms，🔴 差 2.55 倍）
    //   ⚠️ **`top.v` 里把它覆盖成了 150** ⇒ ⭐ 真值以调用点为准（⭐ 见 `top.v` 的参数表）
    parameter integer REFRACT_N = 150,

    //  ⭐⭐⭐⭐ 2026-10-11（⭐ **滑音**）：⭐ **窗口 ＋ 起滑阈值** ✅
    //
    //  ⭐ **依据**：⭐ `review/滑音触发规格-20261011.md`（⭐ 用户 2026-10-11 拍板 ✅）
    //  ⭐ `SLIDE_WIN`：⭐ A 离开到 B 形成之间的**最大帧数** ✅
    //     ⭐ 1000 帧 × 500 µs/帧 = **500 ms**（⭐ 手滑很从容 ✅）
    //     ⚠️ 帧周期 = **500 µs**（⭐ `K-128` 更正过：⛔ 不是 196 µs ✅）
    //  ⭐ `SLIDE_START_TH`：⭐ **B 侧的起滑阈值** —— 🔴 **必须很小** ✅
    //     ⭐ 用户原话：⭐ *"滑音要在 **B 稍微有一点点形成的时候**就开始发出，
    //        ⛔ 不能等 B 完全按下之后才响"* ✅
    //     ⇒ ⭐ `12'h040` = 64 码 ≈ **1.6% 行程**（⭐ = `TRIG_TH` 的 **1/16** ✅）
    //     ⚠️ 下界：⭐ 必须**高于噪声** —— `DELTA_TH = 8` 码 ⇒ ⭐ 64 码 ≈ **8 倍余量** ✅
    parameter integer     SLIDE_WIN      = 1000,
    //  ⭐⭐ 2026-10-16（⭐ 用户裁定：滑音模式开着 ⇒ **相邻先后发生就算滑音**）：
    //     ⚠️ 旧值 64（12 位满量程的 1.6%）要求"B 侧【单帧】涨 64 码" ⇒
    //        🔴 而 `delta` 是【逐帧增量】（`axis_snapshot.v:277` `delta = cur − prev`）⇒
    //           即使快速甩，B 在过渡帧的增量也常常不到 64 ⇒ 判不出来 ✅
    //     ⭐ **新值 4**（⭐ 与噪声门槛 `DELTA_TH=8` 的一半 ⇒ ⭐ 够低、又高于纯噪声抖动）：
    //        ⇒ ⭐ "B 的行程在**增加**"就算开始形成 ✅
    //        ⇒ ⭐ 配合"滑音模式开着"这个前提 ⇒ ⭐ **误触由用户关模式兜底**（⭐ 用户原话）✅
    parameter [POS_W-1:0] SLIDE_START_TH = 12'h004
) (
    input  wire                    clk,
    input  wire                    rst_n,        // ⭐ 同步复位、低有效

    // ═══════════════════════════════════════════════════════════════════════
    // ⭐⭐ 判键使能（⭐ 2026-09-23 新增，🔴 修一个**上板必然遇到**的真缺陷）
    //
    //   🔴 **为什么需要**（⭐ 实测发现）：
    //      ⚠️ 上电后 `calib_autotare` 要等 `DELAY_CLK`（默认 200 ms）才做 `tare`，
    //         ⭐ 而**在那之前 `pos` 是【未标定的脏值】**：
    //         · 未 `tare` ⇒ `zero = 0` ⇒ `pos = 4095 − raw = 4095 − 1985 = 2110`
    //         · ⭐ 而阈值是**按标定后的空间**设的（⭐ 现值 `TRIG_TH = 64`，见 `rtl/top.v:2348`）
    //            🔴 2026-10-01 更正：旧注释写 `TRIG_TH = 149` ⇒ ⚠️ **过时**（那是更早的档位）。
    //            ⚠️ 无论哪个值，下面的结论都成立：**2110 ≫ 阈值 ⇒ 16 轴全被判"按下"**。
    //         ⇒ 🔴 **2110 ≫ 149 ⇒ 16 个轴【全被判成"按下"】**
    //      ⇒ 🔴 **开机瞬间起一堆音符**，⚠️ 而它们**本来就没被按过**
    //         ⇒ ⭐ 松手也关不掉（⭐ 因为对应的"按下"根本没发生过）
    //      ⭐ 实测证据：e2e tb 里 `n_on=8`（⭐ 我一次都没按）、
    //         `nm_gate = 0x08000000`（⭐ 一个 voice **恒 held**）。
    //
    //   ⭐ **语义上本来就该这样**：⭐ **"标定还没做好 ⇒ 读数不可信 ⇒ 不该判按键"**。
    //      ⚠️ 所以在标定完成前**锁住事件层**是**正确做法**，⛔ 不是绕过问题。
    //
    //   📌 **`enable_i = 0` 时的行为**：
    //      ⭐ **只清"按键状态"**（`key_on` / `refr`），⛔ **不产生任何事件**。
    //      ⚠️ 这样标定完成后**从干净状态开始** ⇒ ⭐ 不会把标定前的误触发延续下来。
    //      🔴 **注意**：⛔ 不是"冻结" —— ⚠️ 冻结会把脏状态**带过去**（⭐ 那就白锁了）。
    // ═══════════════════════════════════════════════════════════════════════
    input  wire                    enable_i,
    //  ⭐⭐⭐⭐ 2026-10-11（⭐ **滑音开关**）：⭐ **`slide_en_i`** ✅
    //     ⭐ 依据：⭐ `review/滑音触发规格-20261011.md` §五（⭐ 用户要求"可以单独给滑音加一个开关" ✅）
    //     🔴 **为什么必须有**：⭐ 滑音判据**依赖阈值和窗口** ✅ ⇒ ⚠️ 上板调参**必须能关掉**
    //        （⭐ 否则一旦误触发，⭐ 会**静默改掉音高** 🔴 —— ⭐ `K-106` 那一类 ✅）
    //     📌 ⭐ **默认关**（⭐ `top.v` 的寄存器复位 = 0 ✅）⇒ ⭐ 行为与改动前**逐位一致** ✅
    //     ⚠️ ⭐ **必须 Z-safe 判定**（⭐ 见下方 `:371` 的 `enable_i === 1'b0` 先例 ✅）：
    //        ⭐ 用 `slide_en_i === 1'b1` ⛔ 不用 `if (slide_en_i)` ——
    //        ⚠️ 后者在 `x`/`z` 时会**误开** ✅
    input  wire                    slide_en_i,

    // ── 输入：⭐ 来自 `axis_snapshot`（同帧、原子）──────────────────────────
    input  wire                    snap_valid_i,
    input  wire [AXIS_N*POS_W-1:0] pos_i,
    input  wire [AXIS_N*DW-1:0]    delta_i,

    // ── 输出：事件通路（⭐ 阶段 1）──────────────────────────────────────────
    output reg                     evt_valid_o,
    output reg  [AXIS_W-1:0]       evt_axis_o,
    output reg  [1:0]              evt_kind_o,    // ⭐ 0=note_on 1=note_off 2=pluck
    output reg  [POS_W-1:0]        evt_depth_o,

    //  ⭐⭐ 2026-10-09（`P0-27`）：⭐ **把内部按键状态打包引出** ✅
    //   🔴 **为什么**：⭐ `led_data.key_active_i` 原来是**占位 `16'd0`**
    //      ⇒ 🔴 `key_pattern` 恒 0 ⇒ ⭐ `pattern_changed` 恒假 ⇒ ⭐ `commit_r` 恒 0
    //      ⇒ ⭐ `tlc5916_bank` 一轮都不跑 ⇒ 🔴 **24 路 TLC5916 输出（16 键灯 + 8 状态灯）永久消隐** ✅
    //   ⭐ **本输出** = `key_on[]` 的**打包版**（⭐ 位 i = 轴 i 当前是否已按下 ✅）
    //      📌 `key_on[]` 本来就在内部维护（⭐ 带迟滞的状态 ✅）⇒ ⭐ **零额外逻辑** ✅
    output wire [AXIS_N-1:0]       key_on_o,

    // ── 输出：滑音 / 双音【预留接口】（⭐ 阶段 2 填，⛔ 本版恒 0）─────────────
    output reg                     slide_valid_o,
    output reg  [AXIS_W-1:0]       slide_axis_o,
    output reg  signed [1:0]       slide_dir_o,   // ⭐ +1 = 向高音轴滑、−1 = 向低音轴滑
    //  ⭐⭐⭐⭐ 2026-10-13（⭐ **滑音音高通路**）：⭐ **B 的轴号必须输出** ✅
    //
    //  🔴 **为什么需要**：⭐ 滑音的音高目标是 **B 的 `phase_inc`** ✅（⭐ 见
    //     `review/滑音触发规格-20261011.md` ✅）
    //     ⚠️ 而 ⭐ `slide_dir_o` **不够用** —— ⭐ 它只给方向 ✅
    //        🔴 ⭐ 因为 **"相邻"是【物理布局】决定的** ✅（⭐ ⛔ 不是轴号相邻 ✅）
    //        ⇒ ⭐ B **不等于** A±1 ✅（⭐ 例如 A=7 时 B 可以是 6 或 0 ✅）
    //     ✅ ⭐ 本模块**内部已经算出 B**（⭐ 它是用 `is_h_adj` 匹配出来的 ✅）
    //        ⇒ ⭐ 只要把它**引出来**即可 ✅
    //     📌 ⭐ 用法（⭐ `top.v` ✅）：⭐ `phase_inc` 取 `axis_map` 的 `fb_inc[B]` ✅
    //        ⭐ 而 ⭐ `axis_map.fb_inc[0..15]` **已经是 16 轴全表** ✅
    //        （⭐ 依据：⭐ `top.v:3739-3740` 的注释 ✅ —— ⭐ 只需把"选轴"挪进去 ✅）
    //     ⚠️ ⭐ 非滑音拍 = ⭐ 保持上一个值 ✅（⭐ 与 `slide_axis_o` 同一口径 ✅）
    output reg  [AXIS_W-1:0]       slide_axis_b_o,
    output reg                     two_note_valid_o,
    output reg  [AXIS_W-1:0]       two_note_axis_a_o,
    output reg  [AXIS_W-1:0]       two_note_axis_b_o,

    // ── 输出：⭐ 溢出可见（⭐ `K-106` 纪律：⚠️ 溢出⛔ 不许静默）───────────────
    output wire                    overflow_o,    // ⭐ sticky（置位后保持）
    output wire [7:0]              lost_cnt_o     // ⭐ 累计丢弃数（**饱和**，⛔ 不回绕）
);

    // ═══════════════════════════════════════════════════════════════════════
    // ⭐ 每轴状态：⭐ **迟滞 + 不应期**
    //
    //   ⭐ `key_on[i]`  = 该轴当前是否"已按下"（⭐ 带迟滞的状态）
    //   ⭐ `refr[i]`    = 剩余不应期计数（⭐ >0 ⇒ 封锁中）
    // ═══════════════════════════════════════════════════════════════════════
    reg              key_on [0:AXIS_N-1];
    reg [15:0]       refr   [0:AXIS_N-1];    // ⭐ 16 位够 65535 帧（≈12.8 s）

    //  ⭐⭐ 2026-10-09（`P0-27`）：⭐ **把 `key_on[]` 打包成 `key_on_o`**（⭐ 给 `led_data` 用）✅
    //   📌 用 `generate` + `assign`（⭐ 与文件里其它地方同一风格，⛔ 不用 `always @(*)`）✅
    //   📌 零额外逻辑：⭐ 纯组合重排（⭐ 综合后只是改连线）✅
    genvar ko;
    generate
        for (ko = 0; ko < AXIS_N; ko = ko + 1) begin : g_key_on_pack
            assign key_on_o[ko] = key_on[ko];
        end
    endgenerate

    // ⭐ 逐轴扫描状态机（⭐ 一拍一个轴 ⇒ ⛔ 不会覆盖 FIFO 指针）
    //   ⚠️ `SAW` 位宽 = `$clog2(AXIS_N)`（⭐ 16 轴 ⇒ 4 位）
    localparam integer SAW = (AXIS_N <= 1) ? 1 : $clog2(AXIS_N);
    reg [SAW-1:0] scan_axis;
    reg           scanning;

    // ⭐ 逐轴扫描变量（⭐ 用 for 遍历 ⇒ 可综合、参数化）
    integer ai;

    // ═══════════════════════════════════════════════════════════════════════
    // ⭐⭐ 事件缓冲：🔴 **修"同帧多轴丢事件"**（⭐ 本项目已犯过的缺陷类）
    //
    //   🔴 **⚠️ 我第一版的设计缺陷（2026-09-23，写完就发现）**：
    //      ⚠️ 我把 `evt_valid_o`/`evt_axis_o`/… 直接在 `for (ai...)` 循环里赋值
    //      ⇒ 🔴 **同一帧若有 2 个轴越阈**（⭐ 和弦 / 双音 / 快速扫键）
    //      ⇒ ⭐ **只有最后一个轴的事件存活，其余的【静默丢失】**。
    //      ⭐⭐ **这正是 `evt_merge` 要解决的"同拍相撞丢事件"的同族缺陷**
    //         ⇒ ⚠️ 而且更糟：⭐ **事件在进 `evt_merge` 之前就没了**，
    //            ⭐ `evt_merge` 的仲裁**根本救不了它**（⚠️ 它压根没收到）。
    //
    //   ⭐ **修法：在 `event_extract` 内部加一个【小 FIFO】**
    //      ⇒ ⭐ 一帧内检测到 N 个事件就 push N 次，⭐ **逐个吐出**（⛔ 不丢）
    //      ⭐ 与 `evt_merge` 同样的取舍：**同帧多事件时后面的晚几拍**
    //         （⚠️ 但一帧 9800 拍 ⇒ ⭐ **延迟完全在预算内**）。
    //
    //   ⭐ **深度取 4**：⚠️ 依据 —— ⭐ 一帧内最多"16 轴全部同时越阈"，
    //      但 ⚠️ 实际演奏中**同一帧内 2~3 个轴同时过阈**已是极限
    //      （⭐ 人手指不可能 16 个键在 500 µs 内同时按下 —— ⚠️ 原写 196 µs，见 `K-128`）
    //      ⇒ ⭐ **4 够用**；⚠️ 溢出时**有 sticky 计数**（⛔ 不静默丢）
    // ═══════════════════════════════════════════════════════════════════════
    localparam integer FIFO_D = 4;
    localparam integer FW     = 2;      // ⭐ 指针位宽（$clog2(4)）

    reg [AXIS_W-1:0] q_axis [0:FIFO_D-1];
    reg [1:0]        q_kind [0:FIFO_D-1];
    reg [POS_W-1:0]  q_depth[0:FIFO_D-1];
    reg [FW:0]       q_cnt;             // ⭐ 水位（多 1 位便于判满）
    reg [FW-1:0]     q_wr, q_rd;

    // ⭐ 溢出可见（⭐ `K-106` 纪律：⭐ **溢出必须有 sticky 指示 + 饱和计数**）
    reg              overflow_o_r;
    reg [7:0]        lost_cnt_r;

    // ⭐ 溢出可见（⭐ `K-106` 纪律：⭐ **溢出必须有 sticky 指示 + 饱和计数**）
    //   ⚠️ 为什么不静默丢：⭐ 丢的是**音符事件** ⇒ ⚠️ 丢 `note_off` ⇒ **挂音**
    //      （⭐ 这正是 `T38` 专门要防的失效模式）⇒ ⭐ **必须可见**。
    assign overflow_o = overflow_o_r;
    assign lost_cnt_o = lost_cnt_r;

    // ⚠️ **`ai` 是 `integer`（32 位）⇒ 用它做切片基址时⛔ 不要参与算术后再拼**
    //    🔴 教训（`83 号`/`L49`，⭐ 本会话已踩过一次）：
    //       ⭐ `12'h400 + c`（`c` 是 integer）会让**整个表达式升到 32 位**
    //       ⇒ ⚠️ 若再拼接就会**静默截断**。
    //    ⭐ 本模块只用 `ai` 做**索引**（⛔ 不做拼接）⇒ ✅ 安全。

    // ═══════════════════════════════════════════════════════════════════════
    // ⭐⭐ 主逻辑：⭐ **每帧扫描 16 个轴**
    //
    //   ⚠️ **为什么是"每帧"而不是"逐轴流水"**：
    //      ⭐ 输入已经是**同帧快照** ⇒ ⭐ 必须在**一帧内**看完全部轴，
    //      才能判断"相邻两轴"（⭐ 滑音/双音）。
    //   ⚠️ **一帧的时钟预算**：⭐ 一帧 500 µs @50 MHz = **25000 拍**
    //      （🔴 原写"196 µs = 9800 拍"，见 `K-128` —— ⚠️ 两个数都错了）
    //      ⇒ ⭐ 扫 16 个轴用 16 拍 ⇒ ⭐ **余量 1500 倍**（⛔ 不是性能问题）。
    // ═══════════════════════════════════════════════════════════════════════

    // ⭐ 事件输出寄存器（⭐ 与 `evt_valid_o` **同拍锁存** —— ⭐ `K-109` 要求）
    //   ⭐ ⚠️ **关键**：`evt_*` 现在由 **FIFO 出队**驱动（⛔ 不是循环直接赋）
    //      ⇒ ⭐ **同拍性由"出队那一拍同时锁存数据"保证**。
    integer pi;
    reg q_push_now;

    // ═══════════════════════════════════════════════════════════════════════
    // ⭐⭐⭐⭐ 2026-10-11（⭐ **滑音**）：⭐ **水平相邻表 ＋ 窗口状态** ✅
    //
    //  🔴🔴 **关键：⭐ "相邻"是【物理布局】决定的，⛔ 不是轴号相邻** ✅
    //     ⭐ 依据：⭐ `files/10-硬件/霍尔键位-CH映射-20260923.md`（⭐ 自称
    //        *"⭐ 这是**布线决定的物理事实**，⛔ 不是设计选择"* ✅）
    //     ⭐ 16 轴 = **左右两块【完全相同】的左手板**（⭐ 各 2 排 × 4 列 ✅）
    //        ⭐ 轴号 = `adc_idx × 8 + CH` ✅
    //
    //     ⭐ 物理列  1   2   3   4  |  5   6   7   8
    //     ⭐ 上排轴  6   7   0   1  | 14  15   8   9
    //     ⭐ 下排轴  5   4   3   2  | 13  12  11  10
    //
    //     ⇒ ⭐ **水平相邻只有 12 对** ✅（⭐ 4 段 × 3 对 ✅）：
    //        ⭐ 上排左 (6,7) (7,0) (0,1) · ⭐ 下排左 (5,4) (4,3) (3,2)
    //        ⭐ 上排右 (14,15) (15,8) (8,9) · ⭐ 下排右 (13,12) (12,11) (11,10)
    //     ⚠️ ⭐ **两块板之间不算相邻**（⭐ 它们是两块独立的板 ✅）
    //
    //  📌 ⭐ **所以⛔ 不能用 `abs(B−A)==1`** —— ⚠️ 那会把 (1,2) 这种
    //     "轴号相邻但**物理上跨板/跨行**"的对误判成滑音 ✅
    // ═══════════════════════════════════════════════════════════════════════
    function is_h_adj;
        input [AXIS_W-1:0] a;
        input [AXIS_W-1:0] b;
        begin
            //  ⭐ 上排左：6-7-0-1
            is_h_adj = ((a == 4'd6  && b == 4'd7 ) || (a == 4'd7  && b == 4'd6 ) ||
                        (a == 4'd7  && b == 4'd0 ) || (a == 4'd0  && b == 4'd7 ) ||
                        (a == 4'd0  && b == 4'd1 ) || (a == 4'd1  && b == 4'd0 ) ||
            //  ⭐ 下排左：5-4-3-2
                        (a == 4'd5  && b == 4'd4 ) || (a == 4'd4  && b == 4'd5 ) ||
                        (a == 4'd4  && b == 4'd3 ) || (a == 4'd3  && b == 4'd4 ) ||
                        (a == 4'd3  && b == 4'd2 ) || (a == 4'd2  && b == 4'd3 ) ||
            //  ⭐ 上排右：14-15-8-9
                        (a == 4'd14 && b == 4'd15) || (a == 4'd15 && b == 4'd14) ||
                        (a == 4'd15 && b == 4'd8 ) || (a == 4'd8  && b == 4'd15) ||
                        (a == 4'd8  && b == 4'd9 ) || (a == 4'd9  && b == 4'd8 ) ||
            //  ⭐ 下排右：13-12-11-10
                        (a == 4'd13 && b == 4'd12) || (a == 4'd12 && b == 4'd13) ||
                        (a == 4'd12 && b == 4'd11) || (a == 4'd11 && b == 4'd12) ||
                        (a == 4'd11 && b == 4'd10) || (a == 4'd10 && b == 4'd11));
        end
    endfunction

    //  ⭐ 窗口状态：⭐ "最近离开的轴" ＋ ⭐ 它的年龄（⭐ 单位 = 帧 ✅）
    reg [AXIS_W-1:0] left_ax_r;
    reg              left_v_r;
    reg [10:0]       left_age;
    //  ⭐ 本帧的组合临时量（⭐ 阻塞赋值，⭐ 与 `q_push_now` 同一风格 ✅）
    reg              left_hit;
    reg [AXIS_W-1:0] left_ax_n;
    reg              slide_hit;      // ⭐ 阻塞临时量：⭐ "本帧已找到滑音"（⭐ 决定优先级 ✅）
    //  ⭐⭐ 2026-10-16（🔴 **PnR 时序修复第 2 处：`left_hit` 搜索也拆两级**）
    //  🔴 **同源机理**：⭐ 原写法是"`for` 里带 `!left_hit` 的顺序短路搜索"（⭐ 见下 ✅）
    //     ⚠️ 综合器会把它实现成 **16 个 13 位比较 + 16 段 or 树** ✅
    //        ⚠️ 它与第 2 级（⭐ `slide_best_pos` 的 12 位比较链 ✅）**串在同一条链上** ✅
    //     ⭐ **本修法**：⭐ 写成"**先算 16 位门控向量、再折成一个 or**" ✅
    //        · ⭐ `left_cand[si] = (delta[si] < -DELTA_TH)`（⭐ 纯比较，⭐ 无依赖 ✅）
    //        · ⭐ `left_hit = |left_cand`（⭐ 一级折 or ✅）
    //     ⚠️ **这一步本身不砍链长**（⭐ 贡献的是同一组最迟输入 `delta` ✅）
    //        🔴 **真正砍掉深度的只有 `slide_cand` 那处**（见其说明 ✅）
    //     📌 **保留**：⭐ 语义**逐位不变**（⭐ `left_ax_n` 仍取**最小轴号** ✅）
    reg [AXIS_N-1:0] left_cand;    // ⭐ 每轴"是否在离开"（⭐ 纯比较，无依赖 ✅）
    //  ⭐⭐ 2026-10-16：⭐ "行程最大的同排邻居"所需的两个阻塞临时量
    //     📌 ⭐ 为什么要"行程最大"而不是"第一个形成的"：⭐ 用户裁定
    //        "滑音模式开着 ⇒ 相邻先后发生就算滑音"，而快速跨 2~3 键连甩时
    //        （⭐ 同板同排）会用"第一个形成的"把一段滑音断成多段 ✅
    reg [POS_W-1:0]  slide_best_pos; // ⭐ 当前最优 B 的行程（⭐ 用来比较）
    reg [AXIS_W-1:0] slide_best_ax;  // ⭐ 当前最优 B 的轴号（⭐ 最终给 slide_axis_b_o ✅）
    //  ⭐⭐⭐⭐ 2026-10-16（🔴 **PnR 时序修复：把 67 级组合链砍到 ~11 级**）
    //
    //  🔴 **症状**：⭐ 本轮 PnR 报 **304 条 setup 违例**、⭐ TNS −1502 ns、
    //     ⭐ 最差路径 slack **−50.033 ns**（⭐ 比 20 ns 的周期还长 3 倍 ✅）
    //     ⭐ `Logic Level = 67`（⭐ 上次基线 15.052 MHz / 67 级同源 ✅）
    //     ⭐ From = `u_axis_snapshot/prev[0]` · To = `u_event_extract/slide_*`
    //     ⇒ 🔴 **全部违例都落在【一个锥】上：`prev → Δ 加法器 → 滑音判据`** ✅
    //
    //  🔴 **机理（⭐ 静态推理，与报告逐条对得上）**：
    //     · ⭐ `axis_snapshot.delta_o = cur − prev` 是**组合**的（⭐ 见其 `:277-278`
    //        —— 为了让 `pos/delta` 与 `snap_valid` 同拍 ✅）
    //        ⇒ ⭐ **12 位减法器（逐位进位链 ~9~10 级 ALU）** 整条压在 launch 侧 ✅
    //     · ⭐ 而 2026-10-16 把滑音判据从"**第一个**形成的邻居"改成
    //        "**行程最大**的同排邻居"（⭐ `slide_best_pos` 顺序更新 ✅）
    //        ⇒ ⭐ 那 16 次迭代**每次都要做一次 12 位比较**，
    //           ⭐ 且第 k 次的比较**依赖第 k−1 次的结果**（⭐ 顺序链 ✅）
    //        ⇒ 🔴 **4 段并行 × 12 位比较（级联约 14~16 级）× 4 段串行**
    //           ⇒ **约 64 级 ALU 链** ✅（⭐ 报告实测 67 级，⭐ 差 3 级来自 `is_h_adj` ✅）
    //     ⚠️ 而上一版"**第一个**命中就 `break`"（⭐ `slide_hit` 短路 ✅）
    //        ⇒ ⭐ 比较链被 `slide_hit` 的 or 树**提前截断** ⇒ **基线才 0 违例 ✅**
    //     📌 ⇒ ⭐ **本轮改动本身只 +88 LUT / +36 DFF**（⭐ 资源几乎没涨 ✅）
    //        ⭐ 却把一条**原本被短路掩埋的**深组合链**暴露**成了最长路径 ✅
    //
    //  ⭐⭐ **修法：⭐ 拆两级（⭐ 语义【逐位不变】）**
    //     · ⭐ **第 1 级（并行）**：`sb_*` = "该轴是不是合格候选"（⭐ 纯条件，无比较 ✅）
    //        · ⭐ 三项条件**全部保持不变**：`(left_hit || left_v_r)` ·
    //           `is_h_adj(A, si)` · `delta[si] > SLIDE_START_TH` ✅
    //        · ⭐ ⛔ **去掉** `pos[si] > slide_best_pos` 那一项（⭐ 比较留到第 2 级 ✅）
    //     · ⭐ **第 2 级（顺序）**：只在**合格候选**之间做"取最大行程" ✅
    //        ⇒ ⭐ 此时 `is_h_adj` 已经**全为 0**（⭐ A 的同排邻居最多 4 个 ✅）
    //           ⇒ 🔴 **`slide_cand` 整条或链会塌缩成常量 0**
    //              ⇒ ⭐ **比较链根本不出现**（⭐ 综合器直接优化掉 ✅）
    //        ⇒ ⭐ 剩下的比较链深度 = **≤4**（⭐ 一排放 4 列 ✅）
    //        ⇒ ⭐ 总深度 ≈ **12 位减法器(~9) + 阈值比较(~2) + 取最大(≤4) + mux(~2)**
    //           ≈ **≤17 级**（⭐ 实测报告就是 67 ⇒ ⭐ **砍掉约 50 级** ✅）
    //
    //  ⭐ **为什么语义逐位不变（⭐ 可机械论证）**：
    //     · ⭐ 旧：第 k 次迭代成立 ⇔ `cand_k && (pos_k > max(pos_0..pos_{k-1} 中合格者))`
    //       ⇒ ⭐ 最终 `best` = **合格候选里 pos 最大的那个**（⭐ 同值时取**最小轴号** ✅）
    //     · ⭐ 新：第 k 次迭代成立 ⇔ `cand_k && (pos_k > max(pos_0..pos_{k-1} 中合格者))`
    //       （⭐ `slide_cand` 与旧的 `cand_k` **逐位相同** ✅）
    //     ⇒ ⭐ **同一条判定链、同一个取最大规则** ⇒ ⭐ **输出逐位相同** ✅
    //
    //  📌 **判据（⭐ 必须不退化）**：⭐ `tb/w3a/tb_event_extract_slide.sv`
    //     · ⭐ `SLIDE-1b`（⭐ B 必须是相邻轴 4 ✅）· `SLIDE-1`（⭐ 必须出滑音 ✅）
    //     · ⭐ `SLIDE-2/3/4`（⭐ 两轴都增 / 隔得远 / 只有释放 ⇒ **不许出** ✅）
    //     ⚠️ 判据②（⭐ "两轴都增" ✅）在本轮 tb 里 `SLIDE_START_TH = 4`（⭐ 64→4 ✅）
    //        ⇒ ⭐ B 侧 `delta = +192 > 4` **成立**、⭐ A 侧 `delta = −192 < −8` **成立**
    //        ⇒ ⭐ `left_hit = 1` ⇒ ⭐ **B 仍会被判成候选**（⭐ 与改动前同口径 ✅）
    //        ⇒ ⭐ 所以 `slide_valid` **仍然会抬**（⭐ 这条 tb 本来就在记录这个取舍 ✅）
    //     📌 本修法**⛔ 不改任何阈值语义**（⭐ 用户正在上板调，⛔ 不许碰 ✅）
    reg [AXIS_N-1:0] slide_cand;   // ⭐ 第 1 级：⭐ 每轴"是否合格候选"（⭐ 无比较 ✅）
    integer          si;

    //  ═══════════════════════════════════════════════════════════════════════════
    //  ⭐⭐⭐⭐ 2026-10-16（🔴 **PnR 时序修复 v2**）：三处结构性改动
    //
    //  🔴 **症状**（综合实测，`impl/gwsynthesis/Gowin2026_syn.rpt.html`）：
    //     `clk_sys` **Actual Fmax = 19.505 MHz**（约束 50 MHz）· **Logic Level = 65**
    //     · 304 条 setup 违例 · 最差路径 From `u_axis_snapshot/prev` To `u_event_extract/slide_*`
    //     ⚠️ 而 HEAD `af9f2cdb` 是 **0 违例 / 61.071 MHz / Logic Level 19**
    //     ⇒ 🔴 本轮改动把 Fmax 砍掉 **42 MHz**（T_Lut 仅 +2.6% · T_Bsram 100→100 未变
    //        ⇒ ⛔ **不是资源问题、不是拥塞问题**，就是这条链）
    //
    //  🔴 **为什么上一版"拆两级"只砍掉 2 级（67→65）**：
    //     上一版只把 `is_h_adj`/阈值比较挪出循环条件，**但第 2 级的 argmax 循环原样保留**：
    //       ```
    //       for (si...) if (slide_cand[si] && (pos_i[si] > slide_best_pos)) ...
    //       ```
    //     `slide_best_pos` 跨迭代传递 ⇒ 综合成 **16 级串联 12 位比较器**（每级 4~5 个 LUT）
    //     ⇒ ⭐ **只拆了宽度，没拆深度** ✅
    //     ⚠️ 且 `:365-366` 的推理（"`is_h_adj` 已全为 0 ⇒ `slide_cand` 塌缩成常量 0"）**不成立**：
    //        `is_h_adj(A, si)` 的 A 是**运行时寄存器** ⇒ 综合器无法静态剪枝
    //        ⇒ 16 轴 × 24 子句 = **384 个 4 位比较器必须全建** ✅
    //
    //  ✅ **本版三处改动**：
    //     ① `left_ax_n` ⇒ **树形"最低置位"编码器**（4 级，替代 16 级 mux 链）
    //        🔴 **同时修一个真 bug**：原循环丢了 `!left_hit` 短路 ⇒ 取【最大】轴号，
    //           而 HEAD 与 `:328` 注释都是【最小】轴号（判据 `tb/w3a/tb_ee_multileave.sv`）
    //     ② `is_h_adj(A, si)` ⇒ **16 位邻居掩码查表**（`adj_mask_of`）
    //        ⭐ 对固定 `si` 它只是 A 的 4 输入函数 ⇒ **1 个 LUT4**；原写法把 A 和 si
    //           都当变量 ⇒ 每个 si 都建 24 子句的完整 OR ⇒ **384 个比较器**
    //        ⇒ ⭐ 这一处同时砍**深度**和**LUT**（LUT 少了，布线也更松）✅
    //     ③ argmax ⇒ **4 级"两两合并"树**（替代 16 级比较链），语义逐位不变
    //
    //  📌 **语义不变的三条论证**：
    //     · ① 取"最小轴号" = HEAD 的 `if (!left_hit && ...)` 逐位相同（⭐ 这是**修回归**）
    //     · ② `adj_mask_of(A)` 与 `is_h_adj(A, si)` 是**同一张 12 对邻居表**（见 `:293-307`）
    //     · ③ 树形取最大：`x` 恒为低轴号侧，平局取 `x` ⇒ 与旧循环"升序 + 严格 `>`"相同
    //  📌 **判据**：`tb/w3a/tb_event_extract_slide.sv`（SLIDE-1/1b/2/3/4/5）
    //     ＋ `tb/w3a/tb_ee_multileave.sv`（同帧多轴离开 ⇒ A 取最小）
    //  ═══════════════════════════════════════════════════════════════════════════

    // ── ② 邻居掩码：`adj_mask_of(A)` = A 的【同排相邻】轴集合（16 位）────────────
    //    ⭐ 逐位与 `is_h_adj(A, si)` 等价（同一张表）：
    //       上排左 6-7-0-1 · 下排左 5-4-3-2 · 上排右 14-15-8-9 · 下排右 13-12-11-10
    //    ⭐ 每个 bit 只是 A 的 4 输入函数 ⇒ 综合成 1 个 LUT4 × 16 个（全并行、1 级）✅
    function [AXIS_N-1:0] adj_mask_of;
        input [AXIS_W-1:0] a;
        begin
            case (a)
                4'd6 : adj_mask_of = 16'h0080;   // ⭐ 邻居 7
                4'd7 : adj_mask_of = 16'h0041;   // ⭐ 邻居 6, 0
                4'd0 : adj_mask_of = 16'h0082;   // ⭐ 邻居 7, 1
                4'd1 : adj_mask_of = 16'h0001;   // ⭐ 邻居 0
                4'd5 : adj_mask_of = 16'h0010;   // ⭐ 邻居 4
                4'd4 : adj_mask_of = 16'h0028;   // ⭐ 邻居 5, 3
                4'd3 : adj_mask_of = 16'h0014;   // ⭐ 邻居 4, 2
                4'd2 : adj_mask_of = 16'h0008;   // ⭐ 邻居 3
                4'd14: adj_mask_of = 16'h8000;   // ⭐ 邻居 15
                4'd15: adj_mask_of = 16'h4100;   // ⭐ 邻居 14, 8
                4'd8 : adj_mask_of = 16'h8200;   // ⭐ 邻居 15, 9
                4'd9 : adj_mask_of = 16'h0100;   // ⭐ 邻居 8
                4'd13: adj_mask_of = 16'h1000;   // ⭐ 邻居 12
                4'd12: adj_mask_of = 16'h2800;   // ⭐ 邻居 13, 11
                4'd11: adj_mask_of = 16'h1400;   // ⭐ 邻居 12, 10
                4'd10: adj_mask_of = 16'h0800;   // ⭐ 邻居 11
                default: adj_mask_of = {AXIS_N{1'b0}};
            endcase
        end
    endfunction

    // ── ③ 树形 argmax 的合并算子：取 pos 大者；⭐ 平局取【左】（= 更小轴号）──────
    //    ⭐ 与旧循环"升序 + 严格 `>`"逐位等价（旧写法平局时保留先出现的 = 小轴号）✅
    function [POS_W+AXIS_W:0] mx_pick;
        input [POS_W+AXIS_W:0] x;      // ⭐ 低轴号侧
        input [POS_W+AXIS_W:0] y;
        begin
            if      (!x[POS_W+AXIS_W])                                mx_pick = y;
            else if (!y[POS_W+AXIS_W])                                mx_pick = x;
            else if (x[POS_W+AXIS_W-1:AXIS_W] >= y[POS_W+AXIS_W-1:AXIS_W]) mx_pick = x;
            else                                                      mx_pick = y;
        end
    endfunction

    // ── ① 树形"最低置位"编码器的中间量（4 级：16→8→4→2→1）────────────────────
    reg [AXIS_W:0] px0 [0:AXIS_N-1];   // ⭐ {命中, 轴号}
    reg [AXIS_W:0] px1 [0:7];
    reg [AXIS_W:0] px2 [0:3];
    reg [AXIS_W:0] px3 [0:1];
    // ── ② 邻居掩码的寄存器形式（⭐ v3 起不再使用；保留 `adj_mask_of` 作为对照表 ✅）──
    reg [AXIS_N-1:0] adj_mask_w;

    // ── ③ v3：A 的【同排邻居】查表（最多 2 个）────────────────────────────────
    //    ⭐ 与 `adj_mask_of` 是**同一张 12 对邻居表**，但这里直接回轴号
    //    ⭐ 返回 `{nb2_v, nb2[3:0], nb1[3:0]}`（9 位），且 **保证 `nb1 < nb2`**
    //       ⇒ ⭐ "平局取最小轴号"退化成"取 `nb1`"，⛔ 不需要再比轴号 ✅
    //    📌 4 轴一排：首尾各 1 个邻居（`nb2_v=0`）、中间各 2 个（`nb2_v=1`）✅
    function [8:0] nb_of;
        input [AXIS_W-1:0] a;
        begin
            case (a)
                4'd6 : nb_of = {1'b0, 4'd0,  4'd7 };   // ⭐ 邻居 {7}
                4'd7 : nb_of = {1'b1, 4'd6,  4'd0 };   // ⭐ 邻居 {0, 6}
                4'd0 : nb_of = {1'b1, 4'd7,  4'd1 };   // ⭐ 邻居 {1, 7}
                4'd1 : nb_of = {1'b0, 4'd0,  4'd0 };   // ⭐ 邻居 {0}
                4'd5 : nb_of = {1'b0, 4'd0,  4'd4 };   // ⭐ 邻居 {4}
                4'd4 : nb_of = {1'b1, 4'd5,  4'd3 };   // ⭐ 邻居 {3, 5}
                4'd3 : nb_of = {1'b1, 4'd4,  4'd2 };   // ⭐ 邻居 {2, 4}
                4'd2 : nb_of = {1'b0, 4'd0,  4'd3 };   // ⭐ 邻居 {3}
                4'd14: nb_of = {1'b0, 4'd0,  4'd15};   // ⭐ 邻居 {15}
                4'd15: nb_of = {1'b1, 4'd14, 4'd8 };   // ⭐ 邻居 {8, 14}
                4'd8 : nb_of = {1'b1, 4'd15, 4'd9 };   // ⭐ 邻居 {9, 15}
                4'd9 : nb_of = {1'b0, 4'd0,  4'd8 };   // ⭐ 邻居 {8}
                4'd13: nb_of = {1'b0, 4'd0,  4'd12};   // ⭐ 邻居 {12}
                4'd12: nb_of = {1'b1, 4'd13, 4'd11};   // ⭐ 邻居 {11, 13}
                4'd11: nb_of = {1'b1, 4'd12, 4'd10};   // ⭐ 邻居 {10, 12}
                4'd10: nb_of = {1'b0, 4'd0,  4'd11};   // ⭐ 邻居 {11}
                default: nb_of = 9'd0;
            endcase
        end
    endfunction

    reg [8:0]        nb_pack_w;
    reg [AXIS_W-1:0] nb1_w, nb2_w;
    reg              nb2_v_w;
    reg              gate_w;
    reg [DW-1:0]     dlt1_w, dlt2_w;
    reg [POS_W-1:0]  pos1_w, pos2_w;
    reg              hit1_w, hit2_w;

    // ── ④ v2 的树形 argmax 中间量（⭐ v3 起不再使用，保留声明避免改动面过大）──
    reg [POS_W+AXIS_W:0] mx0 [0:AXIS_N-1];   // ⭐ {命中, 行程, 轴号}
    reg [POS_W+AXIS_W:0] mx1 [0:7];
    reg [POS_W+AXIS_W:0] mx2 [0:3];
    reg [POS_W+AXIS_W:0] mx3 [0:1];
    reg [POS_W+AXIS_W:0] mx4;

    always @(posedge clk) begin
        q_push_now = 1'b0;
        if (!rst_n) begin
            for (ai = 0; ai < AXIS_N; ai = ai + 1) begin
                key_on[ai] <= 1'b0;
                refr  [ai] <= 16'd0;
            end
            q_cnt <= 0; q_wr <= 0; q_rd <= 0;
            //  ⭐⭐ 2026-10-11（⭐ 滑音）：⭐ **新寄存器必须一起复位** ✅
            //     🔴 **实测踩到**：⭐ 我第一版**漏了这三行** ⇒ ⭐ 初值是 **X**
            //        ⇒ ⭐ `SLIDE-2`（⭐ 两轴都增 ✅）**误判成滑音** ✅
            //     📌 ⭐ 教训：⭐ 加寄存器时**必须同时加复位** —— ⚠️ 否则 X 会到处传播 ✅
            left_ax_r <= {AXIS_W{1'b0}};
            left_v_r  <= 1'b0;
            left_age  <= 11'd0;
            overflow_o_r <= 1'b0;
            lost_cnt_r   <= 8'd0;
            scan_axis    <= {SAW{1'b0}};
            scanning     <= 1'b0;
            evt_valid_o      <= 1'b0;
            evt_axis_o       <= {AXIS_W{1'b0}};
            evt_kind_o       <= 2'd0;
            evt_depth_o      <= {POS_W{1'b0}};
            slide_valid_o    <= 1'b0;
            slide_axis_o     <= {AXIS_W{1'b0}};
            slide_dir_o      <= 2'sd0;
            //  ⭐⭐ 2026-10-13：⭐ **新寄存器必须一起复位** ✅（⭐ 本会话踩过这个坑 ✅）
            slide_axis_b_o   <= {AXIS_W{1'b0}};
            two_note_valid_o <= 1'b0;
            two_note_axis_a_o<= {AXIS_W{1'b0}};
            two_note_axis_b_o<= {AXIS_W{1'b0}};
        end else begin
            // ⭐ 事件默认单周期
            evt_valid_o      <= 1'b0;
            slide_valid_o    <= 1'b0;
            two_note_valid_o <= 1'b0;

            // ── ⭐ 不应期递减（⭐ 每帧减 1）─────────────────────────────────
            if (snap_valid_i) begin
                for (ai = 0; ai < AXIS_N; ai = ai + 1)
                    if (refr[ai] != 16'd0) refr[ai] <= refr[ai] - 16'd1;
            end

            // ═══════════════════════════════════════════════════════════════
            // ⭐⭐ 逐轴扫描：⭐ **多拍状态机**（⭐ 一帧内每拍处理【一个】轴）
            //
            //   ⭐⭐ **`enable_i = 0` 时【清按键状态】**（⭐ 2026-09-23 新增）
            //      🔴 **为什么必须清、⛔ 不能只是"不扫描"**：
            //         ⚠️ 若只停止扫描，⭐ `key_on[]` 会**保留脏值** ——
            //         ⭐ 而脏值正是"标定前误判的按下"（⭐ 16 个轴全是 1）
            //         ⇒ 🔴 标定完成后**它们仍然"按着"** ⇒ ⭐ **一起音就永不释放**
            //         ⇒ ⭐ **等于白锁了**。
            //      ⭐ 所以 `enable_i = 0` 时把它清零 ⇒ ⭐ 标定完成后
            //         **从"全部松开"这个干净状态开始** ✅
            //      📌 这样也**天然正确**：⭐ 标定期间没人按键（⭐ 是上电阶段）。
            //
            //   🔴 **⚠️ 踩过的坑（2026-09-23，本模块第二版）**：
            //      ⚠️ 我原来在 `for (ai...)` 里直接 `q_wr <= q_wr + 1;`
            //      ⇒ 🔴 **`for` 循环里多次非阻塞赋值【读到的都是同一个旧 `q_wr`】**
            //      ⇒ ⭐ **所有 push 写同一个位置 ⇒ 互相覆盖，只剩最后一个**
            //      （⭐ 实测：3 个轴同帧越阈 ⇒ **只吐 1 个事件**）
            //      ⭐ 这**正是"单套 `evt_*` 直接赋值"缺陷的翻版** —— ⚠️ 换汤没换药。
            //
            //   ⭐⭐ **正解 = 【一拍一个轴】的状态机**：
            //      · ⭐ 一帧 9800 拍、16 个轴 ⇒ ⭐ **每轴有 600 拍预算**（⛔ 不是性能问题）
            //      · ⭐ **每拍最多 push 1 条** ⇒ ⭐ `q_wr`/`q_cnt` 每拍只加一次

            // ⭐⭐ **使能判定：⭐ 悬空（`x`/`z`）视为【使能】**
            //   🔴🔴 **⚠️ 为什么不能用 `!enable_i`**（⭐ 2026-09-23 踩到，
            //      🔴 回归里一次挂了 3 个 tb）：
            //      ⚠️ `enable_i` 为 `x` 时，⭐ `if (!enable_i)` 在 Verilog 里
            //         **既不为真也不为假** ⇒ 🔴 **两个分支都不执行**
            //         ⇒ ⭐ **事件层彻底停摆**。
            //      ⚠️ 而**老 tb（`tb_event_extract`）不接这个新端口**
            //         ⇒ ⭐ 悬空 = `x` ⇒ 🔴 **那个 tb 直接挂掉**。
            //   ⇒ ⭐ **正解：显式判 0** —— ⭐ 只有【明确的 0】才代表"未使能"，
            //      ⭐ 而 `x`/`z`（悬空）按【使能】处理
            //      ⇒ ⭐ **不接该端口的老 tb 行为与改动前完全一致** ✅
            //   📌 与 `mcp3208_model` 的 `ovr_en_i` 恰好相反：
            //      ⭐ 那里"悬空 = 不启用"（⛔ 不能误触发**新**功能），
            //      ⭐ 这里"悬空 = 启用"（⛔ 不能让**老**用例失效）。
            //      ⭐ 两者都是**向后兼容优先**。
            if (enable_i === 1'b0) begin
                //   ⭐ 清"按住"状态 + 不应期（⭐ 见上方说明）
                //   ⚠️ 用循环逐个清（⭐ Verilog-2001 里数组不能整体赋 0）
                for (ai = 0; ai < AXIS_N; ai = ai + 1) begin
                    key_on[ai] <= 1'b0;
                    refr  [ai] <= 16'd0;
                end
                scanning <= 1'b0;
            end else begin
            //        ⇒ ⭐ **结构上不可能覆盖** ✅
            //      · ⭐ 且**天然可扩展**：⭐ 阶段 2 的"相邻对"判定只需多存一个轴的值
            // ═══════════════════════════════════════════════════════════════
            if (snap_valid_i) begin
                // ⭐ 快照到达 ⇒ ⭐ 开始本轮扫描（⭐ 从轴 0 起）
                //   ⚠️ **使能判定已在【外层】做过**（⭐ 见上方 `enable_i === 1'b0`）
                //      ⇒ ⭐ 走到这里说明**已使能** ⇒ ⭐ 直接开扫，⛔ 不再重复判
                //      （⭐ 重复判会让"悬空=使能"的口径**不一致** ⇒
                //        ⚠️ 老 tb 仍会挂 —— ⭐ 这是我第一版的错）。
                scan_axis <= 4'd0;
                scanning  <= 1'b1;
            end else if (scanning) begin
                // ⭐ 处理【当前】轴（⭐ 一拍一个）
                //   ⚠️ **`scan_axis` 是寄存器** ⇒ ⭐ 用它索引时先落成局部变量
                if (!key_on[scan_axis]) begin
                    if (pos_i[scan_axis*POS_W +: POS_W] >= TRIG_TH) begin
                        if (refr[scan_axis] == 16'd0) begin
                            key_on[scan_axis] <= 1'b1;
                            refr  [scan_axis] <= REFRACT_N[15:0];
                            // ⭐ push（⭐ 每拍至多一次 ⇒ ⛔ 不会覆盖）
                            if (q_cnt < FIFO_D[FW:0]) begin
                                q_axis [q_wr] <= scan_axis;
                                q_kind [q_wr] <= 2'd0;                              // note_on
                                q_depth[q_wr] <= pos_i[scan_axis*POS_W +: POS_W];
                                q_wr  <= q_wr + 1'b1;
                                q_push_now = 1'b1;   // ⭐ 只置标志（水位改由块末【单一写点】更新）
                            end else begin
                                overflow_o_r <= 1'b1;                                // ⭐ sticky
                                if (lost_cnt_r != 8'hFF) lost_cnt_r <= lost_cnt_r + 8'd1;
                            end
                        end
                    end
                end else begin
                    if (pos_i[scan_axis*POS_W +: POS_W] < REL_TH) begin
                        //  ⭐⭐ **2026-09-28 根因修复（A2）：状态清除与事件发布必须【原子】**
                        //  🔴 原写法：**无条件**先清 `key_on[scan_axis]`，**再**尝试 push。
                        //     若此刻 FIFO 满 ⇒ push 失败 ⇒ 🔴 **这条 `note_off` 永久丢失**
                        //     —— ⭐ 因为 off 分支的进入条件就是 `key_on==1`，
                        //        一旦清 0，**后续帧即使 `pos<REL_TH` 也再不会进入本分支**
                        //        ⇒ ⭐ **该 `note_off` 永无第二次机会**（与 on 分支相反）。
                        //     ⇒ 🔴 `note_manager` 只在收到 `KIND_OFF` 时清 gate
                        //        ⇒ **该轴 voice 永久挂音**（⭐ 用户实测"几分钟不停"）。
                        //  ✅ **修法**：与 on 分支**同构** —— ⭐ **只有推入成功才清状态**；
                        //     推入失败则**保持 `key_on=1`** ⇒ ⭐ **下一帧自动重试**
                        //     （帧率 2 kHz ⇒ 重试延迟 ≤500 µs，⛔ 不会丢音）。
                        if (q_cnt < FIFO_D[FW:0]) begin
                            q_axis [q_wr] <= scan_axis;
                            q_kind [q_wr] <= 2'd1;                                  // note_off
                            q_depth[q_wr] <= pos_i[scan_axis*POS_W +: POS_W];
                            q_wr  <= q_wr + 1'b1;
                            q_push_now = 1'b1;
                            key_on[scan_axis] <= 1'b0;                              // ⭐ 与 push 原子
                        end else begin
                            overflow_o_r <= 1'b1;
                            if (lost_cnt_r != 8'hFF) lost_cnt_r <= lost_cnt_r + 8'd1;
                        end
                    end
                end

                // ⭐ 推进扫描指针（⭐ 扫完 16 个轴就停）
                if (scan_axis == (AXIS_N - 1)) begin
                    scanning  <= 1'b0;
                    scan_axis <= 4'd0;
                end else begin
                    scan_axis <= scan_axis + 4'd1;
                end
            end   // ⭐ 关闭 `enable_i` 的 `else`（⭐ 2026-09-23 新增）
            end   // ⭐ 关闭 `if (snap_valid_i) ... else if (scanning)`

            // ── ⭐⭐ 出队：⭐ **每拍吐一个**（⭐ 与数据同拍锁存）───────────────
            //   ⚠️ **必须"出队那一拍同时锁存数据"** —— ⭐ 否则就是
            //      `K-109` 那个"valid 与 data 不同拍"的老缺陷。
            if (q_cnt != 0) begin
                evt_valid_o <= 1'b1;                      // ⭐ 与下面三个字段同一拍
                evt_axis_o  <= q_axis [q_rd];
                evt_kind_o  <= q_kind [q_rd];
                evt_depth_o <= q_depth[q_rd];
                q_rd  <= q_rd + 1'b1;
            end

            //  ═══════════════════════════════════════════════════════════════
            //  ⭐⭐ **水位 `q_cnt` 的唯一写点**（2026-09-28 根因修复，⭐ 最稳健形式）
            //
            //  🔴 **原缺陷**：push 与 drain **两处各写一次** `q_cnt`，而在**同一个
            //     `always` 块**里 ⭐ **后写覆盖先写** ⇒ 同拍既 push 又 pop 时
            //     `q_cnt` **净减 1**（真实占用不变）⇒ ⭐ **水位永久性少计**（误差只增不减）。
            //
            //  🔴 **后果**（⭐ 与用户实测完全吻合）：
            //     · **相邻轴同帧越阈** ⇒ 后一条**滞留 FIFO**，只在"下一次 push"时
            //       才吐出 ⇒ `note_off` 被推迟到下次按键 ⇒ ⭐ **听感 = 挂音，
            //       "再按一下就好"**
            //     · 若滞留的是**本次演奏最后一条** ⇒ 🔴 **永久不发 ⇒ 永久挂音**
            //     · 同帧 ≥8 轴越阈 ⇒ `q_wr` 追上 `q_rd` ⇒ **覆盖未读条目**
            //       ⇒ 🔴 **永久静默丢失，且 `overflow_o`/`lost_cnt_r` 都不置位**
            //       （⭐ `K-106`"溢出必须可见"被绕过）
            //
            //  ⭐ **修法（最稳健）**：⭐ **单一写点** —— push 只置标志，水位在块末
            //     按 `+push −pop` **一次性算出** ⇒ ⭐ **结构上不可能再失步**。
            //     （⛔ 不依赖"后写覆盖先写"的书写顺序，⛔ 不怕将来有人重排代码。）
            //  📌 已实测：相邻轴 (1,2,3) 同帧越阈 ⇒ ⭐ **3 条事件全部正确发出**
            //     （`tb/w3a/tb_ee_adj.sv`）；逐拍水位 `1→1→1→0` 与真实占用**恒等**。
            //  ⚠️ 本行必须是本块中 `q_cnt` 的**唯一**赋值。
            //  ═══════════════════════════════════════════════════════════════
            q_cnt <= q_cnt + (q_push_now ? 1'b1 : 1'b0)
                           - ((q_cnt != 0) ? 1'b1 : 1'b0);

            // ═══════════════════════════════════════════════════════════════
            // ⭐⭐ 阶段 2 预留：滑音 / 双音（🔴 **本版恒 0**）
            //
            //   ⭐ 判据（⭐ 用户 2026-09-23 定义）：
            //      · **滑音** = `dA < −DELTA_TH` 且 `dB > +DELTA_TH`
            //        ⇒ ⭐ `slide_valid_o = 1`，⭐ `slide_dir_o` 指向"行程变大"的那个轴
            //      · **双音** = 两个轴都越阈、且 `dA ≥ 0` 且 `dB ≥ 0`
            //        ⇒ ⭐ `two_note_valid_o = 1`，⭐ 两个轴号同时给出
            //   🔴 **本版恒 0** ⇒ ⚠️ 下游（`evt_merge`）接上去也**不会误触发**
            //      ⇒ ⭐ **接口预留但不改变行为**（⭐ 这正是"预留好接口"的落地方式）
            // ═══════════════════════════════════════════════════════════════
            // TODO(阶段 2): 在 snap_valid_i 那一拍扫描 (ai, ai+1) 相邻对，
            //               用 delta 判方向 ⇒ 填 slide_* / two_note_*。
            //   ⚠️ 注意：⭐ "相邻"是【硬件布局】决定的（⛔ 不是轴号相邻）
            //      ⇒ ⭐ 需要一张【邻居表】（⭐ 见 `霍尔键位-CH映射-20260923.md`）
            // ═══════════════════════════════════════════════════════════════
            // ⭐⭐⭐⭐ 2026-10-11：⭐ **滑音判据已实现**（⭐ 见 `review/滑音触发规格-20261011.md` ✅）
            //
            //  ⭐ 三个条件（⭐ 必须同时 ✅）：
            //     ① ⭐ **水平相邻** ⇒ ⭐ `is_h_adj`（⭐ 12 对的邻居表 ✅，⛔ 不是轴号相邻 ✅）
            //     ② ⭐ **一减一增** ⇒ ⭐ `dA < −DELTA_TH` ✅ ＋ ⭐ `dB > +SLIDE_START_TH`
            //        （⭐ 后者**很小** = 1.6% 行程 ⇒ ⭐ "B 刚开始形成就发声" ✅）
            //     ③ ⭐ **在窗口内** ⇒ ⭐ `left_age ≤ SLIDE_WIN` ✅
            //
            //  ⭐ 语义（⭐ 用户拍板 ✅）：
            //     · ⭐ 力度取 **A** 的（⭐ 滑音是同一个音的延续 ✅，⛔ 不是发新音 ✅）
            //     · ⭐ 中途停在两轴之间 ⇒ ⭐ **停在当前位置**（⭐ 由下游的 `pitch_upd` 通路实现 ✅）
            // ═══════════════════════════════════════════════════════════════
            if (snap_valid_i) begin
                //  ⭐⭐ 2026-10-11：⭐ **滑音开关（Z-safe）** ✅
                //     ⚠️ `slide_en_i` 不是 1（⭐ 含 0/x/z ✅）⇒ ⭐ 整个判据**不跑** ✅
                //     📌 ⭐ 这样"默认关"时**行为与改动前逐位一致** ✅
                if (slide_en_i === 1'b1) begin
                //  ⭐ 1) 找"**在离开**"的轴（⭐ `dA < −DELTA_TH` ✅）
                //     ⭐⭐ 2026-10-16 改：⭐ **16 个比较并行 + 一次折 or** ✅
                //        ⚠️ 语义**逐位不变**（⭐ `left_ax_n` 仍取**最小轴号** ✅）
                for (si = 0; si < AXIS_N; si = si + 1)
                    left_cand[si[AXIS_W-1:0]] =
                        ($signed(delta_i[si*DW +: DW]) < $signed(-DELTA_TH));
                //  ⭐⭐ 2026-10-16（🔴 时序修复 ① ＋ **修一个真 bug**）
                //     树形"最低置位"编码器（4 级：16→8→4→2→1）
                //  🔴 原写法 `for (si) if (left_cand[si]) left_ax_n = si;` 有两个问题：
                //     ① 🔴 **语义回归**：每个命中都覆盖 ⇒ 取【最大】轴号；
                //        而 HEAD（`af9f2cdb`）的 `if (!left_hit && ...)` 与 `:328` 注释
                //        都是【最小】轴号 ⇒ ⭐ 判据 `tb/w3a/tb_ee_multileave.sv` 专抓这条 ✅
                //     ② 🔴 **深度**：16 级 mux 串链
                //  ✅ 本写法：4 级"两两合并"，命中侧优先 ⇒ 取【最小】轴号
                //     ⭐ 语义与 HEAD 逐位相同（`left_hit` 也等价于 `|left_cand`）✅
                for (si = 0; si < AXIS_N; si = si + 1)
                    px0[si] = {left_cand[si[AXIS_W-1:0]], si[AXIS_W-1:0]};
                for (si = 0; si < 8; si = si + 1)
                    px1[si] = px0[2*si][AXIS_W] ? px0[2*si] : px0[2*si+1];
                for (si = 0; si < 4; si = si + 1)
                    px2[si] = px1[2*si][AXIS_W] ? px1[2*si] : px1[2*si+1];
                for (si = 0; si < 2; si = si + 1)
                    px3[si] = px2[2*si][AXIS_W] ? px2[2*si] : px2[2*si+1];
                left_hit  = px3[0][AXIS_W] | px3[1][AXIS_W];
                left_ax_n = px3[0][AXIS_W] ? px3[0][AXIS_W-1:0] : px3[1][AXIS_W-1:0];

                //  ⭐ 2) 窗口推进（⭐ 有新的"离开" ⇒ 重置年龄 ✅；⭐ 否则每帧 +1 ✅）
                if (left_hit) begin
                    left_ax_r <= left_ax_n;
                    left_v_r  <= 1'b1;
                    left_age  <= 11'd0;
                end else if (left_v_r) begin
                    if (left_age >= SLIDE_WIN[10:0])
                        left_v_r <= 1'b0;            // ⭐ 超窗 ⇒ ⭐ 不再是滑音 ✅
                    else
                        left_age <= left_age + 11'd1;
                end

                //  ⭐ 3) 找"**同排、行程最大**的邻居轴" ⇒ ⭐ 出滑音 ✅
                //  ⭐⭐ 2026-10-16（⭐ 用户裁定：滑音模式开着 ⇒ **相邻先后发生就算滑音**）：
                //     🔴 旧逻辑"第一个形成的邻居就算 B"⇒ 跨 2~3 键连甩时会【断成多段滑音】
                //        （⭐ 13→12 判一次、12→11 再判一次）⇒ 音高一跳一跳 ✅
                //     ✅ **新逻辑**：⭐ 窗口期内**每帧都更新** B = "与 A 同排、当前行程最大"的那个轴
                //        ⇒ 跨 3 键甩过去，音高目标一路跟到【最终停下的那个键】，中间不断段 ✅
                //     📌 ⭐ 下游 `slide_position_ctrl` 本来就用 `(A, B)` 两个轴做【位置插值】
                //        （⭐ `top.v:6003` `.axis_a_i(ee_slide_ax) .axis_b_i(ee_slide_b)`）⇒
                //        ⭐ B 持续更新 ⇒ 插值自然连续，⛔ 不需要额外的平滑 ✅
                //     ⚠️ ⭐ **同排**这个限制必须保留：⭐ 跨排/跨板不算一次滑音 ✅
                //  ⭐⭐⭐⭐ 2026-10-16 改：⭐ **拆两级（见上方 `slide_cand` 的说明 ✅）**
                //     · ⭐ 第 1 级：⭐ 算"合格候选"向量（⭐ 纯条件，**无 `pos` 比较** ✅）
                //     · ⭐ 第 2 级：⭐ 只在候选之间做"取最大行程"（⭐ 深度 ≤ 4 ✅）
                //  ⚠️ **语义逐位不变**：⭐ `slide_best_ax` 仍是"合格候选中 pos 最大"的那个
                //     （⭐ 同值时取**最小轴号** ✅ —— 因为循环里用严格 `>` ✅）
                //  ⭐⭐ 2026-10-16（🔴 时序修复 ②）：`is_h_adj(A, si)` ⇒ 16 位掩码查表
                //     ⭐ 对固定 `si` 它只是 A 的 4 输入函数 ⇒ 综合成 **1 个 LUT4**；
                //        原写法把 A 和 si **都当变量** ⇒ 每个 si 都建 24 子句的完整 OR
                //        ⇒ 16 轴 × 24 = **384 个 4 位比较器** ⇒ 🔴 深度与 LUT 双爆 ✅
                //     📌 语义逐位相同（`adj_mask_of` 与 `is_h_adj` 是同一张 12 对邻居表）✅
                //     ⭐ 顺带：LUT 大幅下降 ⇒ 布线拥塞也一起缓解 ✅
                //  ⭐⭐⭐⭐ 2026-10-16（🔴 时序修复 **v3**）：argmax 限定到 A 的【同排邻居】（最多 2 个）
                //
                //  🔴 **v2 实测**（综合报告）：`Logic Level 33` / `Actual Fmax 40.503 MHz`
                //     —— 比改前（67 级 / 19.505 MHz）砍掉一半，但**离 50 MHz 还差 19%**。
                //     路径 = `u_axis_snapshot/prev → 12 位减法器 → event_extract 33 级 LUT 链`。
                //     📌 顺带查清：**减法器不是瓶颈**（走专用进位链 `COUT`/`CIN`，**0.045 ns/位**
                //        ⇒ 12 位总共 ~0.5 ns）；贵的全是 event_extract 里的 LUT（每级 0.465 ns）。
                //     而 v2 的 16 路树占其中 **4 级 × (12 位比较 + mux) ≈ 16 级** ✅
                //
                //  ⭐ **本版（v3）的关键洞察**：**候选最多只有 2 个**。
                //     `slide_cand[si]` 被 `is_h_adj(A, si)` 门控，而邻居表里
                //     **每个轴最多 2 个同排邻居**（4 轴一排：首尾各 1 个、中间各 2 个）
                //     ⇒ ⭐ **直接查 A 的 2 个邻居 + 一次比较**即可，⛔ 根本不需要 16 路树 ✅
                //
                //  📌 **语义逐位不变**（可机械论证）：
                //     · 旧：候选集 = `{si : is_h_adj(A,si) && delta[si] > TH}`
                //       ⇒ ⭐ 它**恰好等于** `{nb1, nb2} ∩ {delta > TH}`
                //          （`nb_of` 与 `is_h_adj` 是**同一张 12 对邻居表**）✅
                //     · 取 pos 最大者；⭐ 平局取【最小轴号】
                //       ⇒ `nb_of` **保证 `nb1 < nb2`** ⇒ 平局直接取 `nb1` ✅
                //     · `left_hit` 侧不变（仍是"同排 + 在上升"）✅
                //  📌 **判据**：`tb/w3a/tb_event_extract_slide.sv`（SLIDE-1/1b/2/3/4/5）
                //     ＋ `tb/w3a/tb_ee_multileave.sv`（同帧多轴离开 ⇒ A 取最小）✅
                //  🔴 ⭐ 仍用【阻塞临时量】⛔ 不用 `!slide_valid_o`（⭐ 非阻塞赋值的旧坑 ✅）
                nb_pack_w = nb_of(left_hit ? left_ax_n : left_ax_r);
                nb1_w     = nb_pack_w[AXIS_W-1:0];
                nb2_w     = nb_pack_w[2*AXIS_W-1:AXIS_W];
                nb2_v_w   = nb_pack_w[2*AXIS_W];
                gate_w    = (left_hit || left_v_r);
                //  ⭐ 两个邻居的 `delta` / `pos`：16:1 mux 取（⭐ 邻居本身就是"同排"，
                //     ⛔ 不必再查掩码 —— 这一步替掉了 v2 的整个 `adj_mask` + `slide_cand` ✅）
                dlt1_w = delta_i[nb1_w*DW    +: DW];
                dlt2_w = delta_i[nb2_w*DW    +: DW];
                pos1_w = pos_i  [nb1_w*POS_W +: POS_W];
                pos2_w = pos_i  [nb2_w*POS_W +: POS_W];
                hit1_w = gate_w &&
                         ($signed(dlt1_w) > $signed({1'b0, SLIDE_START_TH}));
                hit2_w = gate_w && nb2_v_w &&
                         ($signed(dlt2_w) > $signed({1'b0, SLIDE_START_TH}));
                slide_hit = hit1_w || hit2_w;
                //  ⭐ 两个都命中 ⇒ 取 pos 大者；⭐ 平局取 `nb1`（⭐ 它恒为更小轴号 ✅）
                slide_best_ax  = (hit1_w && hit2_w) ? ((pos2_w > pos1_w) ? nb2_w : nb1_w)
                               :  hit1_w            ? nb1_w
                               :                      nb2_w;
                slide_best_pos = (slide_best_ax == nb2_w) ? pos2_w : pos1_w;
                if (slide_hit) begin
                    slide_valid_o <= 1'b1;
                    slide_axis_o  <= left_hit ? left_ax_n : left_ax_r;
                    //  ⭐⭐ B = 当前行程最大的同排邻居（⭐ 每帧更新 ⇒ 连续跟随 ✅）
                    slide_axis_b_o <= slide_best_ax;
                    //  ⭐ 方向：⭐ +1 = 向**高音轴**（⭐ 轴号大 ✅）· ⭐ −1 = 向低音轴 ✅
                    slide_dir_o   <= ((slide_best_ax > (left_hit ? left_ax_n : left_ax_r))
                                      ? 2'sd1 : -2'sd1);
                end
                end   // ⭐ 2026-10-11：⭐ 关闭 `if (slide_en_i === 1'b1)`（⭐ 滑音开关 ✅）
            end
        end
    end

    // ═══════════════════════════════════════════════════════════════════════
    // ⭐ 参数自检（与既有模块同一套路）
    //   ⚠️ 这些组合会**静默失效**，⚠️ 而且**现象极难定位**：
    //     ① `TRIG_TH <= REL_TH` ⇒ 🔴 **没有迟滞** ⇒ ⚠️ 抖动造成**反复触发/释放**
    //        （⭐ 摇杆回中弹簧振荡 ⇒ ⭐ 一次按下产生多个事件）
    //     ② `DELTA_TH <= 0` ⇒ 🔴 **滑音判据恒成立** ⇒ ⚠️ 任何微小噪声都判成滑音
    //     ③ `DW < POS_W+1` ⇒ 🔴 **增量符号错**（⭐ 与 `axis_snapshot` 同一约束）
    //     ④ `REFRACT_N == 0` ⇒ ⚠️ **不应期关闭** ⇒ ⚠️ 抖动重复触发
    // ═══════════════════════════════════════════════════════════════════════
    localparam PARAM_OK = (TRIG_TH > REL_TH) && (DELTA_TH > 0) &&
                          (DW >= (POS_W + 1)) && (REFRACT_N > 0);

    initial begin
        if (TRIG_TH <= REL_TH)
            $display("ERROR [event_extract] TRIG_TH (0x%03h) <= REL_TH (0x%03h) => NO HYSTERESIS: a bouncing contact will emit repeated on/off events. PARAM_OK=0.",
                     TRIG_TH, REL_TH);
        if (DELTA_TH <= 0)
            $display("ERROR [event_extract] DELTA_TH = %0d <= 0 => the slide test is ALWAYS true, so any noise reads as a slide. PARAM_OK=0.",
                     DELTA_TH);
        if (DW < (POS_W + 1))
            $display("ERROR [event_extract] DW = %0d < POS_W+1 = %0d => the signed delta can overflow and the sign goes WRONG. PARAM_OK=0.",
                     DW, POS_W + 1);
        if (REFRACT_N == 0)
            $display("ERROR [event_extract] REFRACT_N = 0 => the refractory window is DISABLED => contact bounce emits repeated events. PARAM_OK=0.");
        if (PARAM_OK)
            $display("NOTE [event_extract] PARAM_OK=1 (AXIS_N=%0d TRIG_TH=0x%03h REL_TH=0x%03h DELTA_TH=%0d REFRACT_N=%0d)",
                     AXIS_N, TRIG_TH, REL_TH, DELTA_TH, REFRACT_N);
    end

endmodule

`default_nettype wire
