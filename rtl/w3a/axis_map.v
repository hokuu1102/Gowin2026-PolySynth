`timescale 1ns/1ps
// ─────────────────────────────────────────────────────────────────────────────
// axis_map.v · W3a 语义层：轴位 → phase_inc
//
// ⭐ 冻结定义（`files/20-代码/代码总览图.md:195`）：
//    *"轴位 → `phase_inc`（两层表；滑音=双压插值）"*
//    ⭐ **传相位增量，⛔ 不传音名** —— ⚠️ **为了避开指数运算**：
//       ⚠️ 音名 → 频率 → 相位增量要算 `2^(n/12)`（**指数**）⇒ 大 LUT 或 DSP；
//       ⭐ 改成"**预先算好一张表、运行期只查表**" ⇒ ⭐ **零指数运算**。
//
// ⭐ 两层表（`产品形态决议清单.md` §2.4 / §七）：
//    | 层 | 输入 → 输出 | 说明 |
//    |---|---|---|
//    | **第 1 层** | `pos_i`(12bit 轴位) → `key_idx`（键位索引）| ⭐ 位置 → 键位 |
//    | **第 2 层** | `key_idx` → `phase_inc`(32bit) | ⭐ 键位 → 相位增量 |
//   ⭐ **双模式**：`mode_i` 选**哪一张第 2 层表**（键盘 / 指板）—— ⚠️ **结构相同、内容不同**。
//
// ── 🔴 本模块的【职责边界】（⛔ 改接口前先读）────────────────────────────────
//   ⭐ **本模块只做【机构】，⛔ 不管【表内容】**（2026-09-23 用户拍板）：
//     · 表内容（哪个轴对哪个音、音阶/调式、起始音）= ⚠️ **由映射表负责人填**
//     · 本模块提供**可换表**的接口 + **一张【示例表】**（⚠️ 仅为自检/变异体服务）
//   ⇒ ⭐ **换表 = 只改 `KEY_PITCH_*` 常量，⛔ 不动逻辑**。
//
// ── ⛔ 纪律 ───────────────────────────────────────────────────────────────────
//   · ⭐ **Verilog-2001**（`K-91`：⛔ 不用 SV 专有构造，否则整个模块被静默丢弃）
//   · ⭐ **同步复位、低有效**、⭐ **单时钟域 50 MHz**（冻结表 §〇 约定 1/2）
//   · ⭐ **`valid` 与数据必须同拍**（`K-109` / `U-18b ②`：⚠️ 本模块用**组合**输出保证同拍）
//   · ⛔ **输出 `phase_inc_o` 永不为 0**（⭐ `tick_inc=0` 会让音乐时钟静止，见总账 §5.1 风险 3）
// ─────────────────────────────────────────────────────────────────────────────
`default_nettype none

module axis_map #(
    // ⭐ 轴号位宽：4 = 最多 16 轴（⭐ `note_manager.AXIS_W` 现成值 ⇒ 零改动复用）
    parameter integer AXIS_W   = 4,
    // ⭐ 轴位（已标定）位宽：12bit = MCP3208 满量程
    parameter integer POS_W    = 12,
    // ⭐ 输出相位增量位宽（冻结表 §二：`PHASE_W = 32`）
    parameter integer PHASE_W  = 32,
    // ⭐ **每个轴分几段**（= 第 1 层表的分辨率）。
    //   ⚠️ 必须 ≥ 2（否则双压插值没有"相邻两键"可言）
    parameter integer N_KEY    = 16,
    // ⭐ **相邻键的相位增量比例**（Q16 定点，`2^(1/12)` ≈ 1.059463 ⇒ 1.059463 × 65536 ≈ 69433）
    //   ⭐ **半音比例**（⭐ 12 平均律）；⚠️ 换律制只改这个常数。
    parameter integer SEMITONE_Q16 = 69433,
    // ⭐ **基准相位增量**（= 键 0 的 `phase_inc`）。
    //   ⚠️ **示例值** `32'h0010_0000`（⭐ 约 122 Hz @ 48.828 kHz）——
    //      🔴 **真实值由映射表负责人填**（⛔ 本模块不规定音高）。
    parameter [PHASE_W-1:0] BASE_INC = 32'h0010_0000
) (
    input  wire                    clk,
    input  wire                    rst_n,        // ⭐ 同步复位、低有效

    // ── 输入：已标定轴位（⭐ 来自 `calib`）──────────────────────────────────
    input  wire                    pos_valid_i,  // ⭐ 与 pos_i/axis_id_i **同拍**
    input  wire [AXIS_W-1:0]       axis_id_i,    // ⭐ 轴号（= 片号×8 + 片内通道，见设计草案 §1.1）
    input  wire [POS_W-1:0]        pos_i,        // ⭐ 已标定轴位

    // ── 模式选择（第 2 层表二选一）─────────────────────────────────────────
    //   ⭐ `0` = 键盘模式（⭐ 见下 §KEYBOARD）· `1` = 指板模式（⚠️ 表内容待填）
    input  wire                    mode_i,

    // ── 输出：相位增量（⭐ **组合**输出 ⇒ 与 `phase_valid_o` 严格同拍）──────
    //   ⚠️ 为什么组合而不是寄存：⭐ 冻结表 §四 要求"事件通路低延迟且固定"，
    //      而 ⭐ **"valid 与 data 不同拍"是本项目已犯过的真缺陷**（`K-109` / `U-18b`）。
    //      ⇒ ⭐ **用组合输出从结构上消灭这一类缺陷**（⭐ 变异体 `M89` 就是守它的）。
    output wire [PHASE_W-1:0]      phase_inc_o,
    output wire                    phase_valid_o,
    output wire [AXIS_W-1:0]       axis_id_o
);

    // ═══════════════════════════════════════════════════════════════════════
    // ⭐ 第 1 层表：轴位 `pos_i` → 键位索引 `key_idx`（⚠️ 纯组合）
    //
    //   做法：把 `POS_W` 位量程**均分**成 `N_KEY` 段 ⇒ `key_idx = pos_i >> SHIFT`
    //   ⚠️ 要求 `N_KEY` 是 2 的幂（本模块用 `SHIFT` 实现，⛔ 不做除法）
    //      ⇒ ⭐ 参数自检会报 `N_KEY` 非 2 的幂（见文件末 `PARAM_OK`）
    // ═══════════════════════════════════════════════════════════════════════
    // 🔴🔴 **`SHIFT` 是【量程/N_KEY】的对数，⛔ 不是 `log2(N_KEY)`！**
    //   ⚠️ **踩过的坑（2026-09-23，本模块第三版 —— 最隐蔽的一个）**：
    //      🔴 我原来写 `SHIFT = $clog2(N_KEY)` = 4（按"16 个键 ⇒ 4 bit 索引"想当然）。
    //      ⚠️ **但那是"索引的位宽"，不是"位置量的右移数"** —— ⭐ 两者搞混了：
    //        · **段宽** = `2^POS_W / N_KEY` = `4096/16` = **256** ⇒ ⭐ **`SHIFT = log2(256) = 8`**
    //        · 而 `log2(N_KEY)=4` ⇒ 🔴 `pos=256` 得 `key_idx=16` **越过表顶**
    //          ⇒ ⭐ 被钳位成 15 ⇒ **整条量程只剩首尾两键**（实测 key_sel 恒 15）。
    //   ⭐ **正确关系**：`SHIFT = POS_W - log2(N_KEY)`（⚠️ 要求 `N_KEY` 是 2 的幂，自检已守）。
    //   📌 **教训**：⭐ **"索引位宽" ≠ "右移数"** —— 混用会**静默越界+钳位**，
    //      而 ⚠️ 钳位后的值**永远合法** ⇒ 🔴 判据不报警（⭐ 与上一个坑同族：**静默失效**）。
    localparam integer KW    = (N_KEY <= 1) ? 1 : $clog2(N_KEY);        // ⭐ 索引位宽
    localparam integer SHIFT = POS_W - KW;                              // ⭐ 右移数 = 量程/键数
    localparam integer FRAC_W = (SHIFT < 1) ? 1 : SHIFT;                // ⭐ 插值系数位宽

    // 🔴 **必须先把 `N_KEY` 落成【有宽度的向量】才能比较**（`K-91` 教训！）
    //   ⚠️ **踩过的坑（2026-09-23，本模块第一版）**：原来直接写 `N_KEY[KW-1:0]`
    //      ⇒ 🔴 **`N_KEY` 是 `integer`，Verilog-2001 ⛔ 不允许对 `integer` 参数做位选**
    //      ⇒ 实测 `N_KEY[3:0]` 求值为 **0**（⛔ 不是 16）⇒ ⭐ **钳位恒成立**
    //      ⇒ 🔴 **`key_sel` 永远 = `N_KEY-1`** ⇒ **整张表只剩最高键**（实测全输出同一值）。
    //   ⭐ 正确写法：先落成 `localparam` 向量（⭐ 与 `K-91` 修 `calib.sv` 时同一手法）。
    localparam [KW-1:0] N_KEY_V = N_KEY[KW-1:0];   // ⚠️ 此处的位选在 localparam 定宽后合法
    localparam [KW-1:0] KEY_MAX = N_KEY_V - 1'b1;

    // 🔴🔴 **`key_idx` 的位宽【必须够宽】，⛔ 不能声明成 `[KW-1:0]`**
    //   ⚠️ **踩过的坑（2026-09-23，本模块第二版 —— 比上面那个更隐蔽）**：
    //      ⭐ `pos_i[POS_W-1:SHIFT]` 是 **`POS_W-SHIFT` 位**（12-4 = **8 位**）。
    //      🔴 若把 `key_idx` 声明成 4 位 ⇒ **截断只留低 4 位** ⇒
    //      ⭐ 实测 `pos=256/512/768/1024/1280` 的 `[11:4]` = `16/32/48/64/80`
    //      ⇒ **低 4 位全是 0** ⇒ 🔴 **所有键边界都读成 key 0**（⚠️ 而 `pos<16` 时又"看着对"）。
    //   ⇒ ⭐ **正确做法：中间量用【全宽】`[POS_W-SHIFT-1:0]`，只在与 `KEY_MAX` 比较时比**。
    //   📌 **教训**：⭐ **切片表达式赋给窄向量 = 静默截断**；⚠️ 而截断后的值**仍在合法范围内**
    //      ⇒ ⛔ **钳位判据不会报警** ⇒ 🔴 **典型的静默失效**。

    // ⭐ 键位索引（**全宽**！⭐ 立即数右移 = 零延迟、零除法器）
    wire [POS_W-SHIFT-1:0] key_idx = pos_i[POS_W-1:SHIFT];

    // ═══════════════════════════════════════════════════════════════════════
    // 🔴🔴 **2026-09-26 上板实测修复：⭐ 指板模式必须用【轴号】选音，⛔ 不是【深度】！**
    //
    //   ⭐ **上板症状**（⭐ 用户实测）：⭐ **所有键按到同样深度 ⇒ 听到同一个音高**。
    //
    //   🔴 **根因**：⭐ 下面 `inc_lo` 的索引是 `key_sel`（⭐ 由 `pos_i` 算出的**深度**）
    //      ⇒ ⭐ **音高 = f(按多深)**，⚠️ 与"按的是哪个键"**完全无关**。
    //      ⚠️ 这正是本模块文件头 §205~213 自述的**已知占位**：
    //         *"⚠️ 当前实现（占位）：…暂时用'位置'在一个 4 品表上插值
    //           ⇒ ⚠️ 只能表达【一条弦】"*
    //
    //   ⭐ **正确语义**（⭐ 本模块文件 §280 早就写明，⚠️ 只是没落实）：
    //      *"⭐ 索引 = **轴号**（`adc_idx × 8 + CH`）⇒ ⭐ 由调用方用 `axis_id_i` 直接选"*
    //      · ⭐ **指板模式**：⭐ 轴号 → 音高（⭐ `fb_inc[axis_id_i]`）
    //      · ⚠️ **键盘模式**：⭐ 保留"深度选音"（⭐ 钢琴是**一个**连续键盘，
    //         深 = 音高，⭐ 语义本来就对）—— ⛔ 不改。
    //
    //   📌 **为什么指板模式要按轴号**：⭐ 四根弦 × 四品，⭐ **每根弦上同一品是不同音**
    //      （⭐ 见 §229 映射表：轴0=A2 / 轴1=A#2 / 轴2=B2 / …）
    //      ⇒ ⭐ **必须用轴号查表**，⛔ 用深度查无异于把所有键压成一根弦。
    //
    //   ⚠️ **插值怎么处理**：
    //      ⭐ `frac`（低 `SHIFT` 位）原本是"段内深度偏移"，⭐ 用于**同一条弦内相邻品**插值。
    //      ⇒ ⭐ 指板模式下**必须关掉插值**（`frac = 0`）：
    //         ⚠️ 因为相邻【轴号】是**不同弦/不同品**，⭐ 在它们之间插值**没有物理意义**
    //         （⭐ 那不是滑音，⭐ 是"跳到另一个音"）。
    //      📌 **滑音将来怎么做**：⭐ 用**同轴的连续位移**（⭐ 即 `pos_i` 在阈内变化时
    //         微调 `phase_inc`）—— ⚠️ 那是 `slide_*` 通路的活（⭐ 本版恒 0）。
    // ═══════════════════════════════════════════════════════════════════════
    //   ⭐ 指板模式：⭐ **轴号直接选表**（⭐ 轴号已是 0~15 ⇒ ⭐ 天然落在表内）
    wire [KW-1:0] fb_sel = axis_id_i[KW-1:0];
    //   ⚠️ **`sel_key` 的声明必须【晚于】`key_sel`**（⭐ Verilog 要求先声明后使用 —— `L66`）
    //      ⇒ ⭐ 见下方 `key_sel` 定义之后的 `sel_key`。

    // ═══════════════════════════════════════════════════════════════════════
    // 🔴 **上界钳位【已删除】—— 它是死代码**（2026-09-23，变异体 `M77` 查出）
    //
    //   ⚠️ 原文是：`wire [KW-1:0] key_sel = (key_idx >= N_KEY) ? KEY_MAX : key_idx[KW-1:0];`
    //      ⭐ 而变异体 `M77`（**删掉那个三元钳位**）**没有让任何 tb 变红** ——
    //      ⇒ ⭐ 这**不是测试漏保护**，而是 ⭐⭐ **那个分支【永远不可达】**：
    //
    //   ⭐ **两条独立的证明**（⚠️ 任一条都够）：
    //     ① **算式上**：⭐ `key_idx = pos_i >> SHIFT`，`SHIFT = POS_W - KW = 12 - 4 = 8`
    //        ⇒ `pos_i` 最大 `4095` ⇒ `key_idx` 最大 `4095 >> 8 = 15` = `N_KEY-1`
    //     ② **位宽上**（⭐ 更强）：⭐ `key_idx` 声明是 `[POS_W-SHIFT-1:0]` = **4 位**
    //        ⇒ ⭐ **4 位无符号的最大值就是 15** ⇒ 🔴 `key_idx >= 16` **恒为 False**
    //     ⇒ ⭐ 钳位分支**永不执行** ⇒ 删掉它**不改变任何行为**（⭐ 等价变异体）。
    //
    //   📌 **为什么它会变成死代码**：⭐ 该钳位是**早期版本**写的 ——
    //      ⚠️ 那时中间量用窄切片（`key_idx[KW-1:0]`）⇒ **曾真能越界**（见上方 105~109 行）。
    //      ⭐ 后来改成**全宽切片**修掉了截断 ⇒ ⚠️ **越界的可能性随之消失**，
    //      ⇒ 🔴 **但钳位没跟着删** ⇒ ⭐ 留下了一段"看起来在防御"的死逻辑。
    //
    //   🔴 **保留它的害处（⭐ 比"多几行"严重得多）**：
    //      ⚠️ 它会让**读代码的人以为"表顶是被钳位守住的"**，
    //      ⇒ ⭐ 而实际守住表顶的是 **`key_idx` 的位宽** —— ⚠️ **搞错了保护机制**
    //      ⇒ 🔴 **将来若有人把中间量改回窄切片，会以为"有钳位兜着"而不再检查**。
    //      📌 这正是 `K-87` 那一族：⭐ **"看起来验过了"而"实际没验"**。
    //
    //   ⭐ **删除后的正确性依据**：⭐ 由**证明 ②**（位宽）**结构性保证** ——
    //      ⚠️ 不需要运行期判断，⭐ 也⛔ 不需要额外逻辑。
    //   ⚠️ **但有个前提**：⭐ **`N_KEY` 必须是 2 的幂**（⭐ 否则 `SHIFT` 不是整数，
    //      `kw_ok` 自检会拒绝）⇒ ⭐ 见文件末 `PARAM_OK` 的 `kw_ok`。
    // ═══════════════════════════════════════════════════════════════════════
    //   ⭐ 直接取名（⭐ 无需钳位：位宽已保证 `key_idx <= N_KEY-1`）
    wire [KW-1:0] key_sel = key_idx[KW-1:0];

    //   ⭐⭐ **选表的键索引**（⭐ 2026-09-26 新增）：
    //      · ⭐ **指板模式** ⇒ `fb_sel`（**轴号**）—— ⭐ 这才是"按哪个键出哪个音"
    //      · ⭐ **键盘模式** ⇒ `key_sel`（**深度**）—— ⭐ 钢琴连续键盘，语义本来就对
    //   📌 放在这里是因为 ⚠️ **它依赖 `key_sel`** ⇒ ⭐ 必须晚于其声明（`L66`）。
    wire [KW-1:0] sel_key = mode_i ? fb_sel : key_sel;

    // ═══════════════════════════════════════════════════════════════════════
    // ⭐ 第 2 层表：`key_sel` → `phase_inc`
    //
    //   🔴 **表内容 = 映射表负责人的工作**（⛔ 本模块不规定音高）。
    //   ⭐ 本模块给出的是**机构**：`phase_inc(key) = BASE_INC × (SEMITONE_Q16/65536)^key`
    //      ⚠️ 但**运行期不做指数** —— ⭐ 改成**逐级乘 + 反复用同一个乘法器**太慢，
    //      ⇒ ⭐ 本示例用**查表**（`KEY_INC` 常量数组），⚠️ 换表只改数组。
    //
    //   ⚠️ 示例表 = **半音阶梯**（⭐ 仅为自检/变异体服务，⛔ 不是最终音高）：
    //      `KEY_INC[k] = BASE_INC × 2^(k/12)`
    // ═══════════════════════════════════════════════════════════════════════
    //   半音比例（Q16 定点）：2^(1/12) = 1.059463094 ⇒ × 65536 = 69432.6 ⇒ **69433**
    //   ⚠️ 表由 `function` 在**编译期**算（⭐ 综合器会折叠成常量 ⇒ ⛔ 无运行期开销）
    function [PHASE_W-1:0] key_inc;
        input integer k;
        integer i;
        reg [63:0] acc;      // ⭐ 64bit 中间量（⭐ 防溢出：32bit × 1.06 会丢精度）
        begin
            acc = BASE_INC;
            for (i = 0; i < k; i = i + 1)
                acc = (acc * SEMITONE_Q16) >> 16;
            key_inc = acc[PHASE_W-1:0];
        end
    endfunction

    // ⭐ **表生成：用 `initial` 在时刻 0 算好**（⛔ 不用 generate+function —— 见下方教训）
    //
    //   🔴 **踩过的坑（2026-09-23，本模块第一版）**：
    //      ⚠️ 我原来写 `generate for (gi...) assign tbl[gi] = func(gi);`
    //      ⇒ 🔴 **所有表项都得到同一个值**（实测 key0~3 全是 `0x00260dff`，而正确值应递增）。
    //      ⭐ **根因**：`function` 的参数在**连续赋值/genvar 上下文里求值不可靠** ——
    //        ⚠️ iverilog 把它当成"对同一表达式的多次引用"而非"逐实例求值"。
    //      ⇒ ⭐ **改成 `initial` 块里用循环填表**（⭐ 语义明确，且 ⭐ **仍被综合器折叠成常量 ROM**：
    //         `initial` 对 `reg` 数组赋常量 ⇒ 综合出 **常量表**，⛔ 无运行期逻辑）。
    //      📌 **教训**：⭐ **"编译期常量表"要写成 `initial` + 循环，⛔ 不要用 generate+function**。
    reg [PHASE_W-1:0] kb_inc [0:N_KEY-1];    // ⭐ 键盘模式表
    reg [PHASE_W-1:0] fb_inc [0:N_KEY-1];    // ⭐ 指板模式表

    // ⭐ 半音比例（Q16 定点）：2^(1/12) = 1.059463094 ⇒ × 65536 = 69432.6 ⇒ **69433**
    //
    //   🔴 **表内容 = 映射表负责人的工作**（⛔ 本模块不规定音高）。
    //      ⭐ 下面填的是**示例表 = 半音阶梯**（`BASE_INC × 2^(k/12)`），
    //      ⚠️ **仅为自检/变异体服务，⛔ 不是最终音高**。
    //   ⭐ **换表 = 只改下面两个任务的内容**（⛔ 不动任何选择逻辑）。
    //
    // ═══════════════════════════════════════════════════════════════════════
    // ⭐⭐ 指板模式表（`fb_inc`）—— **真实音高，2026-09-23 用户确认**
    //
    //   ⭐ 依据：`files/10-硬件/指板示意图.drawio.svg` + 用户口述
    //   ⭐ 布局（**两块板上下叠**）：
    //      | | 品1 | 品2 | 品3 | 品4 |
    //      |---|---|---|---|---|
    //      | **一弦**（右板 上排）| C4 | C#4 | D4 | D#4 |
    //      | **二弦**（右板 下排）| G3 | G#3 | A3 | A#3 |
    //      | **三弦**（左板 上排）| D3 | D#3 | E3 | F3 |
    //      | **四弦**（左板 下排）| A2 | A#2 | B2 | C3 |
    //   ⭐ **滑弦沿品方向**（同一排内 品1→品4）⇒ ⭐ **半音递增 = 等间距** ✅
    //
    //   🔴 **⚠️ 本模块输入是【单轴连续量】（每次一个 CH）** ⇒ ⭐ **"弦"由 `axis_id` 决定**：
    //      轴号 = `adc_idx × 8 + CH`（⭐ 见 `files/10-硬件/霍尔键位-CH映射-20260923.md`）
    //      ⚠️ **本模块【不知道】自己拿到的轴是哪条弦** ——
    //      ⇒ ⭐ **弦的选择由【调用方】用 `axis_id` 选表后传入**（⚠️ 见文件末 §集成说明）。
    //
    //   ⚠️ **当前实现（占位）**：本模块**只有一个 `pos_i` 输入**，
    //      ⇒ ⭐ **暂时用"位置"在一个 4 品表上插值** ⇒ ⚠️ **只能表达【一条弦】**。
    //      🔴 **真实的多弦选择需要第二层索引（轴号 → 弦/品）** ——
    //          ⚠️ **那属于"集成"阶段**（⭐ 设计草案 §三 的数据流）⇒ ⭐ 见下方 TODO。
    // ═══════════════════════════════════════════════════════════════════════

    //   ⭐ `phase_inc` 换算（⭐ 与 `top.v` 的 `INC_E5` 同一算式，已交叉验证）：
    //      `phase_inc = round(f_note / f_s × 2^32)`，`f_s = 50MHz/1024 = 48828.125 Hz`
    //      ⭐ 校验：`INC_E5 = 0x0374_D64B` ⇒ 反算 **659.25 Hz** = 标准 E5 ✅
    //
    // ═══════════════════════════════════════════════════════════════════════
    // ⭐⭐ **16 轴全表**（⭐ 2026-09-23 用户确认版）
    //
    //   ⭐ **轴号 = `adc_idx × 8 + CH`**（⭐ 依据 `霍尔键位-CH映射-20260923.md`）
    //      · 左板 `adc_idx=0`（轴 0~7）· 右板 `adc_idx=1`（轴 8~15）
    //      · 每板内：**上排 = `CH6 CH7 CH0 CH1`**（物理列 1~4）
    //                 **下排 = `CH5 CH4 CH3 CH2`**（物理列 1~4）
    //      ⇒ ⭐ **轴号【不按物理位置递增】** —— ⚠️ 这正是"必须用表、⛔ 不能用算术"的原因。
    //
    //   ⭐ 映射表（⭐ 轴号 → 音高）：
    //      | 轴 | 板 | 排 | CH | 弦 | 品 | 音 | `phase_inc` |
    //      |---|---|---|---|---|---|---|---|
    //      | 0 | 左 | 下 | 5 | 四 | 1 | `A2`  | `0x0093_A3B6` |
    //      | 1 | 左 | 下 | 4 | 四 | 2 | `A#2` | `0x009C_6B2A` |
    //      | 2 | 左 | 下 | 3 | 四 | 3 | `B2`  | `0x00A5_B841` |
    //      | 3 | 左 | 下 | 2 | 四 | 4 | `C3`  | `0x00AF_92EE` |
    //      | 4 | 左 | 上 | 6 | 三 | 1 | `D3`  | `0x00C5_1339` |
    //      | 5 | 左 | 上 | 7 | 三 | 2 | `D#3` | `0x00D0_CB35` |
    //      | 6 | 左 | 上 | 0 | 三 | 3 | `E3`  | `0x00DD_3595` |
    //      | 7 | 左 | 上 | 1 | 三 | 4 | `F3`  | `0x00EA_5CF4` |
    //      | 8 | 右 | 下 | 5 | 二 | 1 | `G3`  | `0x0107_104E` |
    //      | 9 | 右 | 下 | 4 | 二 | 2 | `G#3` | `0x0116_B4CE` |
    //      | 10 | 右 | 下 | 3 | 二 | 3 | `A3` | `0x0127_476D` |
    //      | 11 | 右 | 下 | 2 | 二 | 4 | `A#3` | `0x0138_D653` |
    //      | 12 | 右 | 上 | 6 | 一 | 1 | `C4`  | `0x015F_25DC` |
    //      | 13 | 右 | 上 | 7 | 一 | 2 | `C#4` | `0x0174_073A` |
    //      | 14 | 右 | 上 | 0 | 一 | 3 | `D4`  | `0x018A_2672` |
    //      | 15 | 右 | 上 | 1 | 一 | 4 | `D#4` | `0x01A1_966B` |
    //
    //   ⭐ **滑弦沿品方向**（同一排内 品1→品4）⇒ ⭐ **半音递增 = 等间距** ✅
    // ═══════════════════════════════════════════════════════════════════════
    //   ⭐ 常量定义（⭐ 见下方命名说明）
    //   三弦 D3 D#3 E3 F3
    //   🔴🔴 **2026-09-26 改名：⭐ 从 `FB_AXn`（轴号）改为 `FB_<音名>`**
    //      ⭐ **为什么必须改名**：⚠️ 旧名 `FB_AX7 = F3` 会让人**误以为**
    //         "轴 7 就该是 F3" ⇒ 🔴 **正是这次填错表的心理根源**。
    //      ⇒ ⭐ 改成**音名命名** ⇒ ⭐ **名字只描述"是什么音"，⛔ 不暗示"在哪个轴"**
    //         ⇒ ⚠️ 想填错都难（⭐ `L81` 同族：⭐ **让错误在名字上就暴露**）。
    //   ⭐ 频率 = `round(f / fs × 2^32)`，`fs = 50 MHz / 1024 = 48828.125 Hz`
    //
    //   ── ⭐ 四弦（左板 下排）──────────────────────────────────────────────
    localparam [PHASE_W-1:0] FB_A2   = 32'h0093_A3B6;   // A2  (110.00 Hz)
    localparam [PHASE_W-1:0] FB_As2  = 32'h009C_6B2A;   // A#2 (116.54 Hz)
    localparam [PHASE_W-1:0] FB_B2   = 32'h00A5_B841;   // B2  (123.47 Hz)
    localparam [PHASE_W-1:0] FB_C3   = 32'h00AF_92EE;   // C3  (130.81 Hz)
    //   ── ⭐ 三弦（左板 上排）──────────────────────────────────────────────
    localparam [PHASE_W-1:0] FB_D3   = 32'h00C5_1339;   // D3  (146.83 Hz)
    localparam [PHASE_W-1:0] FB_Ds3  = 32'h00D0_CB35;   // D#3 (155.56 Hz)
    localparam [PHASE_W-1:0] FB_E3   = 32'h00DD_3595;   // E3  (164.81 Hz)
    localparam [PHASE_W-1:0] FB_F3   = 32'h00EA_5CF4;   // F3  (174.61 Hz)
    //   ── ⭐ 二弦（右板 下排）──────────────────────────────────────────────
    localparam [PHASE_W-1:0] FB_G3   = 32'h0107_104E;   // G3  (196.00 Hz)
    localparam [PHASE_W-1:0] FB_Gs3  = 32'h0116_B4CE;   // G#3 (207.65 Hz)
    localparam [PHASE_W-1:0] FB_A3   = 32'h0127_476D;   // A3  (220.00 Hz)
    localparam [PHASE_W-1:0] FB_As3  = 32'h0138_D653;   // A#3 (233.08 Hz)
    //   ── ⭐ 一弦（右板 上排）──────────────────────────────────────────────
    localparam [PHASE_W-1:0] FB_C4   = 32'h015F_25DC;   // C4  (261.63 Hz)
    localparam [PHASE_W-1:0] FB_Cs4  = 32'h0174_073A;   // C#4 (277.18 Hz)
    localparam [PHASE_W-1:0] FB_D4   = 32'h018A_2672;   // D4  (293.66 Hz)
    localparam [PHASE_W-1:0] FB_Ds4  = 32'h01A1_966B;   // D#4 (311.13 Hz)

    // ═══════════════════════════════════════════════════════════════════════
    //   ⭐⭐ **键盘（钢琴）模式的音高常量 `KB_*`**（⭐ 2026-09-27 新增）
    //
    //   ⭐ **来源**：⭐ `files/10-硬件/钢琴音高映射图.drawio.svg`
    //   ⭐ **音域**：⭐ **C3(130.81) ~ C4#(277.18)**，⭐ 完整一个八度
    //   ⭐ **生成**：⭐ `build/exp/kb_map.py`（⭐ 由 MIDI 号精确算 `phase_inc`）
    //      📌 `phase_inc = round(f × 2^32 / 48828.125)`
    //   ⚠️ **⛔ 不要手改数值** —— ⭐ 改音高图后重跑脚本
    // ═══════════════════════════════════════════════════════════════════════
    localparam [PHASE_W-1:0] KB_C3   = 32'h00AF_92EE;   // C3  (130.81 Hz)
    localparam [PHASE_W-1:0] KB_Cs3  = 32'h00BA_039D;   // C#3 (138.59 Hz)
    localparam [PHASE_W-1:0] KB_D3   = 32'h00C5_1339;   // D3  (146.83 Hz)
    localparam [PHASE_W-1:0] KB_Ds3  = 32'h00D0_CB35;   // D#3 (155.56 Hz)
    localparam [PHASE_W-1:0] KB_E3   = 32'h00DD_3595;   // E3  (164.81 Hz)
    localparam [PHASE_W-1:0] KB_F3   = 32'h00EA_5CF4;   // F3  (174.61 Hz)
    localparam [PHASE_W-1:0] KB_Fs3  = 32'h00F8_4C8F;   // F#3 (185.00 Hz)
    localparam [PHASE_W-1:0] KB_G3   = 32'h0107_104E;   // G3  (196.00 Hz)
    localparam [PHASE_W-1:0] KB_Gs3  = 32'h0116_B4CE;   // G#3 (207.65 Hz)
    localparam [PHASE_W-1:0] KB_A3   = 32'h0127_476D;   // A3  (220.00 Hz)
    localparam [PHASE_W-1:0] KB_As3  = 32'h0138_D653;   // A#3 (233.08 Hz)
    localparam [PHASE_W-1:0] KB_B3   = 32'h014B_7081;   // B3  (246.94 Hz)
    localparam [PHASE_W-1:0] KB_C4   = 32'h015F_25DC;   // C4  (261.63 Hz)
    localparam [PHASE_W-1:0] KB_Cs4  = 32'h0174_073A;   // C#4 (277.18 Hz)

    integer ti;
    initial begin
        // ── ⭐⭐ **键盘模式（`kb_inc`）= 钢琴音阶 C3~C4**（⭐ 2026-09-27 实装）──
        //
        //   ⭐ **数据来源**：⭐ `files/10-硬件/钢琴音高映射图.drawio.svg`（⭐ 用户确认）
        //      · ⭐ **左边 = 左手板的左边板（片0）** · **右边 = 左手板的右边板（片1）**
        //      · ⭐ 每板 8 键：**上排 = 黑键（升号）· 下排 = 白键**
        //      · ⭐ **无对应黑键时发白键的音**（⭐ 用户 2026-09-27 明确要求）
        //        ⇒ ⭐ **E3 与 B3 各出现两次**（⭐ E#/B# 不存在，⭐ 这是正确的音乐行为）
        //   ⭐ **轴号来源**：⭐ `files/10-硬件/霍尔键位映射图.drawio.png`
        //      · ⭐ 每板内 **上排 CH = `6 7 0 1`**（物理列 1~4）
        //      · ⭐ 每板内 **下排 CH = `5 4 3 2`**（物理列 1~4）
        //      · ⭐ **轴号 = 片号 × 8 + CH** ⇒ 左板 0~7 · 右板 8~15
        //
        //   🔴 **为什么必须换掉原来的表**：⭐ 原来是 `key_inc(ti)`（半音阶梯），
        //      ⚠️ 实测**轴 0~15 全部落在 11.9~28.4 Hz**（⭐ **次声波，根本听不见**），
        //      且**每个音都偏 −47 音分**（⭐ 因为 `BASE_INC` 不是 C4）
        //      ⇒ ⭐ **钢琴模式完全不可用**（⭐ 上板实测确认）。
        //
        //   📌 **本表音域 C3(130.81) ~ C4#(277.18)**，⭐ **完整覆盖一个八度**。
        //   ⚠️ **与 `fb_inc`（指板表）是两套独立内容** —— ⭐ 本来就该不同。
        //   📌 **生成脚本**：⭐ `build/exp/kb_map.py`（⭐ 改音高图后重跑即可）。
        // ─────────────────────────────────────────────────────────────────
        //   ⭐ 音高常量（`KB_*`）见下方 localparam 区（⭐ 与 `FB_*` 并列）
        kb_inc[ 0] = KB_E3;    // E3    (164.81 Hz)  左板 上排 (列3, 无E# => 发E)
        kb_inc[ 1] = KB_Fs3;   // F3#   (185.00 Hz)  左板 上排 (列4)
        kb_inc[ 2] = KB_F3;    // F3    (174.61 Hz)  左板 下排 (列4)
        kb_inc[ 3] = KB_E3;    // E3    (164.81 Hz)  左板 下排 (列3)
        kb_inc[ 4] = KB_D3;    // D3    (146.83 Hz)  左板 下排 (列2)
        kb_inc[ 5] = KB_C3;    // C3    (130.81 Hz)  左板 下排 (列1)
        kb_inc[ 6] = KB_Cs3;   // C3#   (138.59 Hz)  左板 上排 (列1)
        kb_inc[ 7] = KB_Ds3;   // D3#   (155.56 Hz)  左板 上排 (列2)
        kb_inc[ 8] = KB_B3;    // B3    (246.94 Hz)  右板 上排 (列3, 无B# => 发B)
        kb_inc[ 9] = KB_Cs4;   // C4#   (277.18 Hz)  右板 上排 (列4)
        kb_inc[10] = KB_C4;    // C4    (261.63 Hz)  右板 下排 (列4)
        kb_inc[11] = KB_B3;    // B3    (246.94 Hz)  右板 下排 (列3)
        kb_inc[12] = KB_A3;    // A3    (220.00 Hz)  右板 下排 (列2)
        kb_inc[13] = KB_G3;    // G3    (196.00 Hz)  右板 下排 (列1)
        kb_inc[14] = KB_Gs3;   // G3#   (207.65 Hz)  右板 上排 (列1)
        kb_inc[15] = KB_As3;   // A3#   (233.08 Hz)  右板 上排 (列2)

        // ── ⭐⭐ 指板模式（`fb_inc`）= **16 轴全表**（⭐ 真实音高）──────────────
        //   ⭐ 索引 = **轴号**（`adc_idx × 8 + CH`）⇒ ⭐ 由调用方用 `axis_id_i` 直接选
        //   ⚠️ 但本模块**只有一个 `pos_i` 输入**（一次一个轴）
        //      ⇒ ⭐ **真正的"按轴选音"需要【16 轴快照】upside（⭐ 见设计草案 §三 / TODO）**
        //
        //   🔴🔴 **2026-09-26 上板实测修正：⭐ 本表原来是【按轴号升序填半音阶】，🔴 那是错的！**
        //
        //   ⭐ **上板症状**（⭐ 用户实测）：⭐ *"各键音高分开了，但是**音高不太符合直觉**"*。
        //
        //   ⭐ **根因**：⭐ 原来写 `fb_inc[k] = FB_AXk` —— ⚠️ 即"轴 0 最低音、轴 15 最高音"，⭐
        //      **完全没考虑【轴号 ↔ 物理位置】的真实对应**。
        //   🔴 而真实对应是（⭐ `霍尔键位-CH映射-20260923.md` §二，⭐ **布线决定的物理事实**）：
        //      · ⭐ 每板内 **上排 CH = `6 7 0 1`**（物理列 1~4）
        //      · ⭐ 每板内 **下排 CH = `5 4 3 2`**（物理列 1~4）
        //      ⇒ ⭐ **轴号【不是】按物理位置递增的**（⚠️ 这正是 §150 那条硬约束：
        //         *"双压插值必须按【物理列序】，⛔ 不是 CH 号序"*）。
        //
        //   ⭐⭐ **实测锚定（⭐ 决定性证据）**：
        //      ⭐ 用户提供了上板听到的**真实现状图**，⭐ 与"旧表 + 上述物理对应"**逐格吻合**：
        //      ```
        //        物理上排 (列1~4): E3  F3  A2  A#2   <= 旧表 轴6 轴7 轴0 轴1
        //        物理下排 (列1~4): D#3 D3  C3  B2    <= 旧表 轴5 轴4 轴3 轴2
        //      ```
        //      ✅ **8 格全部对上** ⇒ ⭐ **【轴号 ↔ 物理位置】的对应被实测确认**，
        //         ⛔ 不再是纸面推测 ⇒ ⭐ 可以**确定性地**重排音高表。
        //
        //   ⭐⭐ **目标**（⭐ 文档 §3.2 指板模式，⭐ 用户确认版）：
        //      · ⭐ **三弦** = 左板 **上排** ⇒ 品1~4 = `D3 D#3 E3 F3`
        //      · ⭐ **四弦** = 左板 **下排** ⇒ 品1~4 = `A2 A#2 B2 C3`
        //      · ⭐ **二弦** = 右板 **下排** ⇒ 品1~4 = `G3 G#3 A3 A#3`
        //      · ⭐ **一弦** = 右板 **上排** ⇒ 品1~4 = `C4 C#4 D4 D#4`
        //      ⇒ ⭐ **弦序：一弦在最上、四弦在最下**（⭐ 用户确认）
        //
        //   ⭐ **换算（⭐ 物理位置 → 轴号 → 音高）**：
        //      ```
        //      左板 上排: 列1=轴6 列2=轴7 列3=轴0 列4=轴1
        //                 D3     D#3    E3     F3
        //      左板 下排: 列1=轴5 列2=轴4 列3=轴3 列4=轴2
        //                 A2     A#2    B2     C3
        //      右板 上排: 列1=轴14 列2=轴15 列3=轴8 列4=轴9
        //                 C4      C#4     D4     D#4
        //      右板 下排: 列1=轴13 列2=轴12 列3=轴11 列4=轴10
        //                 G3      G#3     A3     A#3
        //      ```
        //      📌 **右板那 8 个是【按同一规律推算】的** —— ⚠️ 用户**右手板还没接线**，
        //         ⭐ 等接上后**用同样的方法实测锚定**（⛔ 别当已验证）。
        //
        //   📌 **教训**：⭐ **"轴号"是【布线序号】，⛔ 不是【物理位置序号】** ——
        //      ⚠️ 任何"按轴号顺序推物理顺序"的写法都是错的（⭐ `K-87` 同族）。
        fb_inc[0]  = FB_E3;      // 左板上排列3
        fb_inc[1]  = FB_F3;      // 左板上排列4
        fb_inc[2]  = FB_C3;      // 左板下排列4
        fb_inc[3]  = FB_B2;      // 左板下排列3
        fb_inc[4]  = FB_As2;     // 左板下排列2
        fb_inc[5]  = FB_A2;      // 左板下排列1
        fb_inc[6]  = FB_D3;      // 左板上排列1
        fb_inc[7]  = FB_Ds3;     // 左板上排列2
        fb_inc[8]  = FB_D4;      // 右板上排列3
        fb_inc[9]  = FB_Ds4;     // 右板上排列4
        fb_inc[10] = FB_As3;     // 右板下排列4
        fb_inc[11] = FB_A3;      // 右板下排列3
        fb_inc[12] = FB_Gs3;     // 右板下排列2
        fb_inc[13] = FB_G3;      // 右板下排列1
        fb_inc[14] = FB_C4;      // 右板上排列1
        fb_inc[15] = FB_Cs4;     // 右板上排列2
    end

    // ═══════════════════════════════════════════════════════════════════════
    // ⭐⭐ 双压插值（滑音的核心）—— ⚠️ **仅【键盘模式】启用**
    //
    //   ⭐ 冻结定义：*"滑音=相邻双压插值"*（`代码总览图.md:195`）
    //   ⭐ 语义：两个相邻键同时按下 ⇒ 输出**在两者之间插值**（⛔ 不是任一端点）
    //   ⚠️ 本模块的输入是**单轴连续量** ⇒ "双压"体现为**轴位落在两键边界之间**：
    //      · `pos_i` 的低 `SHIFT` 位 = 段内偏移 ⇒ ⭐ 天然就是插值系数 `frac`
    //      · `frac = 0` ⇒ 取低键；`frac = 满` ⇒ 取高键；中间 ⇒ ⭐ **线性插值**
    //   ⇒ ⭐ **本模块用【同一个乘法器】算插值**（⚠️ 不用除法器 ⇒ 延迟确定、资源省）
    //
    //   🔴🔴 **2026-09-26 修正：⭐ 指板模式必须【关掉】插值**
    //      ⚠️ 因为指板模式下 `sel_key` 是**轴号** ⇒ 相邻索引是**不同弦/不同品**
    //      ⇒ ⭐ 在它们之间插值 🔴 **没有物理意义**（那不是滑音，是跳到另一个音）。
    //      ⭐ 做法：⭐ **指板模式强制 `frac = 0`**（⭐ 用 `mode_i` 门控）。
    //      📌 **键盘模式不受影响**（⭐ 那里相邻索引确实是相邻键 ⇒ 插值语义正确）。
    // ═══════════════════════════════════════════════════════════════════════
    //   ⭐ 段内偏移 = `pos_i` 的低 `SHIFT` 位（⭐ 天然就是插值系数 `frac`）
    //      ⚠️ 指板模式：⭐ 恒 0（⭐ 见上方说明）
    wire [FRAC_W-1:0] frac = mode_i ? {FRAC_W{1'b0}} : pos_i[SHIFT-1:0];

    // ⭐ 相邻两键的相位增量
    wire [PHASE_W-1:0] inc_lo = mode_i ? fb_inc[fb_sel] : kb_inc[key_sel];
    // ⚠️ 高键 = 低键 +1，**必须钳位**（⛔ 否则顶键越界）
    //   🔴 同上方教训：⛔ **用定宽向量 `KEY_MAX` 比较**，⛔ 不要写 `N_KEY[KW-1:0]`
    wire [KW-1:0]      hi_sel = (sel_key >= KEY_MAX) ? KEY_MAX : (sel_key + 1'b1);
    wire [PHASE_W-1:0] inc_hi = mode_i ? fb_inc[hi_sel] : kb_inc[hi_sel];

    // ⭐ 线性插值：`out = lo + (hi - lo) × frac / 2^SHIFT`
    //   ⚠️ 用**移位代替除法**（⭐ `frac` 只有 `SHIFT` 位 ⇒ 除以 `2^SHIFT`）
    wire [PHASE_W-1:0] inc_delta = inc_hi - inc_lo;
    wire [PHASE_W+FRAC_W-1:0] interp_raw = inc_delta * frac;    // ⚠️ 位宽必须够（PHASE_W + FRAC_W）
    wire [PHASE_W-1:0] interp = (SHIFT < 1) ? {PHASE_W{1'b0}}
                                             : interp_raw[PHASE_W+FRAC_W-1:SHIFT];

    // ⭐ **结果**：低键 + 插值增量
    wire [PHASE_W-1:0] phase_calc = inc_lo + interp;

    // ⭐⭐ **保护：`phase_inc_o` ⛔ 永不为 0**
    //   🔴 依据：⭐ `tick_inc = 0` ⇒ 音乐时钟**静止**（总账 §5.1 风险 3）。
    //   ⚠️ 正常情况 `BASE_INC ≥ 1` 已保证；⭐ 这里再加一道**结构性护栏**，
    //      因为 ⚠️ **换表时若误填 `BASE_INC = 0`，整条链路会静默静止**。
    wire [PHASE_W-1:0] phase_safe = (phase_calc == {PHASE_W{1'b0}}) ? {{(PHASE_W-1){1'b0}}, 1'b1}
                                                                    : phase_calc;

    // ── 输出（⭐ 组合 ⇒ 与 `axis_id_o` 严格同拍）─────────────────────────────
    assign phase_inc_o   = phase_safe;
    assign phase_valid_o = pos_valid_i;      // ⭐ 直通 ⇒ 与数据同拍（⭐ 判据 4）
    assign axis_id_o     = axis_id_i;        // ⭐ 透传（下游按轴寻址）

    // ═══════════════════════════════════════════════════════════════════════
    // ⭐ 参数自检（与 `clk_gen`/`tlc5916`/`top` 的 `PARAM_OK` 同一套路）
    //   ⚠️ 为什么要有：⭐ 这些参数的**错误组合会静默失效**，且**现象极难定位**：
    //     ① `N_KEY` **非 2 的幂** ⇒ `SHIFT` 丢低位 ⇒ ⚠️ **整张表错位**（⭐ 不报错）
    //     ② `N_KEY < 2` ⇒ ⚠️ **没有"相邻两键"** ⇒ 双压插值**结构上无意义**
    //     ③ `BASE_INC = 0` ⇒ ⚠️ 输出恒 0 ⇒ **音乐时钟静止**（⭐ 已由 `phase_safe` 兜底，
    //        但**自检要报**，因为这说明表填错了）
    //     ④ `FRAC_W < 1` ⇒ 插值系数恒 0 ⇒ ⚠️ **滑音退化成"只认低键"**（⭐ 判据 3 的守护）
    // ═══════════════════════════════════════════════════════════════════════
    localparam NKEY_IS_POW2 = ((N_KEY & (N_KEY - 1)) == 0);
    localparam PARAM_OK     = (N_KEY >= 2) && NKEY_IS_POW2 && (BASE_INC != 0);

    initial begin
        if (BASE_INC == {PHASE_W{1'b0}})
            $display("ERROR [axis_map] BASE_INC = 0 => phase_inc would be 0 and the musical clock would FREEZE. Fill in the real pitch table (PARAM_OK=0).");
        if (N_KEY < 2)
            $display("ERROR [axis_map] N_KEY = %0d < 2 => there is no adjacent-key pair, so dual-press interpolation is meaningless (PARAM_OK=0).", N_KEY);
        if (!NKEY_IS_POW2)
            $display("ERROR [axis_map] N_KEY = %0d is not a power of two => the >>SHIFT index loses low bits and the whole table is misaligned (PARAM_OK=0).", N_KEY);
        if (PARAM_OK)
            $display("NOTE [axis_map] PARAM_OK=1 (AXIS_W=%0d POS_W=%0d PHASE_W=%0d N_KEY=%0d SHIFT=%0d FRAC_W=%0d)",
                     AXIS_W, POS_W, PHASE_W, N_KEY, SHIFT, FRAC_W);
    end

endmodule

`default_nettype wire
