`timescale 1ns/1ps
// ─────────────────────────────────────────────────────────────────────────────
// calib_cmd.v · 标定命令解析（⭐ 单字母 ASCII，⭐ 电脑直连 USB-TTL）
//
// ── ⭐⭐ 协议（⭐ 用户 2026-09-23 拍板 + 深夜确认）────────────────────────────
//   | 字母 | 十六进制 | 动作 | ⭐ 语义 |
//   |---|---|---|---|
//   | `'T'` | `0x54` | ⭐ **逐轴 `tare`**（全部 16 轴） | 重新记零点 = 松手位 |
//   | `'S'` | `0x53` | ⭐ **逐轴 `span`**（全部 16 轴） | 逐个按到底 ⇒ 满行程标定 |
//   | `'X'` | `0x58` | ⭐ **取消** | 中止当前标定（⭐ 任意状态可退） |
//   | `'M'` | `0x4D` | ⭐ **Test Mode 循环** | 关 → 4 → 8 → 16 → 32 → 关 |
//
//   ⭐ **谁定义了这个协议**：⭐ **FPGA 侧** —— ⚠️ ESP32 侧已明确
//      *"标定命令是你们的协议，由你们定义（⛔ 不需要问我们）"*。
//      📌 依据：`<同级>/FPGA2026-esp32/files/20-代码/ESP32侧串口命令格式-给FPGA侧-20260923.md`
//         §1.3/§1.2（⭐ 且对方已**撤回**原 `0x53` 帧头方案）。
//
//   ⚠️ **接线事实**：⭐ 标定阶段是 **PC ──USB-TTL/板载 USB-C──> FPGA**，
//      ⛔ **不经过 ESP32**（⭐ 依据同上 §1.1）。
//      ⇒ ⭐ 本模块接的是**板载 `FPGA_UART`**（`V14`/`U15`，经 `BL616` 桥到 USB-C）。
//
// ── ⭐⭐ 为什么是"单字母"而不是帧 ──────────────────────────────────────────────
//   ⭐ **不占用 `evt_uart_rx` 的帧格式**：⭐ 事件帧是 `0xA5` + 8 字节（9N 对齐），
//      ⚠️ 而单字母命令**不是 `0xA5`** ⇒ ⭐ `evt_uart_rx` 会在"第 0 字节位置"
//      判 `hdr_err` 并**留在 `idx=0` 继续等** ⇒ ⭐ **两者天然共存、⛔ 不误同步**。
//      📌 依据：`evt_uart_rx.v:175-187`（⭐ "只在第 0 字节位置看帧头"）。
//   ⚠️ **代价（⭐ 诚实说明）**：⭐ 命令会让 `evt_uart_rx.hdr_err_cnt_o` **+1**
//      ⇒ ⭐ 上板时**看到该计数上涨是正常的**（⛔ 不是故障）。
//
// ── 🔴🔴 本模块的核心难点：⭐ 命令不能与"正在跑的事件帧"交错 ────────────────────
//   ⚠️ 两个模块接**同一个** `uart_rx` 的 `rx_done_i`/`rx_data_i`
//      ⇒ ⭐ 我们必须**自己判断"这个字节是不是给我的"**。
//   ⭐ 判据：⭐ **只认"自己是一个完整帧的第 0 字节"位置的字母** ——
//      ⚠️ 但 `calib_cmd` **看不到 `evt_uart_rx` 内部的 `idx`**。
//   ⇒ ⭐ **做法**：⭐ 跟踪 `0xA5` 帧的边界（⭐ 本模块自带一个极简的同步计数器）：
//      · 见到 `0xA5` ⇒ ⭐ 进入"帧内"状态、⭐ 数 8 个后续字节
//      · ⭐ **帧内出现的 `'T'`/`'S'`/`'X'` ⇒ ⛔ 一律忽略**（⭐ 它们是**载荷**！）
//      · ⭐ **帧外**（`idx==0` 位置）出现的字母 ⇒ ✅ 才是命令
//   🔴 **为什么必须这样**：⚠️ 事件载荷里**完全可能出现** `0x54`/`0x53`/`0x58`
//      （⭐ 比如 `vel=0x54` 或 `tick` 的某个字节）
//      ⇒ 🔴 **不做边界跟踪 ⇒ 曲谱灌入时会被误当成标定命令**（⭐ 灾难性）。
//      📌 这与 `evt_uart_rx` 的"不做任意位置扫描"是**同一条纪律**。
//
//   ⭐ **空闲归位**（⭐ 自愈，⭐ 与 `evt_uart_rx` 同思路）：
//      ⚠️ 若在"帧内"长时间没有新字节 ⇒ ⭐ 强制回到"帧外"
//      ⇒ ⭐ PC 崩在半帧中间也**不会永久卡死**。
//      ⚠️ `GAP_BYTES` 必须**足够宽**（⭐ 容忍 USB/蓝牙分块投递），
//         且 ⭐ **应与 `evt_uart_rx.GAP_BYTES` 同值**（⭐ 两者对"帧"的理解要一致）。
//
// ── ⭐ 输出：单拍脉冲（⭐ 直接给下游当触发源）─────────────────────────────────
//   ⭐ `tare_req_o` → `calib_autotare.retrig_i`
//   ⭐ `span_req_o` → `calib_span.start_i`
//   ⭐ `abort_req_o` → `calib_span.abort_i`
//   ⚠️ 2026-10-03 更正：本段原来写"**三个**单拍脉冲" —— 🔴 **早就不是三个了**
//      （⭐ `P`/`V`/`N`/`M`/`R`/`L`/`C`/`I`/`B`/`D`/`K` ＋ ⭐ `P2` 的 `F`/`G`/`H`/`J`
//      ⇒ ⭐ 现在共 **18 条命令**，⭐ 其中 `'H'` 还**带一个载荷值**）✅
//      📌 逐条的语义**只写在各自的 `parameter` 声明处**（⛔ 不在此处重复维护）✅
//   ⭐ 纪律：⭐ **新命令一律做成单周期脉冲** ⇒ ⭐ 以后接推子/按键**只需产生同样的脉冲** ✅
//
// ── ⛔ 纪律（本项目血泪）──────────────────────────────────────────────────────
//   · ⭐ **Verilog-2001 语法**（`K-91`：用 SV 专有构造 ⇒ **整个模块被静默丢弃**）
//   · ⭐ **组合逻辑用 `assign`**（`L67`）
//   · ⭐ **参与算术的 wire 一律显式写位宽**（⚠️ 不写就是 1 位 ⇒ 截断）
//   · ⭐ **声明必须先于使用**（⚠️ 本项目踩过 "Unable to bind wire/reg"）
//   · ⭐ **任何"会失效"的路径都必须可观测**（`K-106`）——
//     本模块把"命令计数 / 帧内忽略 / 空闲归位"**全做成计数器**，⛔ 不静默
// ─────────────────────────────────────────────────────────────────────────────
`default_nettype none

module calib_cmd #(
    parameter integer CLK_HZ    = 50000000,   // ⭐ 50 MHz（冻结表约定 1：单时钟域）
    // ⭐ 必须与 `uart_rx.BAUD_DIV` / `evt_uart_rx.BAUD` 一致。
    //   🔴 **2026-10-01 更正：本默认值（1 Mbps）⛔ 不是实际波特率** ——
    //      ⭐ `top.v` 例化时传的是 **`500_000`**（`rtl/top.v:785` / `:831`）⇒ ⭐ **以 500000 为准**。
    //      ⚠️ 照这个默认值去配串口助手会收到**乱码、而且不报错**（`bringup/16:26`）。
    parameter integer BAUD      = 1000000,
    // ⭐ 空闲归位阈值（单位：字节时间）
    //   ⚠️ **应与 `evt_uart_rx.GAP_BYTES` 同值** —— ⭐ 两者对"帧边界"的判断要一致，
    //      否则会出现"一个认为已归位、另一个还在帧内"的**窗口错配**。
    parameter integer GAP_BYTES = 16,
    parameter [7:0]   HEADER    = 8'hA5,      // ⭐ 与 `evt_uart_rx` 同一魔数

    // ⭐⭐ 四个命令字母（⭐ 提成参数 ⇒ ⭐ tb 可改、⭐ 也便于以后换协议）
    //   🔴 2026-09-24 新增 `CMD_PROBE = 'P'` —— ⭐ **诊断用**：
    //      ⚠️ 起因：⭐ 上板跑 `'S'`（span）时**只回 `s` + `!`，⭐ 轴号只出一次**
    //      ⇒ ⭐ 需要【看到实时 `pos` 读数】才能判断"稳定判定为什么过不去"
    //      📌 设计：⭐ 发 `'P'` ⇒ ⭐ 回当前 `calib_span.cur_axis` 的
    //         **原始码（`af0_pol`，3 位十进制）**
    parameter [7:0]   CMD_TARE  = 8'h54,      // 'T'
    parameter [7:0]   CMD_SPAN  = 8'h53,      // 'S'
    parameter [7:0]   CMD_ABORT = 8'h58,      // 'X'
    parameter [7:0]   CMD_PROBE = 8'h50,      // 'P' ⭐ 诊断：⭐ 回传 pos 读数
    parameter [7:0]   CMD_VSTAT = 8'h56,      // 'V' ⭐ 诊断：⭐ 回传 span 内部状态（⭐ 2026-09-24）
    // ⭐ T43：复用板载 USB-C 串口作为 Test Mode 的实体入口。
    // 只输出一次单拍请求；4/8/16/32/关的状态机属于 top.v，避免解析器
    // 自己保留另一份模式状态而与实际音频链失去一致。
    parameter [7:0]   CMD_TEST_MODE = 8'h4D,  // 'M'
    // ⭐⭐ 2026-09-27 新增 `'N'` —— ⭐ **诊断：回传【标定后的 `pos`】**
    //   🔴 **为什么必须再加一条**（⭐ 上板实测）：
    //      · ⭐ `'P'` 回的是 `af0_pol`（⭐ **极性校正后的【原始码】**）
    //      · 🔴 而 `event_extract` 判键用的是 **`pos`（`calib` 后的行程）**
    //      ⇒ ⚠️ 看原始码**推断不出** `pos`：`pos = (raw − zero) × gain >> 8`
    //         ⭐ 而 `zero` **只在上电 `tare` 时写一次** ⇒ 🔴 基准漂移看不出来
    //   ⭐ 三个待查症状都卡在"看不到 `pos`"上：
    //      ① 挂音 —— 松手后 `pos` 能否降到 `REL_TH`(80) 以下？
    //      ② 周期性音量起伏 —— 按住时 `pos` 是否周期性变化？
    //      ③ `zero` 是否有效 —— 松手时 `pos` 应 ≈ 0（⭐ 而不是 ~2000）
    parameter [7:0]   CMD_POSPROBE = 8'h4E,  // 'N' ⭐ 诊断：回传 calib 后的 pos
    // ⭐⭐ 2026-09-29 新增：⭐ **looper 的三条命令**（⭐ `T37` / `T39`）
    //
    //   ⭐ **为什么用串口而不是按键**：
    //      · ⭐ 串口通路**已经在跑**（⭐ 上位机 / ESP32 线都通了）⇒ ⭐ **零新增硬件**
    //      · ⭐ ⛔ **不改任何已有模块的【行为】** —— ⭐ 只是**加**命令字母 ✅
    //      · ⚠️ `met_btn_i`（`AB13`）**已给节拍器**，⭐ 而 `Y12` **被 ESP32 线预定** ⇒ ⛔ 不动按键
    //      📌 这也是 `looper接口定义-20260924.md` §五 第 3 条**自己的建议** ✅
    //
    //   ⚠️ **已占用的字母**：⭐ `T`(54) `S`(53) `X`(58) `P`(50) `V`(56) `M`(4D) `N`(4E)
    //      ＋ ⭐ 帧头 `0xA5` ⇒ ⭐ 新增的三个与之**互不相同**（⭐ 由下面的查重保证）✅
    parameter [7:0]   CMD_LOOP_REC  = 8'h52,  // 'R' ⭐ looper：⭐ 录 / 停 **切换**
    parameter [7:0]   CMD_LOOP_PLAY = 8'h4C,  // 'L' ⭐ looper：⭐ 播放 **切换**
    parameter [7:0]   CMD_LOOP_CLR  = 8'h43,  // 'C' ⭐ looper：⭐ 清空该层
    //  ⭐⭐ 2026-09-29 新增：⭐ **`'I'` 切换音色**（⭐ 用户需求："之后需要有 4 个音色可以切换" ✅）
    //   ⭐ 语义：⭐ **每按一次循环下一档** `0→1→2→3→0`（⭐ 与 `'R'`/`'L'` 同一"切换"手法 ✅）
    //   ⭐ 音色定义（⭐ `wavetable_bank.v:3` 原文）：
    //      ⭐ `0=BASS triangle` · ⭐ `1=GUITAR saw` · ⭐ `2=PIANO zero-DC 25% pulse` · ⭐ `3=PAD`
    //   📌 ⭐ **为什么用串口而不是物理按键**：⭐ 见本文件顶部"控制面"说明 ——
    //      ⭐ `*_req_o` 都是**单周期脉冲** ⇒ ⭐ 以后接按键**只需产生同样的脉冲** ✅
    //      ⇒ ⭐ **控制面与来源解耦**，⭐ 换来源**不用改 `calib_cmd` 的下游** ✅
    //   ⚠️ 字母占用核对：⭐ 已用 `T S X P V M N R L C` ＋ 帧头 `A5`
    //      ⇒ ⭐ `'I'` = `0x49` **未占用** ✅（⭐ `initial` 里的查重表会机械核对 ✅）
    parameter [7:0]   CMD_TIMBRE   = 8'h49,   // 'I' ⭐ 切音色（⭐ 0→1→2→3→0 循环）
    //  ⭐⭐ 2026-09-29 合并（⭐ 用户裁定 = 方案 B）：⭐ **节拍器改走串口 `'B'`** ✅
    //   ⭐ 因为 `AB13`/S2 让给了**音色切换按键**（⭐ 队友的 `timbre_btn_i` ✅）
    //   ⭐ 语义与原来的物理按键**完全一致**：⭐ 发一次 **开**、再发一次 **关** ✅
    parameter [7:0]   CMD_METRONOME = 8'h42,   // 'B' ⭐ 节拍器 **开/关切换**
    //  ⭐⭐ 2026-09-29 新增：⭐ **`'D'` 切鼓机节奏型**（⭐ 用户需求："鼓机节奏型要能现场切" ✅）
    //   ⭐ 语义：⭐ **每按一次循环下一档** `0→1→2→3→0`（⭐ 与 `'I'`/`'R'`/`'L'` 同一"切换"手法 ✅）
    //   ⭐ 节奏型定义（⭐ `drum_gen.v:step_mask_of` 原文）：
    //      ⭐ `0=Rock 四拍基本型` · ⭐ `1=八分摇滚` · ⭐ `2=十六分放克` · ⭐ `3=圆舞曲(3/4)`
    //   🔴 **为什么必须走串口**：⚠️ 它原来是**编译期参数 `DRUM_PATTERN_ID`**
    //      ⇒ ⭐ 换一个型要**重新 PnR + 烧写**（⭐ ~10 分钟）⇒ 🔴 **4 个型没法 A/B 对比**
    //      📌 而串口通路**已经在跑** ⇒ ⭐ **零新增硬件**（⭐ 与 `'I'`/`'B'` 同一理由 ✅）
    //   ⚠️ 字母占用核对：⭐ 已用 `T S X P V M N R L C I B` ＋ 帧头 `A5`
    //      ⇒ ⭐ `'D'` = `0x44` **未占用** ✅（⭐ `initial` 里的查重表会机械核对 ✅）
    //      📌 ⚠️ **注意**：⭐ `top.v` 的**回包**里 `0x44` 是"span 全部完成"的 `'D'`
    //         —— ⚠️ 那是 **TX 方向**，⭐ 与 **RX 方向**的命令**互不相干**（⛔ 不冲突）✅
    parameter [7:0]   CMD_DRUM_PATTERN = 8'h44,  // 'D' ⭐ 鼓机节奏型 **切下一个**
    // ⭐⭐ 2026-10-01 新增：⭐ **键盘打鼓模式**（⭐ 'K' ⇒ 单周期脉冲，⭐ 与 `'D'` 同构）
    //   ⭐ **语义**：⭐ 打开后**磁轴键盘不再发音高，而是当鼓垫** ——
    //      ⭐ 按键事件按 **`axis[3:2]`**（= `axis / 4`，⛔ **不是取余**）换成 4 件乐器之一：
    //         `axis 0~3` = 嗵鼓 · `4~7` = 底鼓 · `8~11` = 军鼓 · `12~15` = 踩镲
    //      🔴 **2026-10-01 更正**：旧注释写"按 `axis % 4`" ⇒ ⚠️ **错**，
    //         实际代码是 `key_drum_sel = src_a_axis[3:2]`（`rtl/top.v`，⭐ 两位切片、零逻辑）。
    //         两者结果**完全不同**：`axis % 4` 会让"每个轴组内 4 个键各发一件鼓"，
    //         而实际是"**每 4 个相邻轴 = 同一件鼓**"。
    //   ⭐ **与 4 个音色彻底解耦**：⭐ 打鼓用**固定的** `DRUM_TIMBRE`，
    //      ⛔ 不受"当前键盘音色"影响（⭐ 与源 B 同一手法 ✅）
    //   📌 **字母占用核对**：⭐ 已用 `T S X P V M N R L C I B D` ⇒ ⭐ `'K'` = `0x4B` **未占用** ✅
    //      （⭐ `initial` 里的查重表会机械核对 ✅）
    //   ⚠️ **`top.v` 回包侧**：⭐ 本命令的回包用 **`'k'`**（⭐ 小写），
    //      ⛔ 与 RX 方向的 `'K'` **互不相干**（⭐ 与 `'D'`/`0x44` 同一情形 ✅）
    parameter [7:0]   CMD_KEYDRUM    = 8'h4B,   // 'K' ⭐ 键盘打鼓模式 **开/关切换**
    // ⭐⭐ 2026-10-03 新增（⭐ `P2`）：⭐ **T3 变调控制面的四条命令**（⭐ `F`/`G`/`H`/`J`）
    //   📌 **依据**：⭐ `files/20-代码/T3-后续计划-20261003.md` §P2 ＋
    //      ⭐ `files/00-总览/T3变调与推子功能状态机-设计定稿-20261001.md` §四（档位表）✅
    //   ⭐ **为什么走串口**：⭐ 与 `'I'`/`'D'`/`'K'` **同一条理由** ——
    //      ⭐ 串口通路**已经在跑**（⭐ PC / ESP32 两条线都通）⇒ ⭐ **零新增硬件**；
    //      ⭐ 且本模块的输出**全是单周期脉冲** ⇒ ⭐ 以后接推子/按键**只需产生同样的脉冲**
    //      （⭐ 控制面与来源解耦 —— 见本文件顶部 `'I'` 处的同一说明 ✅）
    //   ⚠️ **字母占用核对**：⭐ 已用 `T S X P V M N R L C I B D K` ＋ ⭐ 帧头 `0xA5`
    //      ⇒ ⭐ `'F'`(46) · `'G'`(47) · `'H'`(48) · `'J'`(4A) **均未占用** ✅
    //      🔴 **⛔ 不要用 `'K'`(4B)** —— ⭐ 它**已被键盘打鼓模式占用**；
    //         用户实测：`8'h4B` 在旧代码里**有 1 处命中** ⇒ ⭐ 复用它会**静默遮蔽** ✅
    //      📌 下面的 `cmd_tab` 查重会**机械核对**（⭐ 加新字母**必须**往表里加一项）✅
    //   ⭐ **语义**（⭐ 用户 2026-10-03 裁定，⛔ 不要重新论证）：
    //      · ⭐ `'F'` = **降 1 半音**（⭐ **裸字母**、⭐ **可连发**）
    //      · ⭐ `'G'` = **升 1 半音**（⭐ **裸字母**、⭐ **可连发**）
    //      · ⭐ `'H'` = **带帧绝对量**：⭐ 先发**裸 `'H'`** 把它"臂化" ⇒
    //          ⭐ **下一帧**（⭐ 复用现有 9 字节帧 = `0xA5` + 8 字节）的
    //          **第一个载荷字节**就是半音值（⭐ **编码 `0..24`**，⭐ **`12` = 不调** ✅）
    //          ⚠️ 取走后**立刻清臂** ⇒ ⭐ 一次臂化**只吃一帧**（⛔ 不会污染后面的曲谱帧）
    //      · ⭐ `'J'` = **切档**（⭐ 推子功能档位，⭐ 供 `P3` 用）
    //          ⇒ ⭐ **本模块只出脉冲**，⭐ "当前档位"由 `top.v` 用寄存器记住 ✅
    parameter [7:0]   CMD_TRANS_DOWN = 8'h46,   // 'F' ⭐ 变调：降 1 半音（⭐ 单周期脉冲）
    parameter [7:0]   CMD_TRANS_UP   = 8'h47,   // 'G' ⭐ 变调：升 1 半音（⭐ 单周期脉冲）
    parameter [7:0]   CMD_TRANS_ABS  = 8'h48,   // 'H' ⭐ 变调：带帧绝对量（⭐ 臂化 ⇒ 下一帧载荷[0]）
    parameter [7:0]   CMD_SCOPE_MODE = 8'h45,   // 'E' 切换波形/李萨如；Q 留给 BPM，B 保留节拍器
    parameter [7:0]   CMD_GEAR_NEXT  = 8'h4A,   // 'J' ⭐ 推子档位：切下一档（⭐ 供 `P3`）
    //  ⭐⭐ 2026-10-11：⭐ **'Y' = 导出录制内容**（⭐ 录制回传 ✅）
    //     📌 ⭐ 语义：⭐ 把 `looper` 该层**已录下的事件**按 9 字节帧（`0xA5` ＋ 8 字节）
    //        ⭐ 推给 `u_tx_fifo` ⇒ ⭐ `u_uart_tx_esp` ⇒ ⭐ ESP32 ⇒ BLE ⇒ PC ✅
    //     ⚠️ ⭐ **为什么用命令字母而⛔ 不是"在 ESP32 线上认一个单字节"**：
    //        🔴 曲谱帧的**载荷字节是任意的** ⇒ ⚠️ 一个裸单字节触发器
    //        **会被载荷误触发**（⭐ 例如载荷里恰好有 `0x59` ✅）
    //        ⇒ ⭐ 所以触发**必须走命令通道**（⭐ 它天然只在"帧外"接受命令 ✅）
    parameter [7:0]   CMD_RECDUMP   = 8'h59,   // 'Y' ⭐ 录制回传：导出该层已录事件
    //  ⭐⭐ 2026-10-11：⭐ **`'Q'` = 设置 BPM**（⭐ 用户要求"先加串口入口" ✅）
    //     📌 ⭐ 语义：⭐ **臂化 ＋ 下一帧载荷[0] = BPM**（⭐ 与 `'H'` 同一套路 ✅）
    //        ⭐ 40~240 只需**一个字节** ⇒ ⛔ 不用两字节 ✅
    //     📌 ⭐ 为什么不用 `'B'`（节拍器开关）带载荷：⭐ 那样会**改变 `'B'` 的既有语义**
    //        （⭐ 现在 `'B'` 无载荷 = 开/关切换 ✅）⇒ ⚠️ 会打破既有 PC 脚本 ✅
    //     📌 ⭐ 为什么 `'Q'`：⭐ 空闲字母（⭐ 已占 `T S X P V M N R L C I B D K F G H J Y` ✅）
    parameter [7:0]   CMD_BPM      = 8'h51,   // 'Q' ⭐ 设置 BPM（⭐ 臂化 ⇒ 下一帧载荷[0]）
    //  ⭐⭐ 2026-10-11：⭐ **`'W'` = 滑音开关切换** ✅
    //     📌 ⭐ 语义：⭐ 与 `'B'`（节拍器）/`'K'`（键盘打鼓）**同构** —— ⭐ **切换** ✅
    //        ⇒ ⭐ `top.v` 用寄存器记状态 ✅（⭐ ⛔ 本模块只出脉冲 ✅）
    //     📌 ⭐ **为什么需要它**（⭐ `review/滑音触发规格-20261011.md` ✅）：
    //        ⭐ 滑音判据**依赖阈值和窗口** ✅ ⇒ ⚠️ 上板调参时**必须能关掉** ✅
    //        （⭐ 否则一旦误触发，⭐ 会**静默改掉音高** 🔴 —— ⭐ `K-106` 那一类 ✅）
    //     📌 ⭐ **默认【关】** ⇒ ⭐ 行为与现在**逐位一致** ✅
    parameter [7:0]   CMD_SLIDE    = 8'h57,   // 'W' ⭐ 滑音开/关切换（⭐ 2026-10-11）
    //  ⭐⭐ 2026-10-13：⭐ **`'A'` 模式翻转（指板 ⇄ 钢琴）** ✅
    //     🔴 **为什么必须有**：⭐ 交付默认 `uart_ui.MODE_PIANO_DEFAULT = 1`（钢琴）✅
    //        ⇒ ⭐ `play_fretboard_mode = 0` ⇒ ⭐ `am_mode = 0`
    //        ⇒ ⭐ `top.v` 的滑音项 `(ee_slide_v & am_mode)` **恒 0**
    //        ⇒ 🔴 **滑音的音高更新被结构性挡死**（⭐ 实测：探测触发、音高不动 ✅）
    //     📌 ⭐ 以前只能**靠屏**切（触摸控件 0）⇒ ⭐ 没屏就没法用滑音 ✅
    //     ✅ ⭐ 本命令给出**脱离屏**的入口 ✅（⭐ 语义与屏触摸控件 0 **完全一致** ✅）
    //     ⚠️ ⭐ 字母 `'A'` 是空闲的（⭐ 已用：T S X M R L C I D F G H J Y Q W E ✅）
    parameter [7:0]   CMD_MODE_SW  = 8'h41,   // 'A' ⭐ 模式翻转 指板⇄钢琴（⭐ 2026-10-13）
    //  ⭐⭐ 2026-10-14：⭐ **`'O'` 实时上行开关**（⭐ 上行帧 v1.1 的 14 B 事件流 ✅）
    //     📌 ⭐ 为什么用 `'O'`：⭐ 空闲字母只剩 **`O`/`U`/`Z`**（⭐ 见 `串口命令总表` ✅）
    //     📌 ⭐ **默认关**（⭐ 见 `top.v` 的 `up_enable_r` 复位值）⇒ ⛔ 不灌串口、⭐ 零回归 ✅
    parameter [7:0]   CMD_UPSTREAM = 8'h4F,   // 'O' ⭐ 实时上行 开/关切换
    //  ⭐⭐ 2026-10-14：⭐ **`'U'` 指引模式开关** ✅
    //     ⭐ 语义：⭐ 灌谱**只亮 LED 指引** ＋ ⭐ **谱面对应的节拍器/鼓机照响**，
    //        🔴 **但音符不出声** ✅
    //     📌 ⭐ 为什么用 `'U'`：⭐ 空闲字母只剩 **`U`/`Z`** ✅
    //     📌 ⭐ **默认关**（⭐ `top.v` 的 `guide_only_r` 复位值 0 = 普通演奏模式）
    //        ⇒ ⛔ **零回归** ✅
    parameter [7:0]   CMD_GUIDE    = 8'h55,    // 'U' ⭐ 指引模式 开/关切换
    //  ⭐⭐ 2026-10-17（`K-106`）：⭐ **`'Z'` = 效果器状态回读**（⭐ 两级命令 ✅）
    //     📌 ⭐ 语义：⭐ `'Z' <子命令号>` ⇒ ⭐ **下一字节**是子命令号（0..7）
    //        ⭐ 由 `top.v` 把对应观测量经 `u_tx_fifo`/`u_uart_tx` 发回串口 ✅
    //     🔴 **为什么必须是"两级"而⛔ 不是"一个字母一个量"**：
    //        ⚠️ `fx_chain` 有 **7 个**可观测输出（⭐ `en_mask` / `dly_active` /
    //           `chor_active` / `dly_primed` / `dist_clip_cnt` / `trem_lfo` / `pipe`）
    //        ⚠️ 而**空闲字母只剩 `Z` 一个**（⭐ `A`~`Y` 已全占，⭐ 见 `uart_ui.v:423` 原话 ✅）
    //        ⇒ ⭐ 只能"一个字母 ＋ 一个子命令号"复用 ✅
    //     🔴 **为什么子命令号走"下一字节"而⛔ 不是"`0xA5` 帧的载荷[0]"**：
    //        ⚠️ `'H'`/`'Q'` 那种臂化要**用户先发一个字节、再灌一整帧 9 字节**
    //           ⇒ ⚠️ 一次回读要发 **10 个字节**、⭐ 且会把紧随的事件帧**吃掉一个载荷字节** ✅
    //        ⚡ 而回读是**诊断动作**（⭐ 上板时发几十次）⇒ ⭐ 要求"两个字节搞定" ✅
    //        ⚠️ **代价（⭐ 必须写清）**：⭐ 子命令字节**不享受 `0xA5` 帧的保护** ——
    //           ⭐ 它只在"帧外"被收（⭐ 与命令字母同一口径 ✅）
    //        📌 **安全性**：⭐ 清臂路径与 `'H'`/`'Q'` **完全一致**（三条，见 `fxstat_arm_q` ✅）
    //           ⇒ ⭐ 残局**不会永久挂着**吃后面的字节 ✅
    //     📌 **为什么不是 8 位全用**：⭐ 子命令号**只取低 3 位**（0..7）
    //        ⚠️ 发 8..255 ⇒ ⭐ **静默取模**（⭐ 与 `top.v` 的 `cmd_par_sel_val[2:0]` 同口径 ✅）
    //        ⚠️ **诚实标注**：⭐ 这次**不报错、不计数**（⛔ 没有越界计数器）——
    //           ⭐ 因为 `top.v` 那一侧对未知子命令号**直接不动作**（⛔ 不回包 ✅）
    //           ⇒ ⭐ "发了没反应"本身就是可观测的（⭐ 与 `'X'` 的拒绝同性质 ✅）
    parameter [7:0]   CMD_FXSTAT   = 8'h5A    // 'Z' ⭐ 效果器状态回读（⭐ 子命令 = 下一字节）
) (
    input  wire        clk_i,
    input  wire        rst_n_i,        // ⭐ 同步复位、低有效

    // ── ⭐ 来自 `uart_rx.v` 的字节流（⭐ 与 `evt_uart_rx` 同源）─────────────
    input  wire        rx_done_i,      // ⭐ 收到一个字节（单周期脉冲）
    input  wire [7:0]  rx_data_i,      // ⭐ 该字节

    // ── ⭐ 命令脉冲（⭐ 单周期）────────────────────────────────────────────
    output reg         tare_req_o,     // ⭐ 'T' ⇒ 逐轴 tare
    output reg         span_req_o,     // ⭐ 'S' ⇒ 逐轴 span
    output reg         abort_req_o,    // ⭐ 'X' ⇒ 取消
    output reg         probe_req_o,    // ⭐ 'P' ⇒ 诊断：⭐ 回传 pos 读数（⭐ 2026-09-24 新增）
    output reg         vstat_req_o,    // ⭐ 'V' ⇒ 诊断：⭐ 回传 span 状态（⭐ 2026-09-24 新增）
    output reg         posprobe_req_o, // ⭐ 'N' ⇒ 诊断：⭐ 回传 calib 后的 pos（⭐ 2026-09-27 新增）
    output reg         test_mode_req_o,// ⭐ 'M' ⇒ Test Mode 下一档（帧外才有效）
    // ⭐⭐ 2026-09-29 新增：⭐ looper 控制（⭐ 三条命令都是**单周期脉冲**）
    //   ⚠️ 录/播是"**切换**"语义 ⇒ ⭐ `top.v` 用寄存器记住状态（⭐ 与 `met_on_r` 同一手法）
    output reg         loop_rec_req_o, // ⭐ 'R' ⇒ looper 录/停切换
    output reg         loop_play_req_o,// ⭐ 'L' ⇒ looper 播放切换
    output reg         loop_clear_req_o,// ⭐ 'C' ⇒ looper 清空该层
    output reg         scope_mode_req_o,  // ⭐ 'E' ⇒ 显示模式切换（2026-10-13 命令迁移）
    output reg         timbre_req_o,    // ⭐ 'I' ⇒ 切音色（⭐ 0→1→2→3→0 循环，⭐ 2026-09-29 新增）
    output reg         met_req_o,       // ⭐ 'B' ⇒ 节拍器开/关切换（⭐ 2026-09-29 新增，方案 B）
    // ⭐⭐ 2026-09-29 新增：⭐ 鼓机节奏型切换（⭐ 'D' ⇒ 单周期脉冲）
    //   ⚠️ 与 `timbre_req_o`/`met_req_o` **同构**：⭐ "切换"语义 ⇒ ⭐ `top.v` 用寄存器记状态
    output reg         drum_pattern_req_o, // ⭐ 'D' ⇒ 鼓机节奏型 0→1→2→3→0（⭐ 2026-09-29 新增）
    // ⭐⭐ 2026-10-01 新增：⭐ 键盘打鼓模式开关（⭐ 'K' ⇒ 单周期脉冲）
    //   ⚠️ 与 `drum_pattern_req_o` **同构**：⭐ "切换"语义 ⇒ ⭐ `top.v` 用寄存器记状态 ✅
    output reg         keydrum_req_o,    // ⭐ 'K' ⇒ 键盘打鼓 **开/关切换**（⭐ 2026-10-01 新增）

    // ── ⭐⭐ 2026-10-03（`P2`）：⭐ **T3 变调控制面**（⭐ `F`/`G`/`H`/`J`）──────────
    //   ⚠️ 与 `drum_pattern_req_o`/`keydrum_req_o` **同构**：
    //      ⭐ 本模块**只出脉冲**，⭐ "当前半音值 / 当前档位"由 `top.v` 用寄存器记住 ✅
    //   📌 四个都是**单周期脉冲** ⇒ ⭐ 以后换成推子/按键**只需产生同样的脉冲** ✅
    output reg         trans_down_req_o, // ⭐ 'F' ⇒ 变调：降 1 半音
    output reg         trans_up_req_o,   // ⭐ 'G' ⇒ 变调：升 1 半音
    //   ⭐ 'H'：⭐ **脉冲 ＋ 数据** —— ⚠️ `trans_abs_val_o` 与 `trans_abs_req_o` **同拍有效**
    //      （⭐ 都在"第一个载荷字节"那一拍更新，⭐ 见下方 `idx_q == 4'd1` 段 ✅）
    output reg         trans_abs_req_o,  // ⭐ 'H' ⇒ 带帧绝对量：⭐ 值到达的那一拍
    output reg  [7:0]  trans_abs_val_o,  // ⭐ 'H' ⇒ 该帧**第一个载荷字节**（⭐ 编码 0..24）
    output reg         gear_next_req_o,  // ⭐ 'J' ⇒ 推子档位 **切下一档**（⭐ 供 `P3`）
    //  ⭐⭐ 2026-10-11：⭐ `'Y'` ⇒ **导出录制内容**（⭐ 单周期脉冲 ✅）
    output reg         recdump_req_o,    // ⭐ 'Y' ⇒ 启动"录制回传"导出
    //  ⭐⭐ 2026-10-11：⭐ **`'Q'` 设置 BPM**（⭐ 脉冲 ＋ 数据同拍 ✅，与 `'H'` 同约定 ✅）
    output reg         bpm_set_req_o,    // ⭐ 'Q' ⇒ BPM 值到达的那一拍
    output reg  [7:0]  bpm_val_o,        // ⭐ 'Q' ⇒ 该帧**第一个载荷字节**（⭐ 40~240 ✅）
    //  ⭐⭐ 2026-10-11：⭐ **`'W'` 滑音开/关切换** ✅（⭐ 与 `met_req_o` 同构 ✅）
    output reg         slide_req_o,      // ⭐ 'W' ⇒ 滑音开/关 **切换**（⭐ 单周期脉冲 ✅）
    //  ⭐⭐ 2026-10-13：⭐ `'A'` ⇒ 模式翻转（指板 ⇄ 钢琴）**切换** ✅
    //     ⚠️ 与 `slide_req_o`/`met_req_o` **同构** ⇒ `top.v` 用寄存器记状态
    output reg         mode_sw_req_o,    // ⭐ 'A' ⇒ 模式翻转（⭐ 单周期脉冲 ✅）
    //  ⭐⭐ 2026-10-14：⭐ `'O'` ⇒ **实时上行 开/关切换**（⭐ 单周期脉冲，⭐ 与 `'W'` 同构 ✅）
    output reg         upstream_req_o,
    //  ⭐⭐ 2026-10-14：⭐ `'U'` ⇒ **指引模式 开/关切换**（⭐ 单周期脉冲 ✅）
    output reg         guide_req_o,
    //  ⭐⭐ 2026-10-17：⭐ `'Z'` ⇒ **效果器状态回读**（⭐ 脉冲 ＋ 子命令号，⭐ 与 `'H'` 同约定 ✅）
    output reg         fxstat_req_o,    // ⭐ 'Z' 的子命令号到达的那一拍
    output reg  [2:0]  fxstat_sub_o,    // ⭐ 子命令号（⭐ 只取收到的字节的低 3 位 ⇒ 0..7 ✅）

    // ── ⭐ 可观测性（`K-106`：⛔ 不许静默失效）────────────────────────────
    output reg  [15:0] cmd_cnt_o,      // ⭐ 已接受的命令数（饱和）
    output reg  [15:0] in_frame_cnt_o, // ⭐ "帧内出现的命令字母"被忽略的次数（饱和）
    output reg  [15:0] resync_cnt_o,   // ⭐ 空闲归位次数（饱和）— ⚠️ 上板先看这个
    output wire [3:0]  idx_o,          // ⭐ 当前帧内位置（0 = 帧外/可收命令）
    output reg  [15:0] unknown_cnt_o   // ⚠️ 帧外收到的**非命令**字节数（⭐ 诊断用）
);

    // ── ⭐⭐ 换算成**定宽 localparam** 再参与运算 ─────────────────────────────
    //   🔴 **`K-91`：⛔ 绝不对 `integer` 参数做位选**（`GAP_I[19:0]` 这种）。
    //      ⚠️ 本项目踩过：对 `integer` 位选会让**整块索引比较静默失效**。
    //   ⭐ 正确做法：**先算 integer，再【赋值】给定宽 localparam**（⛔ 不是位选）。
    //  ⭐⭐ 2026-10-09（`P0-05`）：⭐ **`GAP_BYTES` 的单位是【字节】，⛔ 不是【位】** ✅
    //   🔴 **原缺陷**：⭐ `CLK_HZ / BAUD` 是**一个位**的时间（⭐ `BAUD` = bit/s）
    //      ⚠️ 原写 `BYTE_CLK_I = (CLK_HZ + BAUD/2) / BAUD` ⇒ ⭐ 名字叫 BYTE 但**值是 BIT**
    //      ⇒ ⭐ `GAP_CLK = 100 × 16 = 1600` 拍 = **32 µs** ⚠️ 而**一个字节**（8N1 = 10 位）
    //        在 500 kbaud 下是 **20 µs** ⇒ 🔴 **帧内容忍只有 1.6 个字节时间** ✅
    //      ⚠️ 而注释与设计意图都写"容忍 16 个字节时间（320 µs）、容忍 USB/蓝牙分块投递" ⇒ **差 10 倍** ✅
    //   🔴 **后果链（⭐ 为什么是 P0）**：⭐ `idx_q` 一旦被 >32 µs 的**帧内间隔**"空闲归位"清 0
    //      ⇒ ⭐ 剩下的载荷字节落在"帧外" ⇒ ⭐ 被当**命令** ✅
    //      ⭐ 18 个命令字母占 256 个字节值的 **7.0%**，⭐ 其中包含
    //      `'X'`（中止标定）· `'C'`（清 looper 层）· `'R'`（开始录音）· `'S'`（启动 span 标定）· `'M'`（切 Test Mode）
    //      ⇒ 🔴 **一次分块投递就能在演奏中途静默启动一次标定 / 清掉一层 loop** ✅
    //      （⭐ 这正是本模块存在的唯一理由 —— ⭐ 它自己 :39-42 写的"灾难性" ✅）
    //   📌 **触发条件（⭐ 诚实标注）**：⭐ 主机一次连续 `write()` 写完 9 字节 ⇒ ⭐ 桥芯片背靠背发
    //      ⇒ ⚠️ 帧内间隔 ≈ 0 ⇒ **不触发**；⭐ 但主机**分两次写**（`write(header)` + `write(payload)`）、
    //      逐字节写的脚本、⭐ 或 **USB-CDC 的 1 ms 帧边界**插进来 ⇒ ⭐ 间隔 **1 ms ≫ 32 µs** ⇒ 🔴 **必触发** ✅
    //   ✅ **修法**：⭐ 拆成"位时间"与"字节时间"两个量（⭐ 一个字节 = 10 位：1 起始 + 8 数据 + 1 停止）✅
    //      📌 位宽复核：⭐ 320 µs = **16000 拍** < `2^20−1` ⇒ ⭐ `[19:0] GAP_CLK` 够用 ✅
    //      ⚠️ **必须同步 `evt_uart_rx.v` 的同一公式**（⭐ 否则一个认为已归位、另一个还在帧内 ⇒ 窗口错配）✅
    localparam integer BIT_CLK_I  = (CLK_HZ + BAUD/2) / BAUD;   // ⭐ 【位】时间（⭐ 四舍五入）
    localparam integer BYTE_CLK_I = BIT_CLK_I * 10;             // ⭐ 【字节】时间 = 10 位（8N1）
    localparam integer GAP_CLK_I  = BYTE_CLK_I * GAP_BYTES;     // ⭐ 16 字节 = 320 µs
    localparam [19:0]  GAP_CLK    = GAP_CLK_I;                  // ⭐ 赋值 ⇒ 自动截断
    localparam [3:0]   IDX_LAST   = 4'd8;                       // ⭐ 8 字节载荷

    // ── 状态 ───────────────────────────────────────────────────────────────
    //   ⭐ `idx_q` 语义与 `evt_uart_rx` **刻意保持一致**：
    //      0 = 帧外（⭐ 命令只能在这里被接受）；1..8 = 帧内第 N 个载荷字节
    reg [3:0]  idx_q;
    reg [19:0] idle_q;

    //   ⭐⭐ 2026-10-03（`P2`）：⭐ **`'H'` 的"臂化"标志**（⭐ 带帧绝对量的核心）
    //      ⭐ 语义：⭐ 帧外收到**裸 `'H'`** ⇒ 置 1 ⇒
    //         ⭐ **下一帧的第一个载荷字节**（`idx_q == 4'd1`）被取走当半音值 ⇒ ⭐ 取走后**立刻清 0**
    //      🔴 **为什么必须"一次性"**：⭐ 若臂一直挂着 ⇒
    //         ⚠️ 后面每一帧的第一个载荷字节都会被当半音值
    //         ⇒ 🔴 **曲谱灌入时变调值被乱改**（⭐ 与"帧内字母不触发"同一类灾难）✅
    //      ⭐ 另外两条清臂路径：⭐ 复位 · ⭐ 空闲归位（⭐ 半帧作废 ⇒ 臂一起作废，⛔ 不留悬空状态）✅
    reg abs_arm_q;
    //  ⭐⭐ 2026-10-11：⭐ **`'Q'` 的臂化标志**（⭐ 与 `abs_arm_q` 同一套路 ✅）
    //     📌 ⭐ 为什么必须是【独立的】标志：⭐ 若与 `'H'` 共用一个 ⇒
    //        🔴 发 `'Q'` 之后紧跟的**普通事件帧**（⭐ 曲谱 ✅）会被当成 BPM
    //        ⇒ ⭐ **曲谱一灌进来就把 BPM 改乱** ✅（⭐ 与 `abs_arm_q` 的注释同一灾难 ✅）
    reg bpm_arm_q;
    //  ⭐⭐ 2026-10-17：⭐ **`'Z'` 的臂化标志**（⭐ "下一字节是子命令号" ✅）
    //     ⚠️ 为什么**必须独立**（⛔ 不能与 `abs_arm_q`/`bpm_arm_q` 共用）：
    //        🔴 三者** downstream 语义完全不同**（⭐ 半音 / BPM / 效果器状态）
    //        ⚠️ 共用一个 ⇒ 发 `'Z'` 紧跟一帧 ⇒ 🔴 那帧的载荷[0] 被当成**半音值**
    //           （⭐ `abs_arm_q` 的灾难原样复制一遍 ✅）
    //     📌 **三条清臂路径**（⛔ 缺一就会永久挂着 ⇒ 静默吃掉后面的字节）：
    //        ① ⭐ 子命令号取到 ⇒ 立即清（⭐ 一次臂只吃一字节 ✅）
    //        ② ⭐ 帧外收到**别的字节** ⇒ 清（⭐ 承诺被打破 ✅）
    //        ③ ⭐ 空闲归位 ⇒ 清（⭐ 半帧作废 ⇒ 臂一起作废 ✅）
    //     ⚠️ 另外：⭐ 帧外收到**任何命令字母**（⭐ 包括 `'Z'` 自己）⇒ 也清
    //        （⭐ 与上面第 ② 条同一个分支 ✅ ⇒ ⭐ `'Z'``'Z'` 连发 = 第二次重新臂化 ✅）
    reg fxstat_arm_q;

    assign idx_o = idx_q;

    // ⭐ 空闲是否已达阈值
    wire idle_expired = (idle_q >= GAP_CLK);

    // ⭐ 本字节是不是帧头
    wire byte_is_header = (rx_data_i == HEADER);

    // ⭐⭐ 四个命令字母的比对（⭐ 组合）
    wire byte_is_tare  = (rx_data_i == CMD_TARE);
    wire byte_is_span  = (rx_data_i == CMD_SPAN);
    wire byte_is_abort = (rx_data_i == CMD_ABORT);
    wire byte_is_probe = (rx_data_i == CMD_PROBE);   // ⭐ 'P' 诊断（⭐ 2026-09-24）
    wire byte_is_vstat = (rx_data_i == CMD_VSTAT);   // ⭐ 'V' 诊断（⭐ 2026-09-24）
    wire byte_is_posprobe = (rx_data_i == CMD_POSPROBE); // ⭐ 'N' 诊断（⭐ 2026-09-27）
    wire byte_is_test_mode = (rx_data_i == CMD_TEST_MODE); // ⭐ 'M' Test Mode
    // ⭐ 2026-09-29：looper 三条（⭐ 'R' / 'L' / 'C'）
    wire byte_is_loop_rec  = (rx_data_i == CMD_LOOP_REC);
    wire byte_is_loop_play = (rx_data_i == CMD_LOOP_PLAY);
    wire byte_is_loop_clr  = (rx_data_i == CMD_LOOP_CLR);
    // ⭐ 2026-09-29：⭐ 切音色（⭐ 'I'）
    wire byte_is_timbre    = (rx_data_i == CMD_TIMBRE);
    wire byte_is_scope     = (rx_data_i == CMD_SCOPE_MODE);   // ⭐ 'E'
    // ⭐⭐ 2026-09-29：⭐ 节拍器开/关（⭐ 'B'）—— 方案 B：⭐ `AB13`/S2 让给音色按键 ✅
    wire byte_is_met       = (rx_data_i == CMD_METRONOME);
    // ⭐⭐ 2026-09-29：⭐ 鼓机节奏型（⭐ 'D'）
    wire byte_is_drum_pat  = (rx_data_i == CMD_DRUM_PATTERN);
    // ⭐⭐ 2026-10-01：⭐ 键盘打鼓模式（⭐ 'K'）
    wire byte_is_keydrum   = (rx_data_i == CMD_KEYDRUM);
    // ⭐⭐ 2026-10-03（`P2`）：⭐ **T3 变调控制面**（⭐ 'F' / 'G' / 'H' / 'J'）
    wire byte_is_trans_down = (rx_data_i == CMD_TRANS_DOWN);
    wire byte_is_trans_up   = (rx_data_i == CMD_TRANS_UP);
    wire byte_is_trans_abs  = (rx_data_i == CMD_TRANS_ABS);
    wire byte_is_gear_next  = (rx_data_i == CMD_GEAR_NEXT);
    //  ⭐⭐ 2026-10-11：⭐ `'Y'`（⭐ 录制回传 ✅）
    wire byte_is_recdump    = (rx_data_i == CMD_RECDUMP);
    //  ⭐⭐ 2026-10-11：⭐ **`'Q'` 设置 BPM** ✅
    wire byte_is_bpm        = (rx_data_i == CMD_BPM);
    //  ⭐⭐ 2026-10-11：⭐ **`'W'` 滑音开关** ✅
    wire byte_is_slide      = (rx_data_i == CMD_SLIDE);
    wire byte_is_mode_sw    = (rx_data_i == CMD_MODE_SW);   // 2026-10-13 'A' 模式翻转
    //  📌 ⭐ **2026-10-15 修**：⭐ 本行原来顶格（`lead=0`），⭐ 而邻居全是 4 空格
    //     ⇒ ⭐ 就是 `上板问题清单-20261013.md` 的 **P6④**（⭐ 那里记的行号 535 已漂到 385）
    //     ⚠️ **为什么当初没抓到**：⭐ 用 PowerShell 的 `Get-Content` 读**无 BOM 的
    //        UTF-8 中文 `.v`** 时按 GBK 解码 ⇒ 🔴 **非 ASCII 序列吃掉换行、行被合并**
    //        （⭐ 项目 `C72` 记的就是这个）⇒ ⚠️ 行号全错、看不出来 ✅
    //     ✅ **正确读法**：`[IO.File]::ReadAllLines(...)` 或 `read` 工具 ✅
    //  ⭐⭐ 2026-10-14：⭐ **`'O'` 实时上行开关** ✅
    wire byte_is_upstream   = (rx_data_i == CMD_UPSTREAM);
    //  ⭐⭐ 2026-10-14：⭐ **`'U'` 指引模式开关** ✅
    wire byte_is_guide      = (rx_data_i == CMD_GUIDE);
    //  ⭐⭐ 2026-10-17：⭐ **`'Z'` 效果器状态回读** ✅
    wire byte_is_fxstat     = (rx_data_i == CMD_FXSTAT);
    // ⭐ 任一命令字母
    wire byte_is_cmd   = byte_is_tare | byte_is_span | byte_is_abort |
                         byte_is_probe | byte_is_vstat | byte_is_posprobe |
                         byte_is_test_mode |
                         byte_is_loop_rec | byte_is_loop_play | byte_is_loop_clr |
                         byte_is_timbre | byte_is_scope | byte_is_met | byte_is_drum_pat |
                         byte_is_keydrum |
                         byte_is_bpm |        // ⭐ 2026-10-11：'Q' 设置 BPM
                         byte_is_slide |      // ⭐ 2026-10-11：'W' 滑音开关
                         // ⭐ 2026-10-03（`P2`）：⭐ 四个新字母**必须**在这里 ⇒
                         //   ⚠️ 否则**帧内出现它们时 `in_frame_cnt_o` 不计数**
                         //      ⇒ 🔴 "边界跟踪在工作"的**证据就没了**（`K-106` 静默失效）
                         byte_is_trans_down | byte_is_trans_up |
                         byte_is_trans_abs | byte_is_gear_next |
                         //  ⭐ 2026-10-11：⭐ `'Y'`（⭐ 录制回传）⭐ **同样必须在这里** ✅
                         //     ⚠️ 漏了 ⇒ 🔴 帧内出现 `0x59` 时 `in_frame_cnt_o` 不计数
                         //        ⇒ ⭐ "边界跟踪在工作"的证据就没了（⭐ 同上面那条 ✅）
                         byte_is_recdump |
                         //  ⭐⭐ 2026-10-14：⭐ **`'O'`（实时上行）同样必须在这里** ✅
                         //     🔴 漏了 ⇒ ⭐ 帧内出现 `0x4F` 时 `in_frame_cnt_o` 不计数
                         //        ⇒ ⭐ "边界跟踪在工作"的证据就没了（⭐ 同上面两条 ✅）
                         byte_is_upstream |
                         //  ⭐⭐ 2026-10-14：⭐ **`'U'`（指引模式）同样必须在这里** ✅
                         byte_is_guide |
                         //  ⭐⭐ 2026-10-13：⭐ **`'A'`（模式翻转）必须在这里** ✅
                         //     🔴🔴 **这就是上板"发 `A` 不回 `a`、模式也不变"的根因** ✅
                         //        ⚠️ 我加了下面 `:547` 那个"出脉冲"的分支，
                         //        ⛔ **却忘了把它加进本总闸** ⇒ ⭐ `'A'` **连"命令"都不算**
                         //        ⇒ 🔴 `cmd_cnt_o` 不加、`mode_sw_req_o` 不出脉冲 ✅
                         //     📌 与 `:380-382` / `:385-387` 那两条**同一个坑**（⭐ 已是第三次）✅
                         //     ✅ 判据：`tb/w3a/tb_calib_cmd.sv` 的 `'A'` 段（⭐ 2026-10-13 补）✅
                         byte_is_mode_sw;

    // ⭐ 只有在**帧外**（`idx_q == 0`）才认命令
    //   🔴 这是本模块的**安全核心** —— ⚠️ 帧内的字母是**载荷**，⛔ 绝不能当命令
    //   ⭐ 实现方式：⭐ 靠 `if (idx_q == 4'd0) ... else ...` 的**结构**保证，
    //      ⛔ **不是**靠一个 `cmd_here` 门控（⚠️ 我曾写过那样的 wire 但**没接**，
    //      结果是**死代码** —— ⭐ 变异测试实测：把它改掉**没有任何 tb 变红**）。
    //   📌 教训：⭐ **声明了没用的信号 = 纯噪声**，⚠️ 还会让人误以为它是守卫。

    // ⭐ 饱和自增（⚠️ ⛔ 不许回绕 —— 回绕会让"溢出"看起来像"刚清零"）
    function [15:0] sat_inc16;
        input [15:0] v;
        begin
            sat_inc16 = (v == 16'hFFFF) ? 16'hFFFF : (v + 16'd1);
        end
    endfunction

    // ── ⭐ 空闲计时器（⭐ 收到字节就清零，否则涨到阈值就停）──────────────────
    always @(posedge clk_i) begin
        if (!rst_n_i) begin
            idle_q <= 20'd0;
        end else if (rx_done_i) begin
            idle_q <= 20'd0;
        end else if (!idle_expired) begin
            idle_q <= idle_q + 20'd1;
        end
    end

    // ── ⭐ 主逻辑 ──────────────────────────────────────────────────────────
    always @(posedge clk_i) begin
        if (!rst_n_i) begin
            idx_q          <= 4'd0;
            tare_req_o     <= 1'b0;
            span_req_o     <= 1'b0;
            abort_req_o    <= 1'b0;
            probe_req_o    <= 1'b0;     // ⭐ 'P' 诊断（⭐ 2026-09-24）
            vstat_req_o    <= 1'b0;     // ⭐ 'V' 诊断（⭐ 2026-09-24）
            posprobe_req_o <= 1'b0;     // ⭐ 'N' 诊断（⭐ 2026-09-27）
            test_mode_req_o<= 1'b0;     // ⭐ 'M' Test Mode
            loop_rec_req_o <= 1'b0;     // ⭐ 'R' looper 录/停（⭐ 2026-09-29）
            loop_play_req_o<= 1'b0;     // ⭐ 'L' looper 播放切换
            loop_clear_req_o<= 1'b0;    // ⭐ 'C' looper 清空
            timbre_req_o   <= 1'b0;     // ⭐ 'I' 切音色（⭐ 2026-09-29）
            scope_mode_req_o <= 1'b0;   // ⭐ 'E'
            met_req_o      <= 1'b0;     // ⭐ 'B' 节拍器开/关（⭐ 2026-09-29）
            drum_pattern_req_o <= 1'b0; // ⭐ 'D' 鼓机节奏型（⭐ 2026-09-29）
            keydrum_req_o  <= 1'b0;     // ⭐ 'K' 键盘打鼓模式（⭐ 2026-10-01）
            trans_down_req_o <= 1'b0;   // ⭐ 'F' 变调降半音（⭐ 2026-10-03 · P2）
            trans_up_req_o   <= 1'b0;   // ⭐ 'G' 变调升半音（⭐ 2026-10-03 · P2）
            trans_abs_req_o  <= 1'b0;   // ⭐ 'H' 带帧绝对量（⭐ 2026-10-03 · P2）
            trans_abs_val_o  <= 8'd0;   // ⭐ 'H' 的载荷值（⭐ 2026-10-03 · P2）
            gear_next_req_o  <= 1'b0;   // ⭐ 'J' 切档（⭐ 2026-10-03 · P2）
            recdump_req_o    <= 1'b0;   // ⭐ 'Y' 录制回传导出（⭐ 2026-10-11）
            bpm_set_req_o    <= 1'b0;   // ⭐ 'Q' 设置 BPM（⭐ 2026-10-11）
            slide_req_o      <= 1'b0;   // ⭐ 'W' 滑音开关（⭐ 2026-10-11）
        mode_sw_req_o    <= 1'b0;   // ⭐ 'A' 模式翻转（⭐ 2026-10-13）
        upstream_req_o   <= 1'b0;   // ⭐ 'O' 实时上行开关（⭐ 2026-10-14）
        guide_req_o      <= 1'b0;   // ⭐ 'U' 指引模式开关（⭐ 2026-10-14）
        fxstat_req_o     <= 1'b0;   // ⭐ 'Z' 效果器状态回读（⭐ 2026-10-17）
            bpm_val_o        <= 8'd0;   // ⭐ 'Q' 的载荷值
            bpm_arm_q        <= 1'b0;   // ⭐ 'Q' 臂化标志
            abs_arm_q        <= 1'b0;   // ⭐ 'H' 臂化标志（⭐ 2026-10-03 · P2）
            fxstat_arm_q     <= 1'b0;   // ⭐ 'Z' 臂化标志（⭐ 2026-10-17）
            cmd_cnt_o      <= 16'd0;
            in_frame_cnt_o <= 16'd0;
            resync_cnt_o   <= 16'd0;
            unknown_cnt_o  <= 16'd0;
        end else begin
            // ⭐ 默认：脉冲类输出**每拍清零** ⇒ 严格单周期
            tare_req_o  <= 1'b0;
            span_req_o  <= 1'b0;
            abort_req_o <= 1'b0;
            probe_req_o <= 1'b0;        // ⭐ 'P' 诊断（⭐ 2026-09-24）
            vstat_req_o <= 1'b0;        // ⭐ 'V' 诊断（⭐ 2026-09-24）
            posprobe_req_o <= 1'b0;     // ⭐ 'N' 诊断（⭐ 2026-09-27）
            test_mode_req_o <= 1'b0;    // ⭐ 'M' Test Mode
            loop_rec_req_o  <= 1'b0;    // ⭐ 'R'（⭐ 2026-09-29）
            loop_play_req_o <= 1'b0;    // ⭐ 'L'
            loop_clear_req_o<= 1'b0;    // ⭐ 'C'
            timbre_req_o    <= 1'b0;    // ⭐ 'I'（⭐ 2026-09-29）
            scope_mode_req_o <= 1'b0;   // ⭐ 'E'
            met_req_o       <= 1'b0;    // ⭐ 'B'（⭐ 2026-09-29）
            drum_pattern_req_o <= 1'b0; // ⭐ 'D'（⭐ 2026-09-29）
            keydrum_req_o      <= 1'b0; // ⭐ 'K'（⭐ 2026-10-01）
            trans_down_req_o   <= 1'b0; // ⭐ 'F'（⭐ 2026-10-03 · P2）
            trans_up_req_o     <= 1'b0; // ⭐ 'G'（⭐ 2026-10-03 · P2）
            trans_abs_req_o    <= 1'b0; // ⭐ 'H'（⭐ 2026-10-03 · P2）
            //  ⭐⭐ 2026-10-11：⭐ **`'Q'` 也必须【每拍清零】** ——
            //     🔴 **实测踩到**：⭐ 我只加了复位分支、⭐ 漏了这一行
            //        ⇒ ⭐ `bpm_set_req_o` **一直为高** ⇒ ⭐ tb 的监视器**每拍都数** ✅
            //     📌 ⭐ 教训：⭐ 本模块的**每个脉冲输出**都必须在**两处**出现
            //        （⭐ 复位 ✅ ＋ ⭐ 每拍默认清零 ✅）—— ⚠️ 漏一处就变成"电平" ✅
            bpm_set_req_o      <= 1'b0; // ⭐ 'Q'（⭐ 2026-10-11）
            slide_req_o        <= 1'b0; // ⭐ 'W'（⭐ 2026-10-11）
        mode_sw_req_o      <= 1'b0; // ⭐ 'A'（⭐ 2026-10-13）
        upstream_req_o     <= 1'b0; // ⭐ 'O' 实时上行（⭐ 2026-10-14）
        guide_req_o        <= 1'b0; // ⭐ 'U' 指引模式（⭐ 2026-10-14）
        fxstat_req_o       <= 1'b0; // ⭐ 'Z' 效果器状态回读（⭐ 2026-10-17）
            gear_next_req_o    <= 1'b0; // ⭐ 'J'（⭐ 2026-10-03 · P2）
            recdump_req_o      <= 1'b0; // ⭐ 'Y' 录制回传导出（⭐ 2026-10-11）
            //   ⚠️ `trans_abs_val_o` **刻意不在这里清零** ——
            //      ⭐ 它是**数据**（⛔ 不是脉冲）：⭐ 清掉会让"值保持到下一帧"这个
            //      ⚠️ 隐含契约失效；⭐ 且清零会产生**无谓的翻转**（⭐ 上板看不出区别，
            //      ⚠️ 但会让 `trans_abs_val_o` 在脉冲之外**忽 0 忽值**）✅

            if (rx_done_i) begin
                // ══ 收到一个字节 ═══════════════════════════════════════════
                if (idx_q == 4'd0) begin
                    // ---- ⭐ 帧外：这里**只可能**是帧头或命令 ---------------
                    if (byte_is_header) begin
                        // ⭐ 事件帧开始 ⇒ ⭐ 进入帧内，⛔ 之后 8 个字节一律不认命令
                        idx_q <= 4'd1;
                    end else if (fxstat_arm_q) begin
                        //  ⭐⭐ 2026-10-17：⭐ **`'Z'` 的子命令号就在这里收** ✅
                        //     ⚠️ **为什么必须排在 `byte_is_cmd` 分支之前**：
                        //        🔴 `'Z'` 的语义是"**下一个字节**是子命令号"（⭐ 协议原话 ✅）
                        //        ⚠️ 若排在后面 ⇒ ⭐ 子命令字节只要是另一个命令字母
                        //           （⭐ 例如用户发 `'Z'` + `'T'`）就会**重新被当成命令**
                        //           ⇒ 🔴 **子命令号永远收不到**（⭐ 学位号静默失效 ✅）
                        //     ⚠️ **为什么排在 `byte_is_header` 之后**：
                        //        🔴 帧头 `0xA5` 必须**最高优先级**（⭐ 否则臂会把帧头吃掉
                        //           ⇒ 🔴 整个事件帧错位 ⇒ 曲谱链路整体失效，⭐ 灾难 ✅）
                        //        📌 代价：⭐ 发了 `'Z'` 之后紧跟一帧曲谱 ⇒ ⭐ 那帧的**帧头被当子命令号**
                        //           （⭐ `0xA5 & 3'b111 = 5`）⇒ ⚠️ 会回读第 5 项而不灌曲谱 ✗
                        //        ⚠️ **如实标注**：⭐ 这是"两字节命令"的**固有代价**
                        //           （⭐ `'H'`/`'Q'` 靠"必须灌完整帧"规避，⭐ 而 `'Z'` 故意不那样 ✅）
                        //        ⭐ 缓解：⭐ 回读是**诊断动作**（⭐ 用户不会在回读时同时灌谱 ✅）
                        //     ⭐ 取走后**立刻清臂** ⇒ ⭐ 一次臂只吃一字节（⛔ 不会污染后面的字节 ✅）
                        fxstat_sub_o <= rx_data_i[2:0];   // ⭐ 只取低 3 位（0..7 ✅）
                        fxstat_req_o <= 1'b1;             // ⭐ 单拍脉冲
                        fxstat_arm_q <= 1'b0;
                        cmd_cnt_o     <= sat_inc16(cmd_cnt_o);   // ⭐ 'Z' + 子命令号 = 一条命令
                        idx_q         <= 4'd0;
                    end else if (byte_is_cmd) begin
                        // ⭐⭐ 命令（⭐ 帧外 ⇒ 安全）
                        //   ⚠️ **互斥**：一次只可能命中一个（⭐ 四个字母互不相同）
                        //   ⭐ 四者的下游都有"忙"保护 ⇒ ⛔ 不会互相打架。
                        //  ⭐⭐ 2026-10-14：⭐ **命令也是"非帧头字节" ⇒ 先废掉【旧的】臂** ✅
                        //     🔴 依据：⭐ 臂的语义 = "**下一个字节就是帧头**"（⭐ 承诺 ✅）
                        //        ⚠️ 承诺被打破却不清臂 ⇒ 🔴 残局**永久挂着**
                        //        ⇒ ⭐ 之后第一帧的载荷[0] 被**静默**当成值吃掉 ✅
                        //     📌 **顺序很重要**：⭐ 先清、⭐ 再由下面的命令建**自己的**臂
                        //        ⇒ ⭐ `'Q'` 紧跟 `'H'` 时**不会互相污染** ✅
                        abs_arm_q <= 1'b0;
                        bpm_arm_q <= 1'b0;
                        fxstat_arm_q <= 1'b0;   // ⭐ 'Z' 的臂也要一起废（⭐ 见 `fxstat_arm_q` 注释 ✅）
                        if (byte_is_tare)  tare_req_o  <= 1'b1;
                        if (byte_is_span)  span_req_o  <= 1'b1;
                        if (byte_is_abort) abort_req_o <= 1'b1;
                        if (byte_is_probe) probe_req_o <= 1'b1;   // ⭐ 'P' 诊断
                        if (byte_is_vstat) vstat_req_o <= 1'b1;   // ⭐ 'V' 诊断
                        if (byte_is_posprobe) posprobe_req_o <= 1'b1; // ⭐ 'N' 诊断
                        if (byte_is_test_mode) test_mode_req_o <= 1'b1;
                        // ⭐ 2026-09-29：looper 三条（⭐ 帧外 ⇒ 安全）
                        if (byte_is_loop_rec)  loop_rec_req_o  <= 1'b1;
                        if (byte_is_loop_play) loop_play_req_o <= 1'b1;
                        if (byte_is_loop_clr)  loop_clear_req_o<= 1'b1;
                        // ⭐ 2026-09-29：⭐ 切音色（⭐ 帧外 ⇒ 安全）
                        if (byte_is_timbre)    timbre_req_o    <= 1'b1;
            if (byte_is_scope)     scope_mode_req_o <= 1'b1;   // ⭐ 'E'
                        if (byte_is_met)       met_req_o       <= 1'b1;   // ⭐ 'B'（⭐ 2026-09-29）
                        // ⭐ 2026-09-29：⭐ 鼓机节奏型（⭐ 帧外 ⇒ 安全）
                        if (byte_is_drum_pat)  drum_pattern_req_o <= 1'b1;
                        // ⭐⭐ 2026-10-01：⭐ 键盘打鼓模式（⭐ 帧外 ⇒ 安全）
                        //   ⭐ 与 `'D'` 同构：⭐ "切换"语义 ⇒ ⭐ `top.v` 用寄存器记状态 ✅
                        if (byte_is_keydrum)   keydrum_req_o      <= 1'b1;
                        // ⭐⭐ 2026-10-03（`P2`）：⭐ **T3 变调控制面**（⭐ 帧外 ⇒ 安全）
                        //   ⭐ `'F'`/`'G'`/`'J'` = **纯脉冲**（⭐ 与 `'D'`/`'K'` 同构）
                        if (byte_is_trans_down) trans_down_req_o <= 1'b1;
                        if (byte_is_trans_up)   trans_up_req_o   <= 1'b1;
                        if (byte_is_gear_next)  gear_next_req_o  <= 1'b1;
                        //  ⭐⭐ 2026-10-11：⭐ `'Y'`（⭐ 录制回传）—— ⭐ 同样是**纯脉冲** ✅
                        if (byte_is_recdump)    recdump_req_o    <= 1'b1;
                        //   ⭐ `'H'` = **臂化**（⛔ 本拍**不出脉冲**）——
                        //      ⭐ 值在**下一帧的第一个载荷字节**那一拍才出（⭐ 见下方帧内段）
                        //      📌 所以"发 `'H'` 就立刻变调"是**错的预期**：
                        //         ⭐ 必须 `'H'` ＋ ⭐ 紧跟一帧（`0xA5` + 8 字节）才生效 ✅
                        if (byte_is_trans_abs)  abs_arm_q        <= 1'b1;
                        //   ⭐⭐ 2026-10-11：⭐ **`'Q'` 也是【臂化】**（⭐ ⛔ 本拍不出脉冲 ✅）
                        //      ⭐ 值在**下一帧的第一个载荷字节**那一拍才出 ✅
                        if (byte_is_bpm)        bpm_arm_q        <= 1'b1;
                        //   ⭐⭐ 2026-10-11：⭐ **`'W'` 滑音开关**（⭐ 切换语义 ⇒ ⭐ 直接出脉冲 ✅）
                        //      📌 ⭐ 与 `'B'`（节拍器）/`'K'`（键盘打鼓）**同构** ✅
                        if (byte_is_slide)      slide_req_o      <= 1'b1;
                        //   ⭐⭐ 2026-10-13：⭐ **`'A'` 模式翻转（指板 ⇄ 钢琴）** ✅
                        //      📌 与 `'B'`/`'K'`/`'W'` **同构**（⭐ "切换"语义 ⇒ 直接出脉冲 ✅）
                        //      🔴 **踩过的坑**：⭐ 只加这一行、⛔ 忘了加进 `byte_is_cmd` 总闸
                        //         ⇒ ⭐ `'A'` 连"命令"都不算（⭐ 上板实测症状 ✅）
                        if (byte_is_mode_sw)    mode_sw_req_o    <= 1'b1;
                        //  ⭐⭐ 2026-10-14：⭐ **`'O'` 实时上行开关**（⭐ "切换"语义 ⇒ 直接出脉冲 ✅）
                        //     📌 与 `'B'`/`'K'`/`'W'`/`'A'` **同构**（⭐ `top.v` 用寄存器记状态 ✅）
                        if (byte_is_upstream)   upstream_req_o   <= 1'b1;
                        //  ⭐⭐ 2026-10-14：⭐ **`'U'` 指引模式开关**（⭐ "切换"语义 ⇒ 直接出脉冲 ✅）
                        if (byte_is_guide)      guide_req_o      <= 1'b1;
                        //  ⭐⭐ 2026-10-17：⭐ **`'Z'` = 臂化**（⭐ ⛔ 本拍**不出脉冲** ✅）
                        //     📌 与 `'H'`/`'Q'` **同构**：⭐ 子命令号在**下一个帧外字节**那一拍才出
                        //        （⭐ 见下方帧内段之后的 `fxstat_arm_q` 取用点 ✅）
                        //     🔴 **为什么不本拍就出脉冲**：⭐ 本拍根本没有子命令号
                        //        ⇒ ⚠️ 若本拍出脉冲，⭐ `top.v` 会拿**上一次的旧子命令号**去回读
                        //        ⇒ 🔴 **回读到的是别的东西**（⭐ 比"没反应"更危险 ✅）
                        if (byte_is_fxstat)     fxstat_arm_q     <= 1'b1;
                        cmd_cnt_o <= sat_inc16(cmd_cnt_o);
                        idx_q     <= 4'd0;      // ⭐ 命令不推进帧位置
                    end else begin
                        // ⚠️ 帧外的其他字节（⭐ 比如 PC 敲的回车/换行）
                        //   ⭐ **必须可观测** ⇒ 计数，⛔ 不静默
                        //  ⭐⭐ 2026-10-14：⭐ **它们【不是无害的】—— 会废掉未兑现的臂** ✅
                        //     🔴 **实测触发路径**：⭐ 用户发 ASCII `Q60`（⭐ `'Q'` ＋ `'6'` ＋ `'0'`）
                        //        ⇒ ⭐ `'Q'` 臂化，⭐ 而 `'6'`/`'0'` 走**本分支**
                        //        ⇒ ⚠️ 旧代码**不清臂** ⇒ 🔴 臂**永久挂住**
                        //        ⇒ ⭐ 之后**任何一帧**（⭐ 串口屏帧 / ESP32 灌的曲谱帧）
                        //           的载荷[0] 被静默当成 BPM 值吃掉 ✅
                        //     📌 ⭐ 现在：⭐ 承诺（"下一个字节是帧头"）被打破 ⇒ ⭐ **立刻废臂** ✅
                        //     📌 **不影响正常用法**：⭐ "发 `'Q'` ⇒ 停顿 ⇒ 发帧"里
                        //        ⚠️ 停顿**不产生字节** ⇒ ⭐ 臂不会被动到 ✅
                        //        （⭐ 只有**别的字节**才会废掉它 —— 那本来就该废 ✅）
                        abs_arm_q <= 1'b0;
                        bpm_arm_q <= 1'b0;
                        fxstat_arm_q <= 1'b0;   // ⭐ 'Z' 的臂同一条路径废掉（✅ 与 `'Q'` 同族）
                        unknown_cnt_o <= sat_inc16(unknown_cnt_o);
                        idx_q         <= 4'd0;
                    end
                end else begin
                    // ---- ⭐ 帧内：⭐ 这些字节是【载荷】，⛔ 绝不当命令 -------
                    if (byte_is_cmd) begin
                        // 🔴 载荷里出现了命令字母 ⇒ ⭐ **忽略它**，但⭐ 记账
                        //    ⚠️ 这段计数是"边界跟踪真的在工作"的**证据**
                        in_frame_cnt_o <= sat_inc16(in_frame_cnt_o);
                    end
                    // ⭐⭐ 2026-10-03（`P2`）：⭐ **`'H'` 的带帧绝对量**（⭐ 复用现有 9 字节帧）
                    //   ⭐ 位置：⭐ `idx_q == 4'd1` = **第一个载荷字节**（⭐ 紧跟 `0xA5` 那一个）✅
                    //   🔴 **必须在"已臂化"（`abs_arm_q`）时才取** ——
                    //      ⚠️ 否则**普通事件帧**（⭐ 曲谱！）的第一个载荷字节会被当成半音值
                    //      ⇒ 🔴 **灌曲谱时变调值被乱改**（⭐ 与"帧内字母不触发"同一类灾难）✅
                    //   ⭐ 取走后**立刻清臂** ⇒ ⭐ 一次臂化只吃一帧 ✅
                    //   📌 帧内出现的 `'H'`（⭐ 载荷字节 == 0x48）⛔ **不会**再臂化 ——
                    //      ⭐ 因为置臂只写在上面"帧外"分支里（⭐ 靠 `if (idx_q == 4'd0)` 的
                    //      **结构**保证，⛔ 不是靠一个可能被漏接的门控 wire —— 见上方注释 ✅）
                    if ((idx_q == 4'd1) && abs_arm_q) begin
                        trans_abs_val_o <= rx_data_i;
                        trans_abs_req_o <= 1'b1;
                        abs_arm_q       <= 1'b0;
                    end
                    //  ⭐⭐ 2026-10-11：⭐ **`'Q'` 的带帧载荷**（⭐ 与 `'H'` 完全同套路 ✅）
                    //     ⭐ 位置：⭐ `idx_q == 1` = **第一个载荷字节** ✅
                    //     ⭐ 取走后**立刻清臂** ⇒ ⭐ 一次臂化只吃一帧 ✅
                    if ((idx_q == 4'd1) && bpm_arm_q) begin
                        bpm_val_o     <= rx_data_i;
                        bpm_set_req_o <= 1'b1;
                        bpm_arm_q     <= 1'b0;
                    end
                    if (idx_q == IDX_LAST) begin
                        idx_q <= 4'd0;          // ⭐ 本帧结束，回到帧外
                    end else begin
                        idx_q <= idx_q + 4'd1;
                    end
                end
            end else if (idle_expired && (idx_q != 4'd0)) begin
                // ══ ⭐ 空闲归位（⭐ 自愈）═════════════════════════════════════
                //   ⭐ 长时间没有新字节 ⇒ ⭐ 半帧作废，回到帧外
                //   ⭐ 幂等：一旦 idx==0 就不再满足条件 ⇒ ⭐ 天然只触发一次
                idx_q        <= 4'd0;
                resync_cnt_o <= sat_inc16(resync_cnt_o);
                //   ⭐ 2026-10-03（`P2`）：⭐ 半帧作废 ⇒ ⭐ `'H'` 的臂**一起作废**
                //      ⚠️ 否则一个"发了 `'H'` 但帧没发完"的残局会**永久挂着臂**
                //      ⇒ 🔴 之后第一帧的载荷[0] 被静默吃掉 ✅
                abs_arm_q    <= 1'b0;
                //   ⭐⭐ 2026-10-14：⭐ **`'Q'` 的臂也必须【一起】作废** ✅
                //      🔴 **原缺陷**：⭐ 2026-10-11 加 `'Q'` 时**只清了 `abs_arm_q`**
                //         ⇒ ⚠️ 发一次 `'Q'` 但没跟完整帧 ⇒ 🔴 `bpm_arm_q` **永久挂住**
                //         ⇒ ⭐ 之后**任何一帧**（⭐ 串口屏帧 / ESP32 灌的曲谱帧）
                //            的**载荷[0] 都会被静默当成 BPM 值吃掉** ✅
                //      📌 ⭐ 与 `abs_arm_q` 上面那条注释是**同一灾难**（⭐ 本行是补漏 ✅）
                //      📌 **实测触发路径**：⭐ 用户发 ASCII `Q60`（⭐ 字母 + 数字，
                //         ⛔ 不是"帧"）⇒ ⭐ 臂挂住 ⇒ ⚠️ 之后灌曲谱会被乱改 BPM ✅
                bpm_arm_q    <= 1'b0;
                //  ⭐⭐ 2026-10-17：⭐ **`'Z'` 的臂也必须【一起】作废** ✅
                //     📌 与上面 `bpm_arm_q` **同一条灾难**（⭐ 已是第三次补漏 ✅）
                //     ⚠️ 触发路径：⭐ 发了 `'Z'` 之后**超过 16 个字节时间没动静**
                //        ⇒ ⭐ 若不清 ⇒ 之后**第一个字节**被当成子命令号吃掉 ✅
                fxstat_arm_q <= 1'b0;
            end
        end
    end

    // ═══════════════════════════════════════════════════════════════════════
    // ⭐ 参数自检（⭐ 与既有模块同一套路）
    //   ⚠️ 会**静默失效**的组合：
    //     ① `GAP_BYTES <= 1` ⇒ ⚠️ 帧内字节间隙被误判成"空闲" ⇒
    //        🔴 **半帧提前归位** ⇒ 帧内字母被当成命令（⭐ 正是本模块要防的）
    //     ② 三个命令字母有**重复** ⇒ ⚠️ 后面的 `if` 永远被前面的遮蔽
    //        ⇒ 🔴 **某个命令静默失效**（⚠️ 按了没反应，且无任何提示）
    //     ③ `BAUD`/`CLK_HZ` 导致 `BYTE_CLK_I == 0` ⇒ ⚠️ 计时器失去意义
    //     ④ 命令字母 == `HEADER` ⇒ 🔴 **帧头被当命令** ⇒ 事件帧全废
    // ═══════════════════════════════════════════════════════════════════════
    // Every recognised command must have its own byte.  Keep this complete:
    // a false PARAM_OK is build-visible, rather than merely a diagnostic that
    // can scroll out of a log.
    //  ⭐ 2026-09-29 重构：⭐ 命令字母从 **7 个**涨到 **10 个** ⇒
    //     🔴 手写 C(10,2) = **45 个配对**既啰嗦、⭐ 又**极容易漏一个**
    //     ⇒ ⭐ **改成【循环查重】**（⭐ 以后加第 11 个字母只需往 `cmd_tab` 里加一项）✅
    localparam PARAM_OK = (GAP_BYTES > 1) && (BYTE_CLK_I > 0);

    //  ⭐⭐ **全部命令字母**（⚠️ 加新命令时【必须】往这张表里加一项）
    //   ⭐ 2026-09-29：⭐ **12 ⇒ 13**（⭐ 新增 `'D'` 鼓机节奏型）
    //      📌 ⚠️ **忘了加这里 = 查重漏掉新字母** ⇒ 🔴 将来撞字母时**静默遮蔽**
    //         （⭐ 所以本表是"加新命令时的**必改项**"，⭐ 见上方注释 ✅）
    //   ⭐ 2026-10-03（`P2`）：⭐ **14 ⇒ 18**（⭐ 新增 `'F'`/`'G'`/`'H'`/`'J'` 四条变调命令）
    //      📌 ⚠️ **忘了加这里 = 查重漏掉新字母** ⇒ 🔴 将来撞字母时**静默遮蔽**
    //         （⭐ 所以本表是"加新命令时的**必改项**"，⭐ 见上方注释 ✅）
    localparam integer N_CMD = 26;   // E 显示、Q BPM、W 滑音、A 模式、O 上行、U 指引、Z 状态回读 分别查重
    reg [7:0] cmd_tab [0:N_CMD-1];
    integer   ci, cj;
    reg       letters_ok;

    initial begin
        cmd_tab[0]  = CMD_TARE;
        cmd_tab[1]  = CMD_SPAN;
        cmd_tab[2]  = CMD_ABORT;
        cmd_tab[3]  = CMD_PROBE;
        cmd_tab[4]  = CMD_VSTAT;
        cmd_tab[5]  = CMD_TEST_MODE;
        cmd_tab[6]  = CMD_POSPROBE;
        cmd_tab[7]  = CMD_LOOP_REC;
        cmd_tab[8]  = CMD_LOOP_PLAY;
        cmd_tab[9]  = CMD_LOOP_CLR;
        cmd_tab[10] = CMD_TIMBRE;      // ⭐ 2026-09-29：⭐ 'I' 切音色
        cmd_tab[11] = CMD_METRONOME;   // ⭐ 2026-09-29：⭐ 'B' 节拍器开/关（⭐ 方案 B：S2 让给音色）
        cmd_tab[12] = CMD_DRUM_PATTERN; // ⭐ 2026-09-29：⭐ 'D' 鼓机节奏型切下一个
        cmd_tab[13] = CMD_KEYDRUM;     // ⭐ 2026-10-01：⭐ 'K' 键盘打鼓模式开关
        cmd_tab[14] = CMD_TRANS_DOWN;  // ⭐ 2026-10-03：⭐ 'F' 变调：降 1 半音（⭐ P2）
        cmd_tab[15] = CMD_TRANS_UP;    // ⭐ 2026-10-03：⭐ 'G' 变调：升 1 半音（⭐ P2）
        cmd_tab[16] = CMD_TRANS_ABS;   // ⭐ 2026-10-03：⭐ 'H' 变调：带帧绝对量（⭐ P2）
        cmd_tab[21] = CMD_SCOPE_MODE; // E 独立于 Y/Q/W 的查重槽位
        cmd_tab[17] = CMD_GEAR_NEXT;   // ⭐ 2026-10-03：⭐ 'J' 推子档位切下一档（⭐ P2）
        cmd_tab[18] = CMD_RECDUMP;     // ⭐ 2026-10-11：⭐ 'Y' 录制回传导出（⭐ 查重必改项 ✅）
        cmd_tab[19] = CMD_BPM;         // ⭐ 2026-10-11：⭐ 'Q' 设置 BPM（⭐ 查重必改项 ✅）
        cmd_tab[20] = CMD_SLIDE;       // ⭐ 2026-10-11：⭐ 'W' 滑音开关（⭐ 查重必改项 ✅）
        cmd_tab[22] = CMD_MODE_SW;     // ⭐ 2026-10-13：⭐ 'A' 模式翻转 指板⇄钢琴（⭐ 查重必改项 ✅）
        cmd_tab[23] = CMD_UPSTREAM;    // ⭐ 2026-10-14：⭐ 'O' 实时上行开关（⭐ 查重必改项 ✅）
        cmd_tab[24] = CMD_GUIDE;       // ⭐ 2026-10-14：⭐ 'U' 指引模式开关（⭐ 查重必改项 ✅）
        cmd_tab[25] = CMD_FXSTAT;       // ⭐ 2026-10-17：⭐ 'Z' 效果器状态回读（⭐ 查重必改项 ✅）

        if (GAP_BYTES <= 1)
            $display("ERROR [calib_cmd] GAP_BYTES = %0d <= 1 => intra-frame byte gaps would be mistaken for idle, so a half frame resyncs early and payload bytes get treated as commands. PARAM_OK=0.", GAP_BYTES);
        if (BYTE_CLK_I <= 0)
            $display("ERROR [calib_cmd] BYTE_CLK_I = %0d <= 0 (CLK_HZ=%0d BAUD=%0d) => the idle timer is meaningless. PARAM_OK=0.", BYTE_CLK_I, CLK_HZ, BAUD);

        letters_ok = 1'b1;
        for (ci = 0; ci < N_CMD; ci = ci + 1) begin
            if (cmd_tab[ci] == HEADER) begin
                letters_ok = 1'b0;
                $display("ERROR [calib_cmd] command letter %02h (index %0d) equals HEADER (%02h) => every event frame would be swallowed as a command. PARAM_OK=0.", cmd_tab[ci], ci, HEADER);
            end
            for (cj = ci + 1; cj < N_CMD; cj = cj + 1) begin
                if (cmd_tab[ci] == cmd_tab[cj]) begin
                    letters_ok = 1'b0;
                    $display("ERROR [calib_cmd] duplicate command letters %02h at index %0d and %0d => one command is silently shadowed and never fires. PARAM_OK=0.", cmd_tab[ci], ci, cj);
                end
            end
        end

        if (PARAM_OK && letters_ok)
            $display("NOTE [calib_cmd] PARAM_OK=1 (CLK_HZ=%0d BAUD=%0d GAP_BYTES=%0d BYTE_CLK=%0d HEADER=%02h N_CMD=%0d T=%02h S=%02h X=%02h M=%02h R=%02h L=%02h C=%02h I=%02h D=%02h F=%02h G=%02h H=%02h J=%02h Y=%02h)",
                     CLK_HZ, BAUD, GAP_BYTES, BYTE_CLK_I, HEADER, N_CMD,
                     CMD_TARE, CMD_SPAN, CMD_ABORT, CMD_TEST_MODE,
                     CMD_LOOP_REC, CMD_LOOP_PLAY, CMD_LOOP_CLR, CMD_TIMBRE,
                     CMD_DRUM_PATTERN,
                     CMD_TRANS_DOWN, CMD_TRANS_UP, CMD_TRANS_ABS, CMD_GEAR_NEXT,
                     CMD_RECDUMP);
    end

endmodule

`default_nettype wire
