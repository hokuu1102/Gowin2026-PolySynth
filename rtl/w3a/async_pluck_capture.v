`timescale 1ns/1ps
// T15: LM393 UP/DOWN asynchronous outputs -> one synchronous pluck event.
// The first synchronized edge is accepted immediately; the refractory period
// only rejects later edges.  A simultaneous UP/DOWN edge is deterministically UP.
//
// ⭐⭐ 2026-10-15：⭐ **删除【回中门控】**（`armed_q`）—— ⭐ 用户明确反对额外限制 ✅
// ⭐⭐ 2026-10-16：⭐ **但同一症状【跨板复现】⇒ 按 RTL 缺陷重开，加【释放后短静默】** ✅
// ---------------------------------------------------------------------------
// 📌 **背景**：⭐ 回中门控是 2026-10-15 为"下拨一次听到两个音"加的，
//    随后**被整个删除**。⭐ **删除的依据（⭐ 仍然成立，⛔ 未被推翻）**：
//    | 量 | 值 | 出处 |
//    |---|---|---|
//    | ⭐ 摇杆**静止（回中）** | ⭐ **1.737 V** | `右手板方案.md:403` |
//    | ⭐ `DOWN_REF`（前推阈值） | ⭐ **1.24 V** | `:422` |
//    | ⭐ `UP_REF`（后拉阈值）   | ⭐ **2.24 V** | `:421` |
//    | ⭐ 迟滞窗口 `ΔV_迟滞`      | ⭐ **17.5 / 18.6 mV** | `:442-443` |
//    ⇒ ⭐ 要制造"**从静止点**再上冲 503 mV"的回摆过冲，⭐ 而一次前推总量仅 1.62 V
//       ⇒ ⭐ **那个特定序列确实物理上不存在** ⇒ 那个删除是对的 ✅
//
// 🔴🔴 **2026-10-16（⭐ 用户上板实测，⛔ 不是推断）**：
//    *"下拨会触发两次。过去一次，回来一次。"*
//    *"我 95% 确定硬件没有问题"* ＋ *"最新的一板一直是有触发两次的，这个问题从来没有被解决过"*
//    ⇒ ⭐ **跨板复现 ⇒ 必须按【RTL 缺陷】处理**，⛔ 不再推给排线/电位器/阈值。
//    ⇒ ⭐ **注意：被否证的是"从静止点反冲 503 mV"，⛔ 不是"回中时重复穿越本路阈值"**。
//       🔴 这两种序列的**触发前提完全不同**：
//        · 🔴 旧假设（已否证）＝**从静止点**再上冲 503 mV ⇒ 需 16% 满量程的能量
//        · ✅ 本症状（⭐ 实测）＝**松手时本路重新穿过自己的阈值一次** ⇒
//          ⭐ 下拨把 `DOWN` 抬到 3.3 V ⇒ **回中必须掉回 0 V** ⇒
//            ⭐ 它**必然**要再穿过 `DOWN_REF`(1.24 V) 一次！
//            ⭐ 带回中的机械摇杆在这一穿**不保证单调** ⇒ 🔴 **每穿一次 = 一个 0→1 沿**。
//          ⭐ 硬件迟滞（18 mV）只管"阈值附近不抖" ⇒ ⛔ 不提供"越过就不回头"的约束。
//          ⭐ `REFRACT_CYC`(30 ms) 也救不了：回弹 100~300 ms 与有意慢拨 200~250 ms
//            **重叠** ⇒ 加长会把正常慢拨一起挡掉（`bringup/29-…-20261015.md:25`）。
//       ⇒ ⭐ 于是**修法必须换判据**：⛔ 不看位置（那是旧门控的死路），
//         ✅ **看"这一路是不是刚掉回过低"** —— 完整论证见下方 `BLANK_CYC` 那段。
//
// ✅ **旧门控为什么⛔ 不能原样加回**（⭐ 三条，逐条对照）：
//    ① 它按"两路都低"重新武装 ⇒ ⭐ 摇杆停在阈值以外（装配偏/温漂）⇒
//       🔴 **永久卡死 ⇒ 上电后只有第一下响**（这是实测过的真实风险）；
//    ② 它会把**真·交替拨弦**（下拨→回中→上拨，100~300 ms）一起挡掉
//       ⇒ ⭐ 用户明确反对"给真拨弦加额外限制"；
//    ③ 它挡的序列（从静止点反冲 503 mV）**已被定量否证** ⇒ 修了个不存在的问题。
//
// 🔴 **"一次下拨出两个音"的【另一条】已定位真因（⭐ 与本文件不同路径）**：
//    ⭐ `event_extract` 在 `enable_i=0` 时静默清 `key_on[]`
//    ⇒ `play_mode_ctrl.held_mask` 留**脏位** ⇒ 一次拨弦发 N 条（**同时**两个音）
//    ⇒ ⭐ 它的修法见 `rtl/w3a/play_mode_ctrl.v` 的 `axis_clr_i` 端口注释。
//    ⚠️ **两者症状不同，⛔ 不许混为一谈**：
//    · ⭐ 脏位路径 ⇒ **同一拍**发 N 条（按 `'T'` 才有）
//    · ⭐ 本文件修的路径 ⇒ **先后**两条（⛔ 不需要任何命令，纯机械）
//
// ✅ **本文件现在的语义（⭐ 回到门控之前 ＋ 2026-10-17 加【下降沿后同路 blank】）**：
//    · ⭐ 同步后的**第一个沿立即接受**，之后由 `REFRACT_CYC`（`top.v` 实参 30 ms）
//      挡极近抖动；
//    · ⭐ `UP`/`DOWN` 同拍时**确定性地判 `UP`**；
//    · ⭐⭐ **2026-10-17：⭐ 本模块【仍然不施加任何位置限制】**（⛔ 不看中位）——
//      但**额外挡"同一路掉回低之后立刻又重新起沿"**（见下方 `BLANK_CYC` 那段）。
//      🔴 **这是两个不同的东西，⛔ 不许混为一谈**：
//        · 🔴 **位置门控**（⭐ 2026-10-15 删掉的那个）＝"回中才准再触发" ⇒
//          会把**真·交替拨弦**（下拨→回中→上拨，间隔 100~300 ms）一起挡掉，
//          用户明确反对 ⇒ ⛔ 永不加回。
//        · ✅ **本修法**＝"**刚掉回低的那一路**在 5 ms 内不许再出声" ⇒
//          它只在**松手那一瞬**有效，⛔ 与"停在什么位置"无关 ⇒
//          真·交替拨弦（间隔 ≫ 5 ms）**一条都不挡**。
//
//  ⭐⭐ **2026-10-17 新增：⭐ 【下降沿后同路 blank】（`BLANK_CYC`）⭐⭐
//  ──────────────────────────────────────────────────────────────────────
//  🔴 **它修的症状（⭐ 用户 2026-10-16/17 上板实测，⛔ 不是推断）**：
//     *"下拨会触发两次。过去一次，回来一次。"*
//     *"第二次响和第一次响是在同一个位置，只是一个是从平衡点过去，一个是回到平衡点。"*
//     *"上拨就没有这个问题。"*
//     · ⭐ 用户同时明确：*"我 95% 确定硬件没有问题"* ＋
//       *"最新的一板一直是有触发两次的，这个问题从来没有被解决过"*
//     ⇒ ⭐ **跨板复现 ⇒ 必须按【RTL 缺陷】处理**（⛔ 不再推给排线/电位器/阈值）。
//
//  🔴 **机理（⭐ 与旧门控要挡的【不是】同一个序列）**：
//     ⭐ 旧门控（2026-10-15 已否证并删除）挡的是"**从静止点**再上冲 503 mV"——
//        ⭐ 静止点 1.737 V，`UP_REF` 2.24 V ⇒ 需 503 mV，而一次前推总量仅 1.62 V
//          ⇒ ⭐ 那个序列确实不存在 ⇒ 那个删除是对的。
//     ⭐⭐ **本症状是【同一条通道掉回低时】的二次穿越**——
//        ⭐ 下拨把 `DOWN` 抬到 3.3 V，`DOWN_REF` 1.24 V；
//        ⭐ **松手回中时 `DOWN` 要掉回 0 V** —— 它必须**重新穿过 `DOWN_REF`
//          （1.24 V）一次**；
//        ⭐ 带弹簧回中的机械摇杆在这一穿**不保证单调** ⇒
//          ⭐ 它可以在 1.24 V 附近**抖/过冲几次** ⇒ 🔴 **每穿一次就是一个 0→1 沿**。
//        ⭐ **迟滞挡不住它**：⭐ 硬件迟滞窗口只有 **17.5 / 18.6 mV**（≈0.35°，
//          满量程 0.5%）⇒ ⭐ 而 PICK 缓慢穿过这 18.6 mV 窗口时**有充分时间抖**
//          ⇒ 迟滞只保证"阈值附近不抖"，⛔ **不提供**"越过之后不再回头"的能量约束。
//     ⭐ **`REFRACT_CYC`（30 ms）也挡不住它**：
//        ⭐ 回弹发生在松手后 **约 100~300 ms**（`bringup/29-…-20261015.md:25` 实测区间），
//          ⭐ 而**有意慢拨的间隔是 200~250 ms** ⇒ 🔴 **两者重叠 ⇒ 加长不应期
//          会把正常慢拨一起挡掉 ⇒ 那条路无解**（原文自己写明了）。
//     ⇒ ⭐ **唯一能分辨这两者的判据 = "这一路是不是【刚掉回过低】"**：
//        · ⭐ **二次穿越** ⇒ 紧跟在该路 `1→0`（**掉回低**）之后 ⇒ ✅ **可挡**
//        · ⭐ **真·交替拨弦** ⇒ 那一路**早已掉回过低**（远早于 5 ms），
//          且这次是**另一路**的上升沿 ⇒ ⛔ **不挡**
//     ⇒ ⭐ 于是"同路 blank"把两类事件**干净分开**，而位置门控分不开。
//
//  ⭐ **为什么 5 ms 够用、⛔ 不需要更准**：
//     · ⭐ 二次穿越是"穿过 18.6 mV 迟滞窗口"时发生的 ⇒ 时间尺度是**毫秒以下**；
//     · ⭐ 真正要挡的只是"掉回低那一瞬的反复穿越" ⇒ **5 ms 远大于该时间尺度**；
//     · ⭐ 而人手**同向连拨**（下拨→回中→再下拨）的最快实测间隔 >50 ms
//       ⇒ ⭐ 5 ms 落在"抖动已结束"与"人手最快连拨"之间 ⇒ **两边都不碰**。
//     ⚠️ **做成 `parameter`**（⭐ 与 `REFRACT_CYC` 同纪律）⇒ ⭐ 上板可调，
//        ⛔ 不写死；若现场仍有漏网/误挡 ⇒ 只改 `top.v` 实参一个数。
//
//  ⭐⭐ **本修法延迟 = 0**（⭐ 题目硬约束：拨弦事件 ≤5 ms）：
//     ⭐ blank 只是**漏掉一次错误的沿**，⛔ **不让任何真事件变慢**。
//     ⭐ 实测（`tb_async_pluck_capture` 的 `P0-4-2h`）：**4 拍 = 80 ns**
//       （2FF 同步 2 + 判决 1 + 采样 1）⇒ ⭐ blank **零贡献**。
//     🔴 **这正是 v2（"等一路连续为高 30 ms"）被整个作废的原因** ——
//        ⭐ v2 延迟 30 ms ⛔ 直接违反题目约束，且会把快速点拨整条丢掉。
//
//  ⭐ **本修法⛔ 不恢复位置门控的任何副作用**（⭐ 三条，逐条对照）：
//     ① ⭐ **不看中位** ⇒ ⭐ 摇杆**停在阈值以外**（装配偏/温度漂移/未调好）
//        时**照样出声** ⇒ ⛔ 不会"卡死成只有第一下响"（旧门控正是死在这条）；
//     ② ⭐ **不要求"两路都低"** ⇒ ⭐ 上电时摇杆偏在一侧也**不影响后续**；
//     ③ ⭐ **真·交替拨弦零回归** ⇒ ⭐ 由 `tb_async_pluck_capture` 的
//        *"alternating pluck"* 与 *"H9/H9b"* 两组判据守（⭐ 见该 tb 的实测 ✅）。
//
//  📌 `armed_o` 保留**端口**（`top.v` 已接 `syn_keep`，无害），但门控没了 ⇒
//    它**失去语义** ⇒ 恒 `1'b1`。
//  📌 `both_low_o` 保留且**仍有意义**：它就是"两路都低 = 摇杆在中位"的**原始观测量**。
`default_nettype none

module async_pluck_capture #(
    parameter integer REFRACT_CYC = 2_500_000,
    //  ═══════════════════════════════════════════════════════════════════════
    //  ⭐⭐ 2026-10-17（⭐ **v3 · 取代 v1/v2**）：⭐ **下降沿后同路 blank** ⭐
    //  ═══════════════════════════════════════════════════════════════════════
    //  🔴 **语义**：⭐ 某一路（UP 或 DOWN）出现 `1→0` 下降沿后的 `BLANK_CYC` 拍内，
    //     ⛔ **不接受该路的上升沿**。⭐ **延迟 = 0**（⛔ 不需要等任何东西）。
    //  🔴 **为什么必须是"下降沿后同路 blank"这个判据**（⭐ 三条现场事实逼出来的）：
    //     · ⭐ 用户：*"第二次响和第一次响是在同一个位置，只是一个是从平衡点过去，
    //       一个是回到平衡点"* ⇒ ⭐ **第二下是同一路二次触发**，⛔ 不是回冲越另一路。
    //       （⭐ 定量佐证：若第二下是回冲越 `UP_REF`，PICK 要从 1.737 V 冲到 2.24 V
    //         ⇒ 位置在平衡点【之上】，与第一下（平衡点之下）⛔ 不同位置 ⇒ 与观察矛盾。）
    //     · ⭐ 用户：*"上拨就没有这个问题"* ⇒ ⭐ 机理与**回中方向 × 阈值位置**有关：
    //       | | 松手回中 | 穿过释放阈 | 二次触发 |
    //       |---|---|---|---|
    //       | **DOWN**（下拨） | PICK 0.12→1.737 V **上升** | 从下方**上行**穿过 1.24→1.2586 V | 🔴 抖一下 ⇒ 新上升沿 |
    //       | **UP**（上拨） | PICK 3.18→1.737 V **下降** | 从上方**下行**穿过 2.24→2.22 V | ✅ 产生 `1→0`，RTL 不检测 |
    //       ⇒ ⭐ **UP 的释放天然是下降沿 ⇒ 结构上不会二次触发**；
    //          ⭐ DOWN 的释放方向决定了它**必须**再穿一次阈值 ⇒ 有机会抖 ⇒ 固定两次。
    //     · ⭐ 用户（⭐ 题目硬约束）：**拨弦事件延迟 ≤ 5 ms** ⇒
    //       ⛔ 判掉 v2（"等一路连续为高 30 ms"：延迟 30 ms 且快速点拨会被整条丢掉）。
    //  ✅ **为什么 blank 能同时满足"挡住二次触发"和"≤5 ms"**：
    //     | 场景 | 同路二次触发距下降沿 | `BLANK_CYC`=5 ms 挡得住？ |
    //     |---|---|---|
    //     | 回中时 DOWN 在释放阈附近抖 | **<几 ms**（穿过 18.6 mV 窗口的时间） | ✅ 挡住 |
    //     | 真·连拨两次下拨 | **>50 ms**（人手最快同向连拨） | ⛔ 不挡，正常出声 |
    //     | 上拨（UP 路） | blank 只作用于 DOWN | ⛔ 完全不影响 |
    //  ⭐ **为什么这是"对因下药"而不是"经验值"**：
    //     ⭐ 二次触发**必然紧跟 DOWN 自己的 `1→0`**（松手那一瞬才开始穿释放阈）
    //     ⇒ ⭐ 用"下降沿"作锚点，物理上就框住了那一次误触发；
    //     ⭐ 而两次独立下拨之间人手最快 >50 ms ⇒ 5 ms 窗口**天然不碰真拨弦**。
    //  ⭐ **硬件侧的对偶修法（⭐ 留给硬件，⛔ 本模块不依赖它）**：
    //     ⭐ `右手板方案.md:448-450` 说不能把 `R5`/`R6` 换小（怕污染 ADC CH0）——
    //        🔴 但**那条限制只对 `R5`（接 PICK = ADC CH0）成立**；
    //        ✅ `R6` 接的是 **`DOWN_REF`（纯阈值节点，⛔ 不接任何 ADC）** ⇒
    //           ⭐ 把 `R6` 470 kΩ → 47 kΩ 可把 DOWN 侧迟滞从 18.6 mV 提到 ~170 mV
    //             （10 倍），而 PICK 上的 ADC 偏移**一点不变**。
    //     ⚠️ 本模块的 blank 是**软件保底**；硬件加大迟滞是**更干净的解**。两者可叠加。
    //  ═══════════════════════════════════════════════════════════════════════
    parameter integer BLANK_CYC   = 250_000
) (
    input  wire clk_i,
    input  wire rst_n_i,
    input  wire pluck_up_async_i,
    input  wire pluck_down_async_i,
    output reg  pluck_valid_o,
    output reg  pluck_up_o,
    //  ⭐ 可观测（`K-106`）：⚠️ 没有它，"为什么这一拨没响"就只能靠猜
    //      （⭐ 分不清"被节流"与"沿没来"）✅
    //  ⚠️ **2026-10-15 更新**：⭐ `armed_o` 的门控语义已随门控一起删除
    //      ⇒ ⭐ 它现在**恒 `1'b1`**（⭐ 见实现处注释）；
    //      ⭐ `both_low_o` **仍有意义** = 摇杆在中位的原始观测量 ✅
    output wire armed_o,
    output wire both_low_o
);
    //  ⭐⭐ 2026-10-17：⭐ **定宽化的 blank 窗口常量**
    //     ⚠️ 为什么必须转一道：⭐ `BLANK_CYC` 是 `integer`（32 位**有符号**）⇒
    //        ⚠️ 且本项目纪律是"参数先定宽再使用"（可读 + 防漂移）。
    //     ⭐⭐ **⛔ 不许写 `BLANK_CYC[31:0]`**（⭐ 本项目 `K-91` 铁律：
    //        **绝不对 `integer` 参数做位选** —— ⭐ 我第一次就写成了那个，
    //        ⚠️ 而且 iverilog 报的是 *"Unable to bind `HOLD_N`"*（⛔ 不指认位选）
    //        ⇒ 🔴 **极易误判成"声明丢了"而白查一轮**，特此留档 ✅）
    //     ✅ 正解：**直接整体赋给定宽 localparam**（⭐ 由语言自己完成截断）
    //        —— ⭐ 同族先例：`evt_upstream.v:120` 的 `localparam [AW_W:0] FIFO_D_C = FIFO_D;`
    //     ⚠️ **`BLANK_N = 0` 表示"整个关掉 blank"**（⇒ 回到"见沿即发"的旧行为）。
    localparam [31:0] BLANK_N = (BLANK_CYC > 0) ? BLANK_CYC : 32'd0;
    //  ⭐ 参数自检（⭐ 与 `event_extract` / `note_manager` / `calib_autotare` 同一套路）
    //     ⚠️ 这两个组合会**静默失效**且极难定位 ⇒ 必须在 elaboration 期就喊出来。
    localparam PARAM_OK = (REFRACT_CYC >= 0) && (BLANK_CYC >= 0);
    initial begin
        if (!PARAM_OK) begin
            $display("ERROR [async_pluck_capture] REFRACT_CYC=%0d BLANK_CYC=%0d => negative parameter. PARAM_OK=0.",
                     REFRACT_CYC, BLANK_CYC);
            //  ⛔ 不 $fatal：⭐ 本项目的自检一律只 $display（⭐ 让上层 PARAM_OK 汇总）
            //     —— ⭐ 见 `note_manager.v:2001-2015` / `calib_autotare.v:348` 的先例。
        end
        if (BLANK_CYC == 0)
            $display("WARNING [async_pluck_capture] BLANK_CYC=0 => the same-rail blank is OFF, so a release-threshold re-crossing WILL retrigger (the 'one down stroke, two notes' bug).");
    end
    reg up_ff1, up_ff2, down_ff1, down_ff2;
    reg up_prev, down_prev;
    reg [31:0] refractory_q;
    //  ⭐⭐ 2026-10-17：⭐ **blank 窗口的【逐路】倒计时**
    //     ⭐ `*_blank_q` = 该路**刚出现 `1→0` 下降沿**后还剩多少拍不许出声。
    //     ⚠️ **逐路（⛔ 不是全局）**：⭐ DOWN 的 blank ⛔ 不许影响 UP，
    //        ⭐ 否则真·交替拨弦（下拨→回中→上拨）会被自己挡掉
    //          —— ⭐ 那正是旧位置门控的死法（⛔ 不许重犯）。
    reg [31:0] up_blank_q, down_blank_q;
    //  ⭐⭐ 2026-10-15：⭐ **`armed_q`（回中门控）已【整个删除】** ✅
    //     🔴 依据见文件头（⭐ "从静止点反冲 503 mV 物理上不存在" + "卡死风险"）✅
    //     ⛔ 本模块**不再对真拨弦加任何位置限制**：
    //        ⭐ 唯一的节流是 `refractory_q`（⭐ 挡极近抖动，⭐ 不是位置门控）✅
    //     ⭐⭐ **2026-10-17 更新**：⭐ 新增 `*_blank_q`（⭐ 下降沿后同路 blank）——
    //        ⚠️ 它同样**不是位置门控**：⭐ 它只看"这一路是不是刚掉过低"，
    //           ⛔ 不看"摇杆停在哪" ⇒ ⭐ 完整辨析见文件头那段对照。

    wire up_rise   = up_ff2   && !up_prev;
    wire down_rise = down_ff2 && !down_prev;
    //  ⭐⭐ 2026-10-17：⭐ **"掉回低"沿**（`1→0`）—— ⭐ 它【启动】blank
    //     ⚠️ 与 `*_rise` 同口径（⭐ 都是同步后的 `ff2/prev`）⇒
    //        ⭐ 两条沿**可以在同一拍**都成立（⭐ 例："从 DOWN 直接切到 UP"）。
    //     🔴 **为什么这就是本修法的锚点**（⭐ 用户现场事实）：
    //        ⭐ DOWN 的释放是 `1→0`，而**松手回中时 PICK 必须再穿一次释放阈**，
    //          ⭐ 于是二次触发**必然紧跟这一沿**（⭐ 距离 < 几 ms）。
    wire up_fall   = !up_ff2   &&  up_prev;
    wire down_fall = !down_ff2 && down_prev;
    //  ⭐⭐ 2026-10-17：⭐ **每路的"可否出声"判据**
    //     · ⭐ `*_blank_q != 0` = 该路**还在** blank 期内 ⇒ ⛔ 不许出声
    //     · ⚠️ **本拍正在掉回低的那一路【豁免】**：
    //        ⭐ 见 `down_fall` 处的例子（"从 DOWN 直接切到 UP"）——
    //          ⭐ 那一拍 DOWN 刚掉低（⇒ 该启动 blank），⭐ 而 UP 正在起沿（⇒ 必须放行）✅
    //     ⚠️ **本行⛔ 不看 `both_low`、⛔ 不看位置** ⇒ ⭐ 它不是位置门控
    //        （⭐ 完整辨析见文件头"位置门控 vs 同路 blank"那段对照 ✅）
    wire up_ok   = !up_rise   || (up_blank_q   == 32'd0) || up_fall;
    wire down_ok = !down_rise || (down_blank_q == 32'd0) || down_fall;
    //  ⭐ "两路都低" = 摇杆在中位（⭐ 现在**只是观测量**，⛔ 不参与判决）
    wire both_low  = !up_ff2 && !down_ff2;

    //  ⚠️ **`armed_o` 已失去语义**（⭐ 门控删了 ⇒ 没有"武装"这个概念了）：
    //     ⭐ 恒 `1'b1` ⇒ ⭐ 语义 = "本模块**随时**接受下一个沿（⭐ 只要不在 refractory）"✅
    //     📌 **保留端口**是因为 `top.v:4526-4527` 已把它接进 `syn_keep`
    //        （⭐ 动它就要动 `top.v`，⭐ 而本任务只要求删门控）✅
    //     📌 **诊断价值**：⭐ "为什么这一拨没响"现在只剩**一个**原因 = `refractory_q`
    //        （⭐ 要看它需要另接探针，⛔ 本模块没引出）✅
    assign armed_o    = 1'b1;
    assign both_low_o = both_low;

    always @(posedge clk_i) begin
        if (!rst_n_i) begin
            up_ff1        <= 1'b0;
            up_ff2        <= 1'b0;
            down_ff1      <= 1'b0;
            down_ff2      <= 1'b0;
            up_prev       <= 1'b0;
            down_prev     <= 1'b0;
            refractory_q  <= 32'd0;
            //  ⭐⭐ 2026-10-16：⭐ **新寄存器必须一起复位**（⭐ 本项目已踩过这个坑：
            //     "加寄存器时漏了复位 ⇒ 初值是 X ⇒ X 到处传播"——见
            //     `event_extract.v:532-535` 的同名教训 ✅）
            up_blank_q     <= 32'd0;
            down_blank_q   <= 32'd0;
            pluck_valid_o <= 1'b0;
            pluck_up_o    <= 1'b0;
        end else begin
            up_ff1    <= pluck_up_async_i;
            up_ff2    <= up_ff1;
            down_ff1  <= pluck_down_async_i;
            down_ff2  <= down_ff1;
            up_prev   <= up_ff2;
            down_prev <= down_ff2;

            pluck_valid_o <= 1'b0;

            //  ═══════════════════════════════════════════════════════════════
            //  ⭐⭐ 2026-10-17（v3）：⭐ **下降沿后同路 blank 的倒计时（逐路）**
            //  ═══════════════════════════════════════════════════════════════
            //  ⚠️ **顺序很重要**：⭐ `*_fall` 置数**必须写在**递减**之后**
            //     （⭐ Verilog 同块内【后写覆盖先写】）⇒
            //     ⭐ 于是"本拍刚掉回低"会**重新装满**新窗口，
            //     ⛔ 不会被同拍的递减吃掉。
            //  ⚠️ **延迟 = 0**：⭐ 本逻辑⛔ 不让任何事件变慢
            //     —— ⭐ 它只是**漏掉一次错误的沿**（⭐ 满足题目 ≤5 ms 要求 ✅）
            if (up_blank_q   != 32'd0) up_blank_q   <= up_blank_q   - 32'd1;
            if (down_blank_q != 32'd0) down_blank_q <= down_blank_q - 32'd1;
            if (up_fall)   up_blank_q   <= BLANK_N;
            if (down_fall) down_blank_q <= BLANK_N;

            //  ── 判决 ───────────────────────────────────────────────────────
            //     ⭐ 节流一 = `refractory_q`（⭐ 挡极近抖动）
            //     ⭐ 节流二 = `*_blank_q`（⭐ v3：⭐ 挡"本路掉低后立刻又起沿"）
            //     ⚠️ **本判据对 UP/DOWN 对称**（⭐ 两路都有各自的 blank）⇒
            //        ⭐ 不预设是哪一路有问题；
            //        ⭐ 但**只有 DOWN 会真的被触发到** ——
            //          ⭐ 因为 UP 的松手回中产生的是 `1→0`（⛔ 本就不产生上升沿），
            //            ⭐ 这正是用户实测"上拨没这个问题"的结构性原因 ✅
            if (refractory_q != 32'd0) begin
                refractory_q <= refractory_q - 32'd1;
            end else if ((up_ok && up_rise) || (down_ok && down_rise)) begin
                pluck_valid_o <= 1'b1;
                //  ⭐ **UP 优先**（⭐ 两路同拍都放行时 UP 胜 —— 与改动前逐位一致）✅
                //     ⚠️ 这里是 `up_ok && up_rise`（⛔ 不是裸 `up_rise`）：
                //        ⭐ 若 UP 被自己的 blank 挡住而 DOWN 放行 ⇒ 发 **DOWN**
                //          ⇒ ⭐ 这正是"DOWN 刚掉低、UP 正在起沿"时的正确行为 ✅
                pluck_up_o    <= (up_ok && up_rise); // UP wins if both edges pass.
                refractory_q  <= REFRACT_CYC;
            end
        end
    end
endmodule

`default_nettype wire
