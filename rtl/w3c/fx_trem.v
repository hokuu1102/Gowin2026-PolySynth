`timescale 1ns/1ps
// ============================================================================
// fx_trem.v -- 音量颤音（Tremolo）· W3c 出声通路的【效果器链第 5 级（最后一级）】
//
//  位置：… → [延迟] → [混响·留位直通] → [音量颤音] → master_mix → i2s_tx
//
// ---------------------------------------------------------------------------
// 为什么放在【最后一级】（用户 2026-10-14 裁定）
// ---------------------------------------------------------------------------
//  · 最便宜：紧挨 master_mix，而 master_mix 已有乘法器 ⇒ 可能 0 额外 DSP
//  · 音乐上正确：真实音箱自带的 tremolo 就是后级，调制整个信号（含回声）
//  · 与推子同处一条增益链：用户要求音量颤音与音高颤音【共用推子】，
//    而推子本来就在那条增益链上
//  · 互相独立：关掉延迟不影响颤音；关掉颤音不影响延迟
//  📌 另一种味道是放在延迟【之前】（回声里带颤音）。
//     将来要换只改 fx_chain 里的连线顺序，⛔ 不用动本模块。
//
// ---------------------------------------------------------------------------
// ⚠️ 一处【有意偏离】文档的地方（如实记录）
// ---------------------------------------------------------------------------
//  文档 `效果器链-整合方案-20261014.md` §3.2 写的是"复用 vibrato_lfo 的 LFO 输出"。
//  🔴 但那需要给 `rtl/w3a/vibrato_lfo.v` **加一个输出端口** ——
//     而它是**上板验证过的模块**（`deliver: 'A' + vibrato board-verified`）。
//  ✅ 所以本模块**自带一个小 LFO**（约 30 LUT）：
//     · 零耦合：不碰 vibrato_lfo，不影响音高颤音
//     · 独立速率：音量颤音的速率可以跟音高颤音不同（更灵活）
//     · 代价：多 30 LUT（相对"复用"）
//  📌 两者都要跟同一个推子走（用户要求共用推子），但那是在 top.v 的
//     `fader_gear` 那层做的，⛔ 与本模块无关。
//
// ---------------------------------------------------------------------------
// 算法
// ---------------------------------------------------------------------------
//  ① LFO：相位累加 + 三角波
//       phase += rate_i（每个样点一次）
//       tri   = phase[最高位] ? ~phase : phase      （0 .. 2^LFO_W−1 的三角波）
//  ② 深度换算成衰减量（全用移位，⛔ 不需要额外乘法器）
//       t8   = tri 的高 8 位（Q0.8，0..255）
//       att  = (depth_i × (255 − t8)) >> 8          （Q0.8 的衰减量）
//       g    = 256 − att                            （Q0.8 的增益，256 = 单位增益）
//       ⚠️ depth=0 ⇒ att=0 ⇒ g=256 ⇒ **逐位等于输入**（等于旁路，但走乘法器）
//  ③ 输出
//       out = (sample × g) >> 8
//  ④ 饱和：逐位溢出判断（K-101，⛔ 不用 signed 比较），与 master_mix / fx_dist 同一套
//
// ---------------------------------------------------------------------------
// 硬旁路（en_i = 0）
// ---------------------------------------------------------------------------
//  out = en ? 颤音输出 : 输入延迟同样拍数
//  => 数值【逐位等于输入】（零回归的保证）
//  ⚠️ 如实说明：旁路走的是【同一条流水线】，数值相同但时序差 PIPE 拍。
//
// ---------------------------------------------------------------------------
// 流水线（PIPE = 3 拍）
// ---------------------------------------------------------------------------
//  | 拍 | 动作 |
//  |----|------|
//  | N   | `valid_i`：锁存样点 / LFO / 深度 |
//  | N+1 | 乘法（sample × g） |
//  | N+2 | 输出寄存 ⇒ `sample_o` |
//  ⚠️ `valid_i` 的脉冲间距必须 ≥ PIPE 拍（真实链路每 1024 拍一个样点，够）。
//
// ---------------------------------------------------------------------------
// 纪律（本项目血泪）
// ---------------------------------------------------------------------------
//  · Verilog-2001 语法（K-91）；组合逻辑用 assign（L67）；算术 wire 显式位宽。
//  · 饱和不用 signed 比较（K-101）⇒ 逐位溢出判断。
//  · 声明必须先于使用。
//  · 可观测（K-106）：LFO 当前值 / 当前增益 / 生效的深度与速率 —— 全部有输出。
//  · 单样本链不反压：valid_i 是脉冲，valid_o 与 sample_o 同拍。
// ============================================================================
`default_nettype none

module fx_trem #(
    // 样点位宽（与 master_mix / i2s_tx 一致 = 24）
    parameter integer SAMPLE_W = 24,
    // LFO 相位位宽（16 ⇒ 三角波周期 = 2×65536/rate 个样点）
    parameter integer LFO_W    = 16,
    // 深度位宽（Q0.8；256 = 满深度，即增益在 1 与 ~0 之间摆）
    parameter integer DEPTH_W  = 8,
    // 速率位宽（每样点相位增量；0 = LFO 静止）
    parameter integer RATE_W   = 8,
    // 复位后的默认深度（Q0.8；0.5 = 128 => 上电就有一半深度，便于上板听出来）
    parameter [DEPTH_W-1:0] DEPTH_DEFAULT = 8'd128,
    // 复位后的默认速率（≈ 5 Hz：rate = 5 × 2^16 / 48828 ≈ 6.7 ⇒ 取 7）
    parameter [RATE_W-1:0]  RATE_DEFAULT  = 8'd7
) (
    input  wire                        clk_i,
    input  wire                        rst_n_i,     // 同步复位、低有效

    // ── 单样本流（与 master_mix 同一约定：valid_i 是脉冲，不反压）────────
    input  wire                        valid_i,
    input  wire signed [SAMPLE_W-1:0]  sample_i,

    // ── 控制（全部来自 top.v 的寄存器；本模块不解析串口）────────────────
    input  wire                        en_i,        // 0 = 硬旁路（输出 == 输入）
    input  wire [DEPTH_W-1:0]          depth_i,     // 深度（Q0.8）
    input  wire [RATE_W-1:0]           rate_i,      // 速率（每样点相位增量）

    // ── 输出 ──────────────────────────────────────────────────────────────
    output reg                         valid_o,
    output reg  signed [SAMPLE_W-1:0]  sample_o,

    // ── 可观测性（K-106：不许静默失效）────────────────────────────────────
    output wire [LFO_W-1:0]            lfo_o,       // 当前 LFO 相位（三角波源）
    output wire [7:0]                  tri_o,       // 当前三角波高 8 位（Q0.8）
    output wire [DEPTH_W:0]            gain_o,      // 当前增益（Q0.8；256 = 单位）
    output wire [DEPTH_W-1:0]          depth_used_o,
    output wire [RATE_W-1:0]           rate_used_o
);

    // ═══════════════════════════════════════════════════════════════════════
    // ① 常量
    // ═══════════════════════════════════════════════════════════════════════
    localparam integer PIPE   = 3;                 // 流水线深度
    localparam integer SUM_W  = SAMPLE_W + DEPTH_W + 1;   // 乘法中间位宽

    localparam signed [SAMPLE_W-1:0] FS_MAX = {1'b0, {(SAMPLE_W-1){1'b1}}};
    localparam signed [SAMPLE_W-1:0] FS_MIN = {1'b1, {(SAMPLE_W-1){1'b0}}};

    localparam [DEPTH_W-1:0] DEPTH_DEF = DEPTH_DEFAULT;
    localparam [RATE_W-1:0]  RATE_DEF  = RATE_DEFAULT;

    //  单位增益的 Q0.8 表示（256 ⇒ 需要 DEPTH_W+1 位）
    localparam [DEPTH_W:0]   ONE_Q = (1 << DEPTH_W);

    // ═══════════════════════════════════════════════════════════════════════
    // ② 参数寄存器
    // ═══════════════════════════════════════════════════════════════════════
    reg [DEPTH_W-1:0] depth_r;
    reg [RATE_W-1:0]  rate_r;

    assign depth_used_o = depth_r;
    assign rate_used_o  = rate_r;

    // ═══════════════════════════════════════════════════════════════════════
    // ③ LFO：相位累加 + 三角波（只在 valid_i 时推进 ⇒ 速率与采样率绑定）
    // ═══════════════════════════════════════════════════════════════════════
    reg [LFO_W-1:0] phase;

    //  三角波：最高位为 0 时取原值（上升），为 1 时取反（下降）
    wire [LFO_W-1:0] tri_w = phase[LFO_W-1] ? (~phase) : phase;
    //  取高 8 位当 Q0.8（0..255）
    //  🔴 **我第一版写错在这里**（被 tb 的 T4a 抓到）：
    //     `tri_w = phase[15] ? ~phase : phase` ⇒ tri_w ∈ [0, 0x7FFF]，
    //     **只有 15 位有效**（相位最高位为 1 时取反，结果必然 ≤ 0x7FFF）。
    //     而我原来写 `tri_w[LFO_W-1 -: 8]` = `tri_w[15:8]` ⇒ **只用到 [0,127]** ✗
    //     ⇒ 增益只在 [2,129]/256 之间摆 ⇒ 🔴 **满深度时永远回不到单位增益**，
    //        颤音变成"整体压低 + 轻微起伏"，不是真正的 tremolo ✓
    //  ✅ 正确：15 位有效 ⇒ 取 `tri_w[14:7]` ⇒ 满量程 [0,255] ✓
    wire [7:0]       t8    = tri_w[LFO_W-2 -: 8];

    assign lfo_o = phase;
    assign tri_o = t8;

    // ═══════════════════════════════════════════════════════════════════════
    // ④ 增益换算（全移位，⛔ 不需要额外乘法器）
    //     att = (depth × (255 − t8)) >> 8      衰减量（Q0.8）
    //     g   = 256 − att                      增益（Q0.8，256 = 单位）
    // ═══════════════════════════════════════════════════════════════════════
    wire [7:0]          inv_t  = 8'd255 - t8;                      // 255−t8
    wire [DEPTH_W+7:0]  att_f  = depth_r * inv_t;                  // 8×8 ⇒ 16 位
    wire [DEPTH_W-1:0]  att    = att_f[15:8];                      // >>8 ⇒ Q0.8
    wire [DEPTH_W:0]    gain_w = ONE_Q - {1'b0, att};              // 256 − att

    // 接受样本时使用同拍深度；后续控制变化不能串入在途样本。
    wire [DEPTH_W+7:0] sample_att_f = depth_i * inv_t;
    wire [DEPTH_W-1:0] sample_att = sample_att_f >> 8;
    wire [DEPTH_W:0] sample_gain = ONE_Q - {1'b0, sample_att};

    assign gain_o = gain_w;

    // ═══════════════════════════════════════════════════════════════════════
    // ⑤ 乘法：out = sample × gain >> 8
    //    ⚠️ 增益用【锁存那一拍】的值，保证与样点同源（否则样点与增益错拍）
    // ═══════════════════════════════════════════════════════════════════════
    reg  [DEPTH_W:0]            g0;        // stage0 锁存的增益
    reg  signed [SAMPLE_W-1:0]  s0;        // stage0 锁存的样点
    reg  signed [SAMPLE_W-1:0]  s1, s2;    // 旁路用的延迟链
    reg  [PIPE-1:0]             v_sr;
    reg  [PIPE-1:0]             en_sr;
    reg  signed [SUM_W-1:0]     p1;
    reg  signed [SAMPLE_W-1:0]  y2;        // 有效数据与三拍 valid 对齐

    wire signed [SUM_W-1:0] prod = s0 * $signed({1'b0, g0});
    wire signed [SUM_W-1:0] shr  = p1 >>> DEPTH_W;

    //  溢出判断（K-101：逐位比较）
    //  ⚠️ 符号位取【真符号位】= 结果的最高位（不是第 SAMPLE_W-1 位）
    //     —— 这个坑我在 fx_dist 里踩过：溢出时第 SAMPLE_W-1 位只是幅值低位
    wire ovf = (shr[SUM_W-1:SAMPLE_W] != {(SUM_W-SAMPLE_W){shr[SUM_W-1]}});
    wire signed [SAMPLE_W-1:0] sat = ovf ? (shr[SUM_W-1] ? FS_MIN : FS_MAX)
                                         : shr[SAMPLE_W-1:0];

    // ═══════════════════════════════════════════════════════════════════════
    // ⑥ 时序
    // ═══════════════════════════════════════════════════════════════════════
    always @(posedge clk_i) begin
        if (!rst_n_i) begin
            depth_r <= DEPTH_DEF;
            rate_r  <= RATE_DEF;
            phase   <= {LFO_W{1'b0}};
            g0      <= {DEPTH_W+1{1'b0}};
            s0      <= {SAMPLE_W{1'b0}};
            s1      <= {SAMPLE_W{1'b0}};
            s2      <= {SAMPLE_W{1'b0}};
            v_sr    <= {PIPE{1'b0}};
            en_sr   <= {PIPE{1'b0}};
            p1      <= {SUM_W{1'b0}};
            y2      <= {SAMPLE_W{1'b0}};
            valid_o  <= 1'b0;
            sample_o <= {SAMPLE_W{1'b0}};
        end else begin
            // ── 参数（每拍都收）────────────────────────────────────────
            depth_r <= depth_i;
            rate_r  <= rate_i;

            // ── LFO 只在有样点时推进（速率与采样率绑定）─────────────────
            if (valid_i) phase <= phase + {{(LFO_W-RATE_W){1'b0}}, rate_i};

            // ── stage0（N → N+1）：锁存样点与增益 ───────────────────────
            s0 <= sample_i;
            g0 <= sample_gain;
            v_sr  <= {v_sr[PIPE-2:0],  valid_i};
            en_sr <= {en_sr[PIPE-2:0], en_i};

            // ── stage1（N+1 → N+2）：乘法 ───────────────────────────────
            s1 <= s0;
            p1 <= prod;

            // ── stage2（N+2 → N+3）：输出 ───────────────────────────────
            s2 <= s1;
            y2 <= sat;
            valid_o  <= v_sr[PIPE-1];
            //  旁路：en = 0 时输出【输入延迟 PIPE 拍】=> 数值逐位等于输入
            sample_o <= en_sr[PIPE-1] ? y2 : s2;
        end
    end

endmodule
