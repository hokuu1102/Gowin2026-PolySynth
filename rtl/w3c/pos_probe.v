// ============================================================================
//  pos_probe.v —— `'P'` 诊断命令：把 `pos` 读数回传到串口（⭐ 2026-09-24 新增）
//
//  ═══════════════════════════════════════════════════════════════════════════
//  🔴 **为什么需要它**（⭐ 上板实测）
//  ═══════════════════════════════════════════════════════════════════════════
//
//  ⭐ 上板跑 `'S'`（逐轴 span 标定）⇒ 现象：
//     · 只回 `s`（受理）+ 一次轴号 `0`，⭐ 之后**全是 `!`（被拒）**
//     · ⭐ 而且**按不按都拒**，⭐ 每个 `!` **正好隔 1 秒**
//     ⇒ ⭐ `WAIT_TIMEOUT_CLK = 50_000_000` = **1.0 秒** ⇒ 🔴 **是超时**
//
//  🔴 **超时的含义**：⭐ `calib_span` 在 `S_SETTLE` 等"连续 `STABLE_NEED` 帧
//     变化 < `STABLE_TOL`" ⇒ ⚠️ **一帧都没等到** 或 ⚠️ **读数一直在抖**
//
//  ⚠️ **而串口【看不到任何 `pos` 值】** ⇒ 🔴 **没法判断是哪种**
//  ⇒ ⭐⭐ **本模块就是为此而生**：⭐ 发 `'P'` ⇒ ⭐ **回一个十进制读数**
//
//  ═══════════════════════════════════════════════════════════════════════════
//  ⭐ 输出格式（⭐ 人类可读，⭐ 串口助手 ASCII 模式即可）
//  ═══════════════════════════════════════════════════════════════════════════
//
//  ⭐ 每次收到 `probe_req_i` ⇒ 回一行：
//
//      ⭐ `P<pos>\r\n`        （⭐ 如 `P0744\r\n`）
//
//  · `P`       —— ⭐ 固定前缀（⭐ 便于人眼定位，⭐ 也便于脚本解析）
//  · `<pos>`   —— ⭐ **4 位十进制**，⭐ 左边补 `0`（⚠️ 12 位最大 4095，⭐ 4 位够）
//  · `\r\n`    —— ⭐ 行尾（⭐ 串口助手按行显示）
//                    ⇒ ⭐ **一共 7 个字节**
//
//  ═══════════════════════════════════════════════════════════════════════════
//  ⭐⭐ 设计要点
//  ═══════════════════════════════════════════════════════════════════════════
//
//  ① ⭐ **`push_o` 是"喂给 `uart_tx_fifo` 的请求"** —— ⚠️ 不是直接喂 `uart_tx`
//     ⇒ ⭐ 所以要接 `ready_i` ⇒ ⚠️ 对方满了就等，⛔ 别硬塞（⭐ `K-126` 的教训）
//
//  ② ⭐ **一次 `probe_req_i` 产生 7 个字节** ⇒ ⭐ 用一个小状态机逐个推
//
//  ③ 🔴🔴 **BCD 转换必须【流水化】**（⭐ 2026-09-24 PnR 实测后重写）：
//     ⚠️ 第一版把"比较 → 减 → 比较 → 减 → 比较 → 减"写成**一整条组合链**
//     ⇒ 🔴 **最差时序路径 23.519 ns**（⭐ 目标 20 ns）
//        ⇒ ⭐ **Actual Fmax 从 54.6 MHz 掉到 50.011 MHz**（⭐ 余量只剩 0.02%）
//     📌 时序报告原文：⭐ 最差路径就是 `g_sound.u_pos_probe` 的 `pos_lat→d3→r3→d2→r2→d1→d0`
//     ✅ **修法**：⭐ **每一级各占一个时钟**（⭐ 见 `bcd_stage` 计数器）
//        ⚠️ 代价：⭐ 转换晚 4 拍 = **80 ns** —— ⭐ 诊断命令，✅ 完全无所谓
//
//  ④ ⭐ **用一个 `bcd_stage` 计数器驱动流水**（⭐ 比多写几个状态机清楚）
//
//  ⑤ ⭐ **Verilog-2001**（⭐ `K-91`）· ⭐ **声明先于使用**（⭐ `L66`）
//
// ============================================================================

module pos_probe #(
    // ⭐ 一次回传的字节数：'P' + 1 位 hex 通道号 + 4 位数字 + CR + LF = 8
    //   🔴 2026-09-24 扩展：⭐ 原来是 7（无通道号）——
    //      ⚠️ 上板查 `span` 失败时发现"光有读数不够"：
    //         ⭐ 必须知道**这个读数属于哪个通道**才能判断 `calib_span` 为什么被拒。
    parameter integer N_BYTES = 8,
    // ⭐⭐ 2026-09-27 新增：**回包前缀字符**（⭐ 让本模块能被复用给别的诊断命令）
    //   · `'P'`(0x50) = 回 `af0_pol`（⭐ 极性校正后的**原始码**）
    //   · `'N'`(0x4E) = 回 `calib` 后的 **`pos`**（⭐ 判键用的那个数）
    //   📌 为什么提成参数：⭐ 两条命令**必须能从回包前缀区分**，
    //      ⚠️ 否则 PC 侧解析不出"这个数是谁"。⛔ 不改其余逻辑。
    parameter [7:0]   PREFIX  = 8'h50
) (
    input  wire        clk_i,
    input  wire        rst_n_i,

    // ── ⭐ 触发（⭐ 来自 `calib_cmd.probe_req_o`，⭐ 单拍脉冲）──────────────
    input  wire        probe_req_i,

    // ── ⭐ 要回传的读数（⭐ 来自 `top.v` 的 `af0_pol`）────────────────────────
    input  wire [11:0] pos_i,
    // ── ⭐ 同时回传【当前采样通道】（⭐ 2026-09-24 扩展）──────────────────────
    //   ⭐ 来自 `af_sample_ch` ⇒ ⭐ 一眼看出"这个读数属于哪个通道"
    //   ⭐⭐ 2026-09-27：⭐ **扩到 4 位** —— `'N'` 用它回传【轴号 0~15】，
    //      ⚠️ 3 位装不下 16 个轴（⭐ 轴 8~15 会与 0~7 混淆 ⇒ 分不清是谁）。
    //      📌 `'P'` 只用到 0~7（⭐ 每片 8 通道）⇒ ⭐ 高位恒 0，✅ 兼容。
    input  wire [3:0]  ch_i,

    // ── ⭐ 下游：`uart_tx_fifo` 的推入口 ──────────────────────────────────
    output reg         push_o,       // ⭐ 当拍有效即入队
    output reg  [7:0]  data_o,
    input  wire        ready_i,      // ⭐ 下游未满（⭐ 来自 `tx_fifo.ready_o`）
    input  wire        idle_i,       // ⭐ **下游彻底空闲**（⭐ 来自 `tx_fifo.idle_o`）

    output reg         busy_o        // ⭐ 正在回传（⭐ 可观测）
);

    // ── ⭐ 常量 ───────────────────────────────────────────────────────────
    localparam [2:0] S_IDLE = 3'd0;
    localparam [2:0] S_BCD  = 3'd1;   // ⭐ BCD 流水（4 拍）
    localparam [2:0] S_SEND = 3'd2;   // ⭐ 逐字节推
    // ⭐⭐ 收尾一拍（⭐ 2026-09-24 新增，⭐ 修"每包多发 1 字节"）
    //   📌 **为什么需要独立一拍**：⭐ `push_o` 是【寄存器输出】⇒
    //      ⚠️ 最后一拍置 1 后，⭐ 若【同拍】就跳回 `S_IDLE`，
    //         🔴 下一拍 `push_o` 仍是 1（⭐ 非阻塞赋值的下一拍才生效）
    //         ⇒ 🔴 **多推一个字节**（⭐ `data_o` 此时已被 `idx=0` 的组合逻辑改成 `'P'`）。
    //      ⭐ 实测：⭐ 发一次 `'P'` ⇒ 板子回 **9 字节** `P52900\r\nP`，
    //         ⚠️ 那个尾巴会**黏在下一次回包前面** ⇒ ⭐ 看起来像"包不完整"。
    localparam [2:0] S_DONE = 3'd3;   // ⭐ 收尾（⭐ 不推字节，⭐ 只把 push_o 拉低）

    // ── ⭐ 声明（⭐ 全部先于使用 —— `L66`）────────────────────────────────
    reg  [2:0]  state;
    reg  [2:0]  bcd_stage;           // ⭐ 0..3
    reg  [3:0]  idx;                 // ⭐ 0..6
    reg  [11:0] pos_lat;             // ⭐ 锁存的读数
    reg  [3:0]  ch_lat;              // ⭐ 锁存的通道号/轴号（⭐ 2026-09-27：3→4 位）
    reg  [11:0] rem;                 // ⭐ BCD 流水里的"剩余值"
    reg  [3:0]  bcd3, bcd2, bcd1, bcd0;

    // ⭐ 组合：⭐ 当前"剩余值"对应的那一位数字（⭐ 纯比较器，⭐ 链很短）
    //   ⚠️ 注意：⭐ 这个比较器只用于【百 / 十 / 个】三位（⭐ 阈值 100 段）
    //      🔴 **千位【必须】用单独的比较器**（⭐ 阈值是 1000/2000/3000/4000）——
    //         ⚠️ 我第一版复用了这里 ⇒ 744 算出 bcd3=7（⭐ 错的）
    reg [3:0] cur_digit;
    always @(*) begin
        if      (rem >= 12'd900) cur_digit = 4'd9;
        else if (rem >= 12'd800) cur_digit = 4'd8;
        else if (rem >= 12'd700) cur_digit = 4'd7;
        else if (rem >= 12'd600) cur_digit = 4'd6;
        else if (rem >= 12'd500) cur_digit = 4'd5;
        else if (rem >= 12'd400) cur_digit = 4'd4;
        else if (rem >= 12'd300) cur_digit = 4'd3;
        else if (rem >= 12'd200) cur_digit = 4'd2;
        else if (rem >= 12'd100) cur_digit = 4'd1;
        else                     cur_digit = 4'd0;
    end

    // ⭐ 千位比较器（⭐ 阈值 1000 的整数倍）—— ⚠️ **与上面那个分开**
    reg [3:0] cur_thou;
    always @(*) begin
        if      (rem >= 12'd4000) cur_thou = 4'd4;
        else if (rem >= 12'd3000) cur_thou = 4'd3;
        else if (rem >= 12'd2000) cur_thou = 4'd2;
        else if (rem >= 12'd1000) cur_thou = 4'd1;
        else                      cur_thou = 4'd0;
    end

    // 🔴 **十位比较器（⭐ 阈值 10 的整数倍）—— 也必须【独立】**
    //   ⚠️ 我第二版复用了 `cur_digit`（⭐ 100 段）⇒ 🔴 **rem=50 时给 0**
    //      ⇒ ⭐ 2050 算出 `P2002`（⭐ 十位丢、⭐ 个位拿错）
    reg [3:0] cur_ten;
    always @(*) begin
        if      (rem >= 12'd90) cur_ten = 4'd9;
        else if (rem >= 12'd80) cur_ten = 4'd8;
        else if (rem >= 12'd70) cur_ten = 4'd7;
        else if (rem >= 12'd60) cur_ten = 4'd6;
        else if (rem >= 12'd50) cur_ten = 4'd5;
        else if (rem >= 12'd40) cur_ten = 4'd4;
        else if (rem >= 12'd30) cur_ten = 4'd3;
        else if (rem >= 12'd20) cur_ten = 4'd2;
        else if (rem >= 12'd10) cur_ten = 4'd1;
        else                    cur_ten = 4'd0;
    end

    // ⭐ 当前该减多少（⭐ 常数移位加法，⛔ 不用乘法器 ⇒ 时序好）
    //   ⭐ `cur_digit × 100` = `(cur_digit×64) + (cur_digit×32) + (cur_digit×4)`
    //      ⇒ ⚠️ 但为了**可读性**和**资源**，⭐ 直接用 12 位常数乘法 ——
    //         ⚠️ Gowin 会用 LUT 拼，⭐ 而它【在寄存器之间】⇒ 不叠在前级比较器上
    wire [11:0] cur_x100 = {8'd0, cur_digit} * 12'd100;

    // ⭐ 当前该发哪个字节（⭐ 纯组合查表）
    //   ⭐ 0='P' · 1..4=千/百/十/个 · 5=CR · 6=LF
    reg [7:0] tx_byte_c;
    always @(*) begin
        case (idx)
            4'd0:    tx_byte_c = PREFIX;                      // ⭐ 'P' 或 'N'
            // ⭐ 新增：⭐ 1 位十六进制通道号（⭐ 0..7 ⇒ '0'..'7'）
            //   📌 用 hex 而不是 dec 的原因：⭐ 位宽固定 1 字节，⭐ 且 0~7 两者相同
            //   ⭐⭐ 2026-09-27：⭐ 改成**十六进制**（'0'..'9'/'A'..'F'）——
            //      `'N'` 要回传轴号 0~15，⚠️ 十进制两位会撑破 1 字节。
            //      📌 `'P'` 的通道号 0~7 在两种进制下**写法相同** ⇒ ✅ 兼容。
            4'd1:    tx_byte_c = (ch_lat < 4'd10) ? (8'h30 + {4'd0, ch_lat})
                                                  : (8'h41 + ({4'd0, ch_lat} - 8'd10));
            4'd2:    tx_byte_c = 8'h30 + {4'd0, bcd3};        // '0'..'9'
            4'd3:    tx_byte_c = 8'h30 + {4'd0, bcd2};
            4'd4:    tx_byte_c = 8'h30 + {4'd0, bcd1};
            4'd5:    tx_byte_c = 8'h30 + {4'd0, bcd0};
            4'd6:    tx_byte_c = 8'h0D;                       // CR
            default: tx_byte_c = 8'h0A;                       // LF
        endcase
    end

    // ── ⭐ 时序 ───────────────────────────────────────────────────────────
    always @(posedge clk_i) begin
        if (!rst_n_i) begin
            state     <= S_IDLE;
            bcd_stage <= 3'd0;
            idx       <= 4'd0;
            pos_lat   <= 12'd0;
            ch_lat    <= 4'd0;
            rem       <= 12'd0;
            bcd3      <= 4'd0;
            bcd2      <= 4'd0;
            bcd1      <= 4'd0;
            bcd0      <= 4'd0;
            push_o    <= 1'b0;
            data_o    <= 8'd0;
            busy_o    <= 1'b0;
        end else begin
            // ⭐ 默认：`push_o` 单拍
            push_o <= 1'b0;

            case (state)
                // ── ⭐ 等触发 ────────────────────────────────────────────
                S_IDLE: begin
                    busy_o <= 1'b0;
                    // 🔴🔴 **必须同时满足 `idle_i`**（⭐ 2026-09-24 上板修）
                    //   ⚠️ **原来只判 `probe_req_i`** ⇒ 🔴 **上板实测的 bug**：
                    //      ⭐ 连发 `'P'` 时，⭐ 上一个包的 7 个字节**还在 FIFO 里排队**
                    //      ⇒ ⚠️ 新包的字节【接在旧包后面】⇒ 🔴 **PC 按行读就错位**：
                    //         有时先冒出一个孤立数字（⭐ 旧包尾巴），⭐ 再跟新包
                    //         eg. `0\n\nP217`
                    //   ✅ 修法：⭐ **等 `idle_i`（队列空 且 发送器停）才开新包**
                    //      ⇒ ⭐ 包与包之间【干净分开】✅
                    //   📌 `ready_i`（⭐ 未满）⛔ **不够** —— ⚠️ 它只保证"塞得进去"，
                    //      ⛔ 不保证"上一个包发完了"。
                    if (probe_req_i && idle_i) begin
                        // 🔴 **锁存读数**（⭐ 否则回传期间读数变了 ⇒ 同一行数字不自洽）
                        pos_lat   <= pos_i;
                        ch_lat    <= ch_i;   // ⭐ 同拍锁存通道号
                        rem       <= pos_i;      // ⭐ 流水从"整值"起步
                        bcd_stage <= 3'd0;
                        idx       <= 4'd0;
                        state     <= S_BCD;
                        busy_o    <= 1'b1;
                    end
                end

                // ── ⭐ BCD 流水：⭐ 每拍算一位 ─────────────────────────────
                //   ⚠️ 本状态【不依赖 `ready_i`】—— ⭐ 它只做算术，⭐ 与下游无关
                S_BCD: begin
                    busy_o <= 1'b1;
                    // ⭐ 注意：`rem` 是【上一拍寄存】的值 ⇒ 比较器链很短
                    case (bcd_stage)
                        3'd0: begin                       // ⭐ 千位
                            bcd3 <= cur_thou;
                            rem  <= rem - ({8'd0, cur_thou} * 12'd1000);
                            bcd_stage <= 3'd1;
                        end
                        3'd1: begin                       // ⭐ 百位
                            bcd2 <= cur_digit;
                            rem  <= rem - cur_x100;
                            bcd_stage <= 3'd2;
                        end
                        3'd2: begin                       // ⭐ 十位
                            bcd1 <= cur_ten;
                            //   🔴 **位宽必须写够**：⭐ 原来写 `cur_ten * 4'd10`
                            //      ⇒ ⚠️ 4 位 × 4 位 = **4 位** ⇒ 🔴 `9×10=90` 被截成 `10`
                            //      ⇒ ✅ 改成 `12'd10` ⇒ ⭐ 结果升到 12 位，⛔ 不丢
                            rem  <= rem - ({8'd0, cur_ten} * 12'd10);
                            bcd_stage <= 3'd3;
                        end
                        default: begin                    // ⭐ 个位（⭐ 余数就是它）
                            bcd0 <= rem[3:0];
                            bcd_stage <= 3'd0;
                            state <= S_SEND;
                        end
                    endcase
                end

                // ── ⭐ 逐个推字节（⭐ 只在 `ready_i` 时推进）───────────────
                S_SEND: begin
                    busy_o <= 1'b1;
                    if (ready_i) begin
                        push_o <= 1'b1;
                        data_o <= tx_byte_c;

                        if (idx == (N_BYTES[3:0] - 4'd1)) begin
                            idx    <= 4'd0;
                            state  <= S_DONE;      // ⭐ 先过一拍收尾，⛔ 不直接回 IDLE
                            busy_o <= 1'b1;
                        end else begin
                            idx <= idx + 4'd1;
                        end
                    end
                end

                // ── ⭐ 收尾一拍（⭐ 2026-09-24 新增）─────────────────────
                //   ⭐ 本拍【不推字节】，⭐ 只把 `push_o` 明确拉低
                //   📌 这样最后一拍推的字节不会因为"跳回 IDLE"而被重复计入 ✅
                S_DONE: begin
                    push_o <= 1'b0;
                    busy_o <= 1'b0;
                    state  <= S_IDLE;
                end

                default: state <= S_IDLE;
            endcase
        end
    end

endmodule
