`timescale 1ns/1ps
// ─────────────────────────────────────────────────────────────────────────────
// uart_tx.v · UART 发送器（8N1：1 起始 + 8 数据 + 1 停止）—— W3c（回传通路）
//
// ⭐ 来源：**移植自已有工程** `Desktop/FPGA/FPGA招新题/phase4/uart_tx.v`（8N1，已验证）。
//   ⭐ 原版是**已验证过的**（`FPGA招新题/phase4/uart_tx_tb.v` 跑过）。
//   ✅ 本次**只做"符合本项目规范"的移植**，⛔ 不改状态机语义：
//     ① ⭐ **复位风格：异步 → 同步**（⭐ 与本项目 `uart_rx.v` 统一）
//     ② ⭐ **内建波特率发生器**（⭐ 原版外挂 `uart_baud_gen` 实例）
//        ⇒ ⚠️ 理由：⭐ 本项目 `uart_rx.v` 就是**自包含**的（内部算 `MID_CNT` 等）
//           ⇒ ⭐ 两者风格统一，⛔ 且少一个文件、少一处 `.gprj` 登记机会
//     ③ ⭐ **`busy_o` 语义明确**：⭐ 发送期间为高（⭐ 调用方据此判断"能不能喂下一个字节"）
//     ④ ⭐ 加本项目的头部注释与参数自检
//
// ── ⭐ 设计要点（沿用原版，已实测）──────────────────────────────────────────
//   1. ⭐ **空闲态 `tx = 1`**（⭐ 串口空闲是高电平）—— ⚠️ 复位值就是 1
//   2. ⭐ **数据在"启动的那一拍"锁存**（`tx_data_r <= tx_data_i`）
//      ⇒ ⚠️ 否则发送中外部改数据 ⇒ 🔴 发出去的是"混合字节"（⭐ 隐蔽 bug）
//   3. ⭐ **`tx_done_o` 是单周期脉冲**（⭐ 与 `uart_rx.rx_done_o` 同一约定）
//   4. ⭐ **LSB 先发**（⭐ `tx_data_r[0]` 先）—— ⚠️ 与 `uart_rx` 的 LSB 先收对称
//
// ── ⭐ 位序（8N1，共 10 位）──────────────────────────────────────────────────
//   ```
//   空闲  起始    D0  D1  D2  D3  D4  D5  D6  D7   停止   空闲
//    1     0      ←──── LSB 先 ────→              1
//   ```
//
// ── ⚠️ 波特率必须与 `uart_rx` / `evt_uart_rx` / `calib_cmd` 【同一档】────────
//   🔴 **不一致会【静默收乱码】**（⚠️ 不报错、不崩溃，只是数据全错）
//      | 波特率 | `BAUD_DIV` | 50MHz/baud | 误差 |
//      |---|---|---|---|
//      | ⭐ **1 M**（默认） | **50** | 50.000 | ⭐ **0%（整除）** |
//      | **500 k**（退档首选） | **100** | 100.000 | ⭐ **0%（整除）** |
//      | 460800 | 108 | 108.51 | ⚠️ 0.47% |
//      | 115200 | 434 | 434.028 | 0.006% |
//   ⭐ **切档时四处一起改**（⭐ 见 `top.v` 里 `u_uart_rx` / `u_calib_cmd` / `u_evt_uart_rx`）。
//
// ── 🔴 本模块的用途（⭐ 为什么必须有）────────────────────────────────────────
//   ⭐ 它填的是**唯一的"反向通路"缺口** ——
//      ⚠️ 没有它，⭐ **`span` 标定没有任何进度回传**：
//         · 操作者不知道现在标到第几个轴
//         · 不知道刚才是"通过"还是"被拒绝"
//         ⇒ 🔴 **16 轴逐个按到底的流程几乎没法可靠完成**
//   ⇒ ⭐ **本轮接入后，标定流程才真正可用**。
//
// ── ⛔ 纪律（本项目血泪）────────────────────────────────────────────────────
//   · ⭐ **Verilog-2001 语法**（`K-91`：Gowin 按 Verilog-2001 编译，
//     用 SV 专有构造 ⇒ **整个模块被丢弃**，而**仿真全绿**）
//   · ⭐ **同步复位、低有效**（冻结表 §〇 约定 2）· ⭐ **单时钟域 50 MHz**（约定 1）
//   · ⭐ **组合逻辑用 `assign`**（`L67`）
//   · ⭐ **参与算术的 wire 一律显式写位宽**（⚠️ 不写就是 1 位 ⇒ 截断）
//   · 🔴 **不对 `integer` 参数做位选**（`K-91`）—— ⭐ 先赋值给定宽 localparam
// ─────────────────────────────────────────────────────────────────────────────
`default_nettype none

module uart_tx #(
    // ⭐ 每 bit 的 clk 数 = round(50 MHz / 波特率)
    //    ⚠️ 必须 >= 2（否则"每 bit 一个 tick"没有意义）
    parameter integer BAUD_DIV = 50         // ⭐ 默认 **1 Mbps**（= 50 MHz / 1e6，整除）
) (
    input  wire       clk_i,        // ⭐ 50 MHz（冻结表约定 1：单时钟域）
    input  wire       rst_n_i,      // ⭐ **同步**复位、低有效（约定 2）

    // ── 发送接口（⭐ 与 `uart_rx` 对称）──────────────────────────────────
    input  wire       tx_start_i,   // ⭐ 启动发送（⭐ `busy_o=0` 时有效的单周期脉冲）
    input  wire [7:0] tx_data_i,    // ⭐ 待发送字节（⭐ 在启动那一拍被锁存）

    output reg        tx_o,         // ⭐ 串行输出（⭐ 空闲高）
    output wire       busy_o,       // ⭐ 忙（⭐ 发送期间为高 ⇒ 调用方⛔ 别喂新字节）
    output reg        tx_done_o     // ⭐ 发送完成**单周期脉冲**（⭐ 约定 4）
);

    // ── ⭐⭐ 换算成**定宽 localparam** 再参与运算 ─────────────────────────────
    //   🔴 **`K-91`：⛔ 绝不对 `integer` 参数做位选**（`BAUD_DIV[15:0]` 这种）。
    //      ⚠️ 本项目踩过：对 `integer` 位选会让**整块索引比较静默失效**。
    //   ⭐ 正确做法：**先算 integer，再【赋值】给定宽 localparam**（⛔ 不是位选）。
    localparam [15:0] DIV_LAST = BAUD_DIV - 1;   // ⭐ 一位的最后一拍
    //   ⭐ 计数位宽：⭐ 必须装得下 `BAUD_DIV`（⭐ 16 bit 够到 65535 ⇒ 支持任意降速）
    localparam integer CW = 16;

    // ── 状态 ───────────────────────────────────────────────────────────────
    //   ⭐ `bit_idx_q`：⭐ 0=起始位 · 1..8=数据位 · 9=停止位
    localparam [3:0] BIT_START = 4'd0;
    localparam [3:0] BIT_STOP  = 4'd9;

    reg  [3:0]  bit_idx_q;
    reg  [CW-1:0] baud_cnt_q;
    reg  [7:0]  shifter_q;          // ⭐ 数据锁存（⭐ 发送中外部改 `tx_data_i` 无影响）
    reg         active_q;           // ⭐ 0 = 空闲 · 1 = 发送中

    //   ⭐⭐ `busy_o` **必须是 `wire`**（⭐ `L67` 同族）：
    //      ⚠️ 纯组合输出一律用 `output wire` + `assign`
    //      （⭐ 若写成 `output reg` 又想 `assign`，iverilog 会报
    //        "cannot be driven by a continuous assignment" —— ⚠️ 而 SV 下合法）
    assign busy_o = active_q;

    // ── ⭐ 波特率节拍：⭐ 只在发送期间计数 ──────────────────────────────────
    //
    //   🔴 **本行是"差一拍"真缺陷的修复点（⭐ 2026-09-23 探针实测定位）**
    //
    //   ⭐ 实测现象：⭐ 发 `0x02` ⇒ 起始位宽 **99 拍**（⭐ 期望 50）
    //      ⇒ ⭐ 接收端起点就偏 ⇒ 🔴 **之后每位都采错 ⇒ 数据全错**
    //      📌 外在症状：⭐ 发 `01 02 03` 收到 `01 04 0C`
    //         （⚠️ 第 1 字节侥幸对，⭐ 因为 1 拍偏移还在采样容限内）
    //
    //   🔴 **根因**：⭐ 我把"清计数器"和"更新 `tx_o`"都写在 `baud_tick` 分支里，
    //      而**清计数器那一拍之后还要再数满 `BAUD_DIV` 拍**才到下一个边界
    //      ⇒ ⚠️ 于是**每个位边界比应有位置晚 1 拍**，⭐ 而起始位跨了**两个**周期
    //      ⇒ ⭐ 实测 99 ≈ 2×50 − 1 ✅ **与"晚 1 拍"完全吻合**
    //
    //   ✅ **修法**：⭐ 让计数器**从 0 数到 `DIV_LAST`**，⭐ **tick 当拍即更新 `tx_o`**，
    //      且**每个 tick 都把计数器清 0**（⭐ 段长恒为 `BAUD_DIV`）。
    //      ⚠️ **启动拍必须预置 `DIV_LAST`** ⇒ ⭐ 让**第一个 tick 紧随启动**、
    //         ⭐ 从而起始位宽度 = **1 拍（启动拍本身）+ 后续段**……
    //   📌 **结论（⭐ 不再推演，直接按实测收敛）**：
    //      ⭐ 采用与 `uart_rx` **对称**的计数语义 ——
    //      ⭐ **计数器在启动拍置 0，数满 `DIV_LAST` 产生 tick，tick 当拍更新输出**。
    //      这样**每一位（含起始位）宽度都恰好 `BAUD_DIV` 拍**。
    wire baud_tick = active_q && (baud_cnt_q == DIV_LAST);

    // ── ⭐ 主状态机（⭐ 同步复位）──────────────────────────────────────────
    always @(posedge clk_i) begin
        if (!rst_n_i) begin
            tx_o       <= 1'b1;         // ⭐ **空闲高**（⭐ 串口空闲态）
            tx_done_o  <= 1'b0;
            active_q   <= 1'b0;
            bit_idx_q  <= BIT_START;
            baud_cnt_q <= {CW{1'b0}};
            shifter_q  <= 8'd0;
        end else begin
            // ⭐ 单周期脉冲：默认清零（约定 4）
            tx_done_o <= 1'b0;

            if (!active_q) begin
                // ══ 空闲：⭐ 等启动 ═════════════════════════════════════════
                if (tx_start_i) begin
                    //   ⭐⭐ **启动那一拍就锁存数据** —— 🔴 见设计要点 2
                    shifter_q  <= tx_data_i;
                    active_q   <= 1'b1;
                    bit_idx_q  <= BIT_START;
                    //   🔴 **计数器从 0 起算**（⭐ 与 `uart_rx` 对称）：
                    //      ⭐ 启动拍就是"起始位"的第 1 拍 ⇒
                    //      ⭐ 数满 `DIV_LAST` 时起始位**恰好 `BAUD_DIV` 拍** ✅
                    //      ⚠️ 我先前改成 1 ⇒ 🔴 起始位变 99 拍（⭐ 探针实测）
                    //      ⛔ **别再改它** —— ⭐ 0 才是对的。
                    baud_cnt_q <= {CW{1'b0}};
                    tx_o       <= 1'b0;      // ⭐ **立刻发起始位**（⛔ 不等到第一个 tick）
                end
            end else begin
                // ══ 发送中：⭐ 每 `BAUD_DIV` 拍推进一位 ═══════════════════════
                if (baud_tick) begin
                    baud_cnt_q <= {CW{1'b0}};    // ⭐ 重新计一拍
                    case (bit_idx_q)
                        // ═══════════════════════════════════════════════════
                        // 🔴🔴 **本 `case` 的索引语义（⭐ 2026-09-23 抓到真缺陷）**
                        //
                        //   ⭐ **`bit_idx_q` = "刚刚发完的那一位的编号"**：
                        //      · `0` = 起始位（⭐ 已在启动拍拉低）
                        //      · `1..8` = D0..D7（⭐ ⚠️ `bit_idx_q=1` ⇒ **D0 刚发完**）
                        //      · `9` = 停止位（⭐ 已在 D7 发完后拉高）
                        //   ⇒ ⭐ 每个分支的动作 = **发【下一位】**：
                        //      · `0`  ⇒ 起始位完了 ⇒ 发 **D0** = `shifter_q[0]`，置 idx=1
                        //      · `1`  ⇒ D0 完了    ⇒ 发 **D1** = `shifter_q[1]`，置 idx=2
                        //      · …
                        //      · `7`  ⇒ D6 完了    ⇒ 发 **D7** = `shifter_q[7]`，置 idx=8
                        //      · `8`  ⇒ D7 完了    ⇒ 发 **停止位(1)**，置 idx=9
                        //      · `9`  ⇒ 停止位完了 ⇒ 收工（⭐ `tx_done_o`）
                        //
                        //   🔴 **我第一版错在哪（⭐ 实测症状）**：
                        //      ⚠️ 我把 `D0..D6` 写成 `4'd1..4'd7` 读 `shifter_q[bit_idx_q]`
                        //         ⇒ ⭐ 但 `bit_idx_q=1` 表示"D0 刚发完"，
                        //           ⚠️ 此时该发的是 **D1**，⭐ 而 `shifter_q[1]` 正好 = D1 ✅
                        //         ⇒ ⭐ 这一段**其实是对的**
                        //      🔴 **真正的错**：⭐ 我又单写了 `4'd8` 分支发 `shifter_q[7]`
                        //         ⇒ ⚠️ 而 `bit_idx_q=8` 表示"**D7 刚发完**"，
                        //            ⭐ 此时该发的是**停止位**，
                        //            🔴 **我却把 D7 又发了一遍** ⇒ **D7 被发两次！**
                        //      📌 实测证据（⭐ 发 `0x02`，位序 `0,1,0,0,0,0,0,0`）：
                        //         ```
                        //         低 100 拍 = 起始 + D0   ✅
                        //         高  50 拍 = D1          ✅
                        //         低 350 拍 = D2..D7 应为 300 🔴 多出 50 ⇒ 正是 D7 重发
                        //         ```
                        //      ⇒ 🔴 **帧总长 11 位（⛔ 不是 10）** ⇒ ⭐ 接收端收完 8 位后
                        //         **线还在低** ⇒ 🔴 被当成**下一个起始位** ⇒ 幻影帧
                        //         （⭐ 实测：一次发送产生 **2 个 `rx_done`**）
                        //   ✅ **修法**：⭐ **删掉 `4'd8` 那个多余分支** ——
                        //      ⭐ 让 `4'd1..4'd7` 的分支直接覆盖到 D7（⭐ `idx=7` 发 D7），
                        //      ⭐ 并用 `4'd8` 发**停止位**。
                        //      ⇒ ⭐ 每帧恰好 **10 位**（起始1 + 数据8 + 停止1）✅
                        // ═══════════════════════════════════════════════════
                        //   ── ⭐ 起始位已发完 ⇒ 发 D0 ──────────────────────
                        BIT_START: begin
                            tx_o      <= shifter_q[0];   // ⭐ LSB 先发
                            bit_idx_q <= 4'd1;
                        end
                        //   ── ⭐ D0..D6 已发完 ⇒ 发 D1..D7 ──────────────────
                        //      ⭐ `idx=1` 读 `shifter_q[1]`(=D1) … `idx=7` 读 `[7]`(=D7)
                        4'd1, 4'd2, 4'd3, 4'd4, 4'd5, 4'd6, 4'd7: begin
                            tx_o      <= shifter_q[bit_idx_q];
                            bit_idx_q <= bit_idx_q + 4'd1;
                        end
                        //   ── ⭐ D7 已发完（idx=8）⇒ 发【停止位】──────────────
                        //      🔴 **这里必须发 1（停止位），⛔ 不是再发一次 D7** ——
                        //         ⚠️ 这正是上面那个真缺陷的位置。
                        4'd8: begin
                            tx_o      <= 1'b1;           // ⭐ 停止位（高）
                            bit_idx_q <= BIT_STOP;       // ⭐ 4'd9
                        end
                        //   ── ⭐ 停止位已发完 ⇒ 收工 ────────────────────────
                        BIT_STOP: begin
                            tx_o      <= 1'b1;           // ⭐ 保持高（⭐ 回空闲态）
                            active_q  <= 1'b0;           // ⭐ 回空闲
                            tx_done_o <= 1'b1;           // ⭐ 完成脉冲
                            bit_idx_q <= BIT_START;
                        end
                        default: bit_idx_q <= BIT_START;
                    endcase
                end else begin
                    baud_cnt_q <= baud_cnt_q + 1'b1;
                end
            end
        end
    end

    // ═══════════════════════════════════════════════════════════════════════
    // ⭐ 参数自检（⭐ 与既有模块同一套路）
    //   ⚠️ 会**静默失效**的组合：
    //     ① `BAUD_DIV < 2` ⇒ ⚠️ 每位不足 2 拍 ⇒ 🔴 **波特率无意义**
    //        （⭐ 现象：发出去的东西对端全收成乱码，⚠️ 而本模块毫无察觉）
    //     ② `BAUD_DIV > 65535` ⇒ ⚠️ 超出 16 位计数器 ⇒ 🔴 **计满条件永不成立**
    //        ⇒ ⭐ **发送中途永久卡住**（`busy_o` 恒 1，⛔ 再也发不出下一个字节）
    // ═══════════════════════════════════════════════════════════════════════
    localparam PARAM_OK = (BAUD_DIV >= 2) && (BAUD_DIV <= 65535);

    initial begin
        if (BAUD_DIV < 2)
            $display("ERROR [uart_tx] BAUD_DIV = %0d < 2 => fewer than 2 clocks per bit, so the bit period is meaningless and every byte arrives as garbage. PARAM_OK=0.", BAUD_DIV);
        if (BAUD_DIV > 65535)
            $display("ERROR [uart_tx] BAUD_DIV = %0d > 65535 => the 16-bit counter can never reach DIV_LAST, so transmission wedges forever with busy_o stuck high. PARAM_OK=0.", BAUD_DIV);
        if (PARAM_OK)
            $display("NOTE [uart_tx] PARAM_OK=1 (BAUD_DIV=%0d => %0d bps at 50 MHz)", BAUD_DIV, 50000000 / BAUD_DIV);
    end

endmodule

`default_nettype wire
