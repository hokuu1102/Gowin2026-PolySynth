`timescale 1ns/1ps
// ============================================================================
// fx_dist.v -- 数字失真（硬削）· W3c 出声通路的【效果器链第 1 级】
//
//  位置：tdm_render_mixer（干声）→ [失真] → [合唱] → [延迟] → master_mix → i2s_tx
//
// ---------------------------------------------------------------------------
// 为什么先做失真（用户 2026-10-14 裁定：只做硬削，留三个空位）
// ---------------------------------------------------------------------------
//  失真是【无记忆非线性】：y[n] = f(x[n])，只看当前一个样点。
//  => 不需要延迟线、不需要状态 => BSRAM 用量 = 0（这是它最大的优势，
//     不跟波表/事件缓冲抢资源）。
//
//  赛题"拓展要求 2"点名"混响、延迟、合唱等数字音频效果器"，原文有"等"字
//  => 失真算数；而且听感差异最明显，演示价值最高。
//
// ---------------------------------------------------------------------------
// 算法（硬削 + 连续增益 + 输出电平补偿）
// ---------------------------------------------------------------------------
//  ① 增益：xg = x × gain        gain 是 Q4.12（16 位；4096 = 1.0，最大 15.999）
//  ② 硬削：y  = clamp(xg, −T, +T)   T = 满量程（SAMPLE_W 位）
//  ③ 补偿：out = y × trim       trim 是 Q1.15（16 位；32768 = 1.0）
//     为什么需要③：失真把 RMS 抬起来，不补偿会顶到 master_mix 的饱和。
//
//  连续增益用真乘法器（用户裁定：DSP 够就用连续）。
//  代价 2 个 DSP（增益 1 个 + 补偿 1 个）；当前 DSP 22/118，余 96 个，够。
//
// ---------------------------------------------------------------------------
// 预留的 3 个档位（sel_i）
// ---------------------------------------------------------------------------
//  sel_i = 0  : 硬削（本期实现）
//  sel_i = 1  : 预留 —— 软削（分段线性 y = a + (|xg|−a)>>1，零 DSP）
//  sel_i = 2  : 预留 —— Fuzz（非对称阈值 T1≠T2，产生偶次谐波）
//  sel_i = 3  : 预留 —— 自定义曲线 / 位压缩
//  ⚠️ 本期 1/2/3 的【行为定义为与 0 相同】（硬削）—— 接口已就位、行为确定
//     （不会出现未定义），将来填实现时只改一处 case。
//  ⚠️ 做 Fuzz 时【必须】补 DC 阻断器：非对称削波会引入直流偏置，顶掉功放
//     动态余量。本期硬削是对称的，所以不需要，但接口留好了。
//
// ---------------------------------------------------------------------------
// 硬旁路（en_i = 0）
// ---------------------------------------------------------------------------
//  out = en ? 失真输出 : 输入延迟同样拍数
//  => 数值【逐位等于输入】（这是"零回归"的保证：全部 enable=0 时整条链
//     与今天的输出数值逐位相同）。
//  ⚠️ 如实说明：旁路走的是【同一条流水线】，所以数值相同但时序差 PIPE 拍。
//     相对本项目 10 ms 的延迟预算可忽略。
//
// ---------------------------------------------------------------------------
// 流水线（PIPE = 5 拍）
// ---------------------------------------------------------------------------
//  | 拍 | 动作 |
//  |----|------|
//  | N   | `valid_i`：锁存样点与参数 → `s0` |
//  | N+1 | 乘法 1（增益）        → `p1` |
//  | N+2 | 硬削（饱和）          → `c2` |
//  | N+3 | 乘法 2（补偿）        → `p3` |
//  | N+4 | 输出寄存              → `sample_o`（N+5 拍可见） |
//  ⚠️ `valid_i` 的脉冲间距必须 ≥ PIPE 拍（真实链路每 1024 拍一个样点，够）。
//
// ---------------------------------------------------------------------------
// 纪律（本项目血泪）
// ---------------------------------------------------------------------------
//  · Verilog-2001 语法（K-91）：用 SV 专有构造 => 整个模块被静默丢弃，
//    而仿真全绿。
//  · 组合逻辑用 assign（L67）；参与算术的 wire 一律显式写位宽。
//  · 饱和不用 signed 比较（K-101：iverilog 会退化成无符号比较）
//    => 用【逐位溢出判断】（与 master_mix.v 同一套）。
//  · 声明必须先于使用（本项目踩过 "Unable to bind wire/reg"）。
//  · 任何"会失效"的路径都必须可观测（K-106）：
//    削波次数 / 有效增益 / 有效补偿 / 削波前峰值 —— 全部有输出。
//  · 单样本链不反压：valid_i 是脉冲，当拍算完，valid_o 与 sample_o 同拍。
// ============================================================================
`default_nettype none

module fx_dist #(
    // 样点位宽（与 master_mix / i2s_tx 一致 = 24）
    parameter integer SAMPLE_W  = 24,
    // 增益位宽（Q4.12：高 4 位整数、低 12 位小数；4096 = 1.0，最大 15.999）
    parameter integer GAIN_W    = 16,
    // 增益的小数位数（乘完右移这么多位还原到样点域）
    parameter integer GAIN_FRAC = 12,
    // 输出补偿位宽（Q1.15：最高位为 0 表示分数；32768 = 1.0）
    parameter integer TRIM_W    = 16,
    // 补偿的小数位数
    parameter integer TRIM_FRAC = 15,
    // 复位后的默认增益（Q4.12；4.0 = 16384 => 一上来就有明显失真，便于上板听出来）
    parameter [GAIN_W-1:0] GAIN_DEFAULT = 16'd16384,
    // 复位后的默认补偿（Q1.15；0.25 = 8192 => 抵掉失真抬起来的 RMS）
    parameter [TRIM_W-1:0] TRIM_DEFAULT = 16'd8192
) (
    input  wire                        clk_i,
    input  wire                        rst_n_i,     // 同步复位、低有效

    // ── 单样本流（与 master_mix 同一约定：valid_i 是脉冲，不反压）────────
    input  wire                        valid_i,
    input  wire signed [SAMPLE_W-1:0]  sample_i,

    // ── 控制（全部来自 top.v 的寄存器；本模块不解析串口）────────────────
    input  wire                        en_i,        // 0 = 硬旁路（输出 == 输入）
    input  wire [1:0]                  sel_i,       // 0=硬削 · 1/2/3=预留（本期同 0）
    input  wire [GAIN_W-1:0]           gain_i,      // 连续增益（Q4.12）
    input  wire [TRIM_W-1:0]           trim_i,      // 输出电平补偿（Q1.15）

    // ── 输出 ──────────────────────────────────────────────────────────────
    output reg                         valid_o,
    output reg  signed [SAMPLE_W-1:0]  sample_o,

    // ── 可观测性（K-106：不许静默失效）────────────────────────────────────
    output reg  [15:0]                 clip_cnt_o,  // 削波（饱和）次数，饱和
    output wire [GAIN_W-1:0]           gain_used_o, // 当前生效的增益
    output wire [TRIM_W-1:0]           trim_used_o, // 当前生效的补偿
    output reg  [SAMPLE_W-1:0]         peak_o       // 削波【前】的幅值（饱和，与输出同拍）
);

    // ═══════════════════════════════════════════════════════════════════════
    // ① 常量
    // ═══════════════════════════════════════════════════════════════════════
    //  流水线深度：sample 经过 PIPE 拍才到 sample_o（旁路也一样）
    //    s0(N+1) → p1(N+2) → c2(N+3) → p3(N+4) → sample_o(N+5)
    localparam integer PIPE = 5;

    //  乘法 1（增益）的中间位宽
    localparam integer SUM1_W = SAMPLE_W + GAIN_W;
    //  乘法 2（补偿）的中间位宽
    localparam integer SUM2_W = SAMPLE_W + TRIM_W;

    //  满量程（正最大 / 负最小）
    localparam signed [SAMPLE_W-1:0] FS_MAX = {1'b0, {(SAMPLE_W-1){1'b1}}};
    localparam signed [SAMPLE_W-1:0] FS_MIN = {1'b1, {(SAMPLE_W-1){1'b0}}};

    //  默认值（复位用；直接取参数，不手抄数字）
    localparam [GAIN_W-1:0] GAIN_DEF = GAIN_DEFAULT;
    localparam [TRIM_W-1:0] TRIM_DEF = TRIM_DEFAULT;

    // ═══════════════════════════════════════════════════════════════════════
    // ② 参数寄存器（复位取默认值；top.v 每拍喂，后写者胜）
    // ═══════════════════════════════════════════════════════════════════════
    reg [GAIN_W-1:0] gain_r;
    reg [TRIM_W-1:0] trim_r;
    reg        [1:0] sel_r;
    reg              en_r;

    assign gain_used_o = gain_r;
    assign trim_used_o = trim_r;

    // ═══════════════════════════════════════════════════════════════════════
    // ③ 流水线寄存器
    // ═══════════════════════════════════════════════════════════════════════
    reg signed [SAMPLE_W-1:0] s0, s1, s2, s3, s4;   // 各级的样点（旁路用）
    reg signed [SUM1_W-1:0]   p1;                   // 乘法 1 结果
    reg signed [SAMPLE_W-1:0] c2;                   // 硬削结果
    reg signed [SUM2_W-1:0]   p3;                   // 乘法 2 结果
    reg [PIPE-1:0]            v_sr;                 // valid 移位（v_sr[0] 最新）
    reg [PIPE-1:0]            en_sr;                // en 移位（与样点同拍对齐）
    reg [PIPE-1:0]            ovf_sr;               // 削波标志移位（对齐到输出拍）

    // ═══════════════════════════════════════════════════════════════════════
    // ④ 乘法 1：xg = sample × gain（Q4.12 ⇒ 右移 GAIN_FRAC 位还原）
    // ═══════════════════════════════════════════════════════════════════════
    wire signed [SUM1_W-1:0] prod1 = s0 * $signed({1'b0, gain_r});
    wire signed [SUM1_W-1:0] shr1  = prod1 >>> GAIN_FRAC;

    //  溢出判断（K-101：逐位比较，⛔ 不用 signed 比较）
    //    右移后，位 [SUM1_W-1 : SAMPLE_W-1] 必须【全部相同】（都等于真符号位），
    //    否则就是溢出 ⇒ 需要饱和。
    //    ⚠️ 判据写成"上面那些位 != 第 SAMPLE_W-1 位的复制" —— 等价且省逻辑 ✓
    wire ovf1 = (shr1[SUM1_W-1:SAMPLE_W] != {(SUM1_W-SAMPLE_W){shr1[SAMPLE_W-1]}});
    //  ⭐⭐ 饱和（按【真符号位】选正/负满量程）
    //     🔴 **我第一版写错在这里**：用 `shr1[SAMPLE_W-1]` 当符号位。
    //        但**溢出时第 SAMPLE_W-1 位只是幅值的低位，不是符号** ——
    //        例：9 600 000 = 0x927C00，第 23 位正好是 1 ⇒ 被判成负数
    //        ⇒ 🔴 **正输入输出 FS_MIN、负输入输出 FS_MAX（符号整个反了）** ✓
    //     ✅ 真符号 = **40 位结果的最高位** `shr1[SUM1_W-1]` ✓
    wire signed [SAMPLE_W-1:0] sat1 = ovf1 ? (shr1[SUM1_W-1] ? FS_MIN : FS_MAX)
                                           : shr1[SAMPLE_W-1:0];

    //  削波【前】的幅值（无符号；溢出时记满量程）
    //    ⚠️ 同样用【真符号位】`shr1[SUM1_W-1]` 判正负，⛔ 不用第 23 位
    wire [SUM1_W-1:0] mag1_full = shr1[SUM1_W-1] ? ((~shr1) + 1'b1) : shr1;
    wire [SAMPLE_W-1:0] peak1 = ovf1 ? FS_MAX : mag1_full[SAMPLE_W-1:0];

    // ═══════════════════════════════════════════════════════════════════════
    // ⑤ 乘法 2：out = clipped × trim（Q1.15 ⇒ 右移 TRIM_FRAC 位）
    // ═══════════════════════════════════════════════════════════════════════
    wire signed [SUM2_W-1:0] prod2 = c2 * $signed({1'b0, trim_r});
    wire signed [SUM2_W-1:0] shr2  = prod2 >>> TRIM_FRAC;

    wire ovf2 = (shr2[SUM2_W-1:SAMPLE_W] != {(SUM2_W-SAMPLE_W){shr2[SAMPLE_W-1]}});
    //  ⚠️ 同 sat1：符号位用【40 位结果的最高位】，⛔ 不用第 SAMPLE_W-1 位
    wire signed [SAMPLE_W-1:0] sat2 = ovf2 ? (shr2[SUM2_W-1] ? FS_MIN : FS_MAX)
                                           : shr2[SAMPLE_W-1:0];

    // ═══════════════════════════════════════════════════════════════════════
    // ⑥ 时序
    // ═══════════════════════════════════════════════════════════════════════
    always @(posedge clk_i) begin
        if (!rst_n_i) begin
            gain_r  <= GAIN_DEF;
            trim_r  <= TRIM_DEF;
            sel_r   <= 2'd0;
            en_r    <= 1'b0;
            s0 <= {SAMPLE_W{1'b0}}; s1 <= {SAMPLE_W{1'b0}};
            s2 <= {SAMPLE_W{1'b0}}; s3 <= {SAMPLE_W{1'b0}}; s4 <= {SAMPLE_W{1'b0}};
            p1 <= {SUM1_W{1'b0}};
            c2 <= {SAMPLE_W{1'b0}};
            p3 <= {SUM2_W{1'b0}};
            v_sr   <= {PIPE{1'b0}};
            en_sr  <= {PIPE{1'b0}};
            ovf_sr <= {PIPE{1'b0}};
            valid_o  <= 1'b0;
            sample_o <= {SAMPLE_W{1'b0}};
            peak_o   <= {SAMPLE_W{1'b0}};
            //  ⚠️ `clip_cnt_o` 的复位与计数都在【本块】里 ——
            //     一个 reg 只能有一个 always 块写（否则综合报 EX2000 多驱动）
            clip_cnt_o <= 16'd0;
        end else begin
            // ── 参数与选通（每拍都收；top.v 只在自己有值时才给新值）──────
            gain_r <= gain_i;
            trim_r <= trim_i;
            sel_r  <= sel_i;
            en_r   <= en_i;

            // ── stage0（N → N+1）：锁存输入与选通 ───────────────────────
            s0     <= sample_i;
            v_sr   <= {v_sr[PIPE-2:0],   valid_i};
            en_sr  <= {en_sr[PIPE-2:0],  en_r};

            // ── stage1（N+1 → N+2）：乘法 1 ─────────────────────────────
            s1 <= s0;
            p1 <= prod1;

            // ── stage2（N+2 → N+3）：硬削 ───────────────────────────────
            //   ⚠️ 本期 sel 1/2/3 的行为【定义为与 0 相同】（硬削）。
            //      将来填软削/Fuzz 时只改这里的一处 case。
            s2 <= s1;
            c2 <= sat1;
            ovf_sr <= {ovf_sr[PIPE-2:0], ovf1};

            // ── stage3（N+3 → N+4）：乘法 2 ─────────────────────────────
            s3 <= s2;
            p3 <= prod2;

            // ── stage4（N+4 → N+5）：输出 ───────────────────────────────
            s4 <= s3;
            valid_o  <= v_sr[PIPE-1];
            //  旁路：en = 0 时输出【输入延迟 PIPE 拍】=> 数值逐位等于输入
            sample_o <= en_sr[PIPE-1] ? sat2 : s4;
            //  峰值：与输出同拍（削波【前】的幅值）
            peak_o   <= peak1;

            // ── 削波计数（K-106：饱和次数必须可观测，且【饱和】不溢出）──
            //  ⚠️ 用 en_sr[PIPE-1]（与输出同拍）门控：旁路时【不算】削波
            //     （否则"关掉效果器计数还在涨"会误导上板诊断）
            //  ⚠️ 两个乘法器的溢出都算：补偿过头也要看得见
            //  ⚠️ 复位与计数【都在本块】—— 一个 reg 只能有一个 always 块写
            if (en_sr[PIPE-1] && (ovf_sr[PIPE-1] || ovf2)) begin
                if (clip_cnt_o != 16'hFFFF) clip_cnt_o <= clip_cnt_o + 16'd1;
            end
        end
    end

endmodule
