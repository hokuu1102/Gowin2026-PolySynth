`timescale 1ns/1ps
// ─────────────────────────────────────────────────────────────────────────────
// evt_uart_rx.v · 串口事件帧解析（上位机通路的 FPGA 侧）
//
// ⭐ 契约见 `files/20-代码/上位机与ESP32通路实施计划.md` §三
//
// ── 它解决什么问题 ───────────────────────────────────────────────────────────
//   ⭐ 上位机要把**曲谱事件**送进 FPGA，而 `uart_rx.v` 只是**字节接收器**
//      —— ⛔ 它没有"帧"的概念，⚠️ 收到什么都当一个字节给你。
//   ⇒ 本模块 = **把字节流切回一条条 64 bit 事件**。
//
// ── ⭐⭐ 帧格式（9 字节定长）──────────────────────────────────────────────────
//     byte 0     : 0xA5          帧头（固定魔数）
//     byte 1..8  : 64 bit 事件   **大端**（⭐ 与 `events.hex` 字节序一致）
//
//   ⭐ 为什么用**固定帧头**而不是长度字段：
//     · ⭐ **纯硬件可解析** —— 一个移位寄存器 + 比较器，⛔ 不需要长度状态机
//     · ⚠️ 代价：吞吐 `9/8 = 12.5%` 开销（⭐ 实测完全不是瓶颈，见下）
//
// ── ⭐⭐ 同步方案：**⛔ 不做任意位置扫描**（★ 本模块最关键的设计决定）──────
//   🔴 **风险**：`0xA5` 是**合法的事件载荷字节**（⚠️ 例如 `tick=0xA5xx`）
//      ⇒ ⭐ **"扫到 0xA5 就当帧头"必然误同步**。
//
//   ⭐ 本模块的做法：
//     ① ⭐ **只在"第 0 字节位置"看帧头** —— ⛔ 不在数据中间找 0xA5
//        ⇒ ⭐ **误同步在原理上不可能发生**（⚠️ 载荷里的 0xA5 只是普通数据）
//     ② ⭐ **靠字节计数维持同步** —— 9 个字节一组，硬件数着走
//     ③ ⭐⚠️ **失步后由 PC 重发复位序列**，⛔ 不是 FPGA 自己猜
//
// ── ⭐ 两级"归位"机制（⚠️ 缺一不可）────────────────────────────────────────
//   **① 空闲间隔归位**（静默 ≥ `GAP_BYTES` 个字节时间）
//     ⭐ 检测 `rx_done_i` 之间**长时间没有新字节** ⇒ 强制回到 `idx = 0`。
//     ⭐ 好处：**自愈** —— ⚠️ PC 崩在半帧中间也不会永久卡死。
//     ⚠️ **前提（PC 侧必须遵守）**：⭐ **一帧的 9 个字节要【连续发】**
//        （⛔ 中间停顿不得超过 `GAP_BYTES` 个字节时间）。
//        ⭐ `tools/evt2uart.py` 用**单次 `write()`** 保证；
//        ⚠️ 且 `GAP_BYTES` 默认给得**较宽**，容忍 USB-串口的分块投递。
//
//   **② 全 `0xA5` 帧抑制**
//     ⭐ PC 的复位序列是**一串 `0xA5`**。
//     ⚠️ 若不管它，硬件会把它拼成"载荷全是 0xA5 的假事件" ⇒ 🔴 **弹出怪音**。
//     ⇒ ⭐ 定义：**9 个字节全是 `0xA5` 的帧 = 复位标记，⛔ 不产生事件**。
//     ⭐ 安全性：真"全 0xA5 事件"概率 ≈2⁻⁷²，且 ⭐ **上位机不生成它**
//        （`evt2uart.py` 会断言拦截）。
//
//   ⚠️⚠️ **复位序列的长度必须是【9 的整数倍】**，否则会错位：
//     · 发 **9N** 个 `0xA5` ⇒ ⭐ 硬件把它们整帧整帧地抑制掉，`idx` 稳定回 0 ✅
//     · 发 **9N+3** 个 ⇒ 🔴 残留 3 个字节把 `idx` 推到 3
//       ⇒ ⚠️ 之后真正的帧会被**当成帧内数据**吞掉，直到空闲归位救回来
//     ⇒ ⭐ **`evt2uart.py` 只发 9 的整数倍**；⚠️ 这是硬约束，不是建议。
//
// ── ⭐ 带宽实测（⚠️ "事件很少"这个直觉是错的）──────────────────────────────
//   ⚠️ 设计文档假设"事件很少、12.5% 开销可接受"，
//      但 ⭐ **实测三个真实谱子**：
//        · 平均 **13~25 条事件/拍**
//        · 最坏 8 拍窗口 **283~504 条**
//      ⇒ ⭐ 平均负载 **750 B/s ≈ 占 115200 的 6.5%**（⚠️ 远没到瓶颈）
//      ⇒ ⭐ **12.5% 的帧开销完全不是问题**；🔴 真正的瓶颈是**缓冲深度**（见 `U-19`）。
//
// ── ⛔ 纪律（本项目血泪）────────────────────────────────────────────────────
//   · ⭐ **Verilog-2001 语法**（`K-91`：用 SV 专有构造 ⇒ **整个模块被静默丢弃**）
//   · ⭐ **组合逻辑用 `assign`**（`L67`）
//   · ⛔ **不对 `integer` 参数做位选**（`K-91`）—— ⭐ 只能**赋值**给定宽 localparam
//   · ⭐ **参与算术的 wire 一律显式写位宽**（⚠️ 不写就是 1 位 ⇒ 截断）
//   · ⭐ **任何"会失效"的路径都必须可观测**（`K-106`）——
//     本模块把"帧头错 / 归位 / 抑制 / 位置"**全做成计数器**，⛔ 不静默
// ─────────────────────────────────────────────────────────────────────────────
`default_nettype none

module evt_uart_rx #(
    parameter integer CLK_HZ    = 50000000,   // ⭐ 50 MHz（冻结表约定 1：单时钟域）
    // ⭐ 2026-09-23：**默认 1 Mbps**（`U-29` 落地；ESP32 对接清单 §四.3）。
    //   ⚠️ **必须与所接 `uart_rx.BAUD_DIV` 一致** —— 两者不匹配会**静默收到乱码**
    //      （⚠️ 不是报错）。切档时**两处一起改**：
    //        · `uart_rx #(.BAUD_DIV(50))`  ↔ `evt_uart_rx #(.BAUD(1000000))`  = **1 Mbps（默认）**
    //        · `uart_rx #(.BAUD_DIV(108))` ↔ `evt_uart_rx #(.BAUD(460800))`   = 退档备选
    //   ⭐ **参数化的理由**：⚠️ 1 Mbps 对线材质量敏感 ⇒ ⭐ **误码时能退档**（⭐ 退 460800/230400，
    //      ⛔ 不是退回 115200 —— 见 `uart_rx.v` 顶部的更正记录）。
    parameter integer BAUD      = 1000000,
    // ⭐ 空闲归位的阈值（单位：字节时间）。
    //   ⚠️ 必须 > 1（⛔ 否则帧内字节间隙会被误判成"空闲"）
    //   ⭐ 取 16（≈160 µs @1 Mbps / ≈1.4 ms @115200）：⚠️ **故意给宽** ——
    //      容忍 USB-串口/蓝牙把一次 `write()` **分块投递**造成的间隙。
    //      ⚠️ 帧内字节理论间隙 ≈ 0（背靠背），所以 16 依然区分得很开。
    //   📌 ESP32 侧承诺：**一帧的 9 字节一次性写入**（对接清单 §六.1）⇒ ⭐ 这条足够。
    parameter integer GAP_BYTES = 16,
    parameter [7:0]   HEADER    = 8'hA5
) (
    input  wire        clk_i,
    input  wire        rst_n_i,        // ⭐ 同步复位、低有效（约定 2）

    // ── ⭐ 来自 `uart_rx.v` 的字节流接口 ───────────────────────────────────
    input  wire        rx_done_i,      // ⭐ 收到一个字节（单周期脉冲，约定 4）
    input  wire [7:0]  rx_data_i,      // ⭐ 该字节

    // ── ⭐ 解析出的事件 ───────────────────────────────────────────────────
    output reg         evt_valid_o,    // ⭐ 单周期脉冲（⭐ 与 evt_data_o 同拍）
    output reg  [63:0] evt_data_o,     // ⭐ 64 bit 事件（大端拼装完成）

    // ── ⭐ 可观测性（`K-106`：⛔ 不许静默失效）────────────────────────────
    output reg  [15:0] frame_cnt_o,    // ⭐ 成功解析的帧数（饱和）
    output reg  [15:0] resync_cnt_o,   // ⭐ 空闲归位次数（饱和）— ⚠️ 上板先看这个
    output reg  [15:0] hdr_err_cnt_o,  // ⭐ "该是帧头却不是"的次数（饱和）
    output reg  [15:0] drop_cnt_o,     // ⭐ 被抑制的全 0xA5 帧数（饱和）
    output wire [3:0]  idx_o,          // ⭐ 当前字节位置（0..8，⚠️ 上板调试用）
    output reg         synced_o        // ⭐ 自上次归位以来是否成功解析过一帧
);

    // ── ⭐⭐ 换算成**定宽 localparam** 再参与运算 ─────────────────────────────
    //   🔴 **`K-91`：⛔ 绝不对 `integer` 参数做位选**（`GAP_I[19:0]` 这种）。
    //      ⚠️ 本项目踩过：对 `integer` 位选会让**整块索引比较静默失效**
    //      （⚠️ 现象是"数据推不进去"，看起来像别的原因）。
    //   ⭐ 正确做法：**先算 integer，再【赋值】给定宽 localparam**（⛔ 不是位选）。
    //  ⭐⭐ 2026-10-09（`P0-05`）：⭐ **与 `calib_cmd.v` 同步改** —— 单位是【字节】⛔ 不是【位】 ✅
    //   🔴 **原缺陷**：⭐ `CLK_HZ / BAUD` = **一个位**的时间 ⇒ ⭐ `GAP_CLK = 100 × 16 = 1600` 拍 = **32 µs**
    //      ⚠️ 而一个字节（8N1 = 10 位）在 500 kbaud 下 = **20 µs** ⇒ 🔴 **容忍只有 1.6 个字节时间**
    //      （⭐ 设计意图是 16 个字节时间 = **320 µs**）⇒ ⭐ **差 10 倍** ✅
    //   🔴 **后果**：⭐ 主机分块投递（⭐ USB-CDC 的 1 ms 帧边界）⇒ ⭐ 曲谱包被**空闲归位**截断
    //      ⇒ ⚠️ 半条事件被丢 + 剩下的字节被当成**别的消费者**的载荷 ✅
    //   ⚠️ **纪律**：⭐ 本公式与 `calib_cmd.v:242` **逐字相同**（⭐ 两处**必须同值**，
    //      ⛔ 否则一个认为已归位、另一个还在帧内 ⇒ 🔴 **窗口错配**）✅
    localparam integer BIT_CLK_I  = (CLK_HZ + BAUD/2) / BAUD;   // ⭐ 【位】时间（⭐ 四舍五入）
    localparam integer BYTE_CLK_I = BIT_CLK_I * 10;             // ⭐ 【字节】时间 = 10 位（8N1）
    localparam integer GAP_CLK_I  = BYTE_CLK_I * GAP_BYTES;     // ⭐ 16 字节 = 320 µs
    localparam [19:0]  GAP_CLK    = GAP_CLK_I;                  // ⭐ 赋值 ⇒ 自动截断
    localparam [3:0]   IDX_LAST   = 4'd8;                       // ⭐ 第 9 个字节

    // ── 状态 ───────────────────────────────────────────────────────────────
    reg [3:0]  idx_q;              // ⭐ 0 = 等帧头；1..8 = 收数据字节
    reg [63:0] shift_q;            // ⭐ 移位寄存器（大端拼装）
    reg        all_a5_q;           // ⭐ "本帧到此为止全是 0xA5"
    reg [19:0] idle_q;             // ⭐ 距上次收到字节的 clk 数（饱和）

    assign idx_o = idx_q;          // ⭐ 直接引出（⛔ 不再多做一级寄存器）

    // ⭐ 空闲是否已达阈值
    wire idle_expired = (idle_q >= GAP_CLK);

    // ── ⭐ 组合：本字节拼进移位寄存器后的完整字（⚠️ 只在 idx==IDX_LAST 时完整）──
    wire [63:0] evt_word = {shift_q[55:0], rx_data_i};

    // ── ⭐ 本帧"全是 0xA5"？（⭐ 帧头已经是 0xA5 才会进到这里）─────────────────
    wire byte_is_a5 = (rx_data_i == HEADER);
    wire all_a5_now = all_a5_q & byte_is_a5;

    // ⭐ 饱和自增（⚠️ ⛔ 不许回绕 —— 回绕会让"溢出"看起来像"刚清零"）
    function [15:0] sat_inc16;
        input [15:0] v;
        begin
            sat_inc16 = (v == 16'hFFFF) ? 16'hFFFF : (v + 16'd1);
        end
    endfunction

    // ── ⭐ 空闲计时器（⭐ 收到字节就清零，否则涨到阈值就停）──────────────────
    always @(posedge clk_i) begin
        if (!rst_n_i) begin
            idle_q <= 20'd0;
        end else if (rx_done_i) begin
            idle_q <= 20'd0;
        end else if (!idle_expired) begin
            idle_q <= idle_q + 20'd1;
        end
    end

    // ── ⭐ 主状态机 ────────────────────────────────────────────────────────
    always @(posedge clk_i) begin
        if (!rst_n_i) begin
            idx_q         <= 4'd0;
            shift_q       <= 64'd0;
            all_a5_q      <= 1'b0;
            evt_valid_o   <= 1'b0;
            evt_data_o    <= 64'd0;
            frame_cnt_o   <= 16'd0;
            resync_cnt_o  <= 16'd0;
            hdr_err_cnt_o <= 16'd0;
            drop_cnt_o    <= 16'd0;
            synced_o      <= 1'b0;
        end else begin
            // ⭐ 默认：脉冲类输出**每拍清零** ⇒ 严格单周期
            evt_valid_o <= 1'b0;

            if (rx_done_i) begin
                // ══ 收到一个字节 ═══════════════════════════════════════════
                if (idx_q == 4'd0) begin
                    // ---- ⭐ 只在【第 0 字节位置】看帧头（⛔ 不扫描）----------
                    if (byte_is_a5) begin
                        idx_q    <= 4'd1;
                        all_a5_q <= 1'b1;      // ⭐ 帧头是 0xA5 ⇒ 起始为真
                        // ⚠️ shift 此刻清空：⭐ 上一帧的残留 ⛔ 不许漏进新帧
                        shift_q  <= 64'd0;
                    end else begin
                        // 🔴 该是帧头却不是 ⇒ ⭐ **留在 idx=0 继续等**
                        //    ⭐ 这就是"不做扫描"的代价，也是它的安全性来源
                        hdr_err_cnt_o <= sat_inc16(hdr_err_cnt_o);
                        idx_q <= 4'd0;
                    end
                end else begin
                    // ---- ⭐ 数据字节：大端拼装 --------------------------------
                    shift_q  <= evt_word;
                    all_a5_q <= all_a5_now;

                    if (idx_q == IDX_LAST) begin
                        idx_q <= 4'd0;         // ⭐ 本帧结束，回到等帧头
                        if (all_a5_now) begin
                            // 🔴 **全 0xA5 帧 = 复位标记** ⇒ ⭐ **抑制**，⛔ 不产生事件
                            //    （⚠️ 否则 PC 的复位序列会弹出一串怪音）
                            drop_cnt_o <= sat_inc16(drop_cnt_o);
                        end else begin
                            // ⭐ 正常事件：⭐ 数据与 valid **同一拍**锁存
                            //    （⚠️ 经验 `80 号`：valid 与 data 必须同拍）
                            evt_data_o  <= evt_word;
                            evt_valid_o <= 1'b1;
                            frame_cnt_o <= sat_inc16(frame_cnt_o);
                            synced_o    <= 1'b1;
                        end
                    end else begin
                        idx_q <= idx_q + 4'd1;
                    end
                end
            end else if (idle_expired && (idx_q != 4'd0)) begin
                // ══ ⭐ 机制 ①：**空闲间隔归位** ═══════════════════════════════
                //   ⭐ 长时间没有新字节 ⇒ 半帧作废，回到等帧头
                //   ⭐ 幂等：一旦 idx==0 就不再满足条件 ⇒ ⭐ 天然只触发一次
                idx_q        <= 4'd0;
                all_a5_q     <= 1'b0;
                resync_cnt_o <= sat_inc16(resync_cnt_o);
                // ⭐ 归位后"本次同步"作废（⭐ 但帧计数保留 —— 它是历史累计）
                synced_o     <= 1'b0;
            end
        end
    end

endmodule

`default_nettype wire
