// ============================================================================
//  uart_tx_fifo.v —— 串口回传的【发送队列】（⭐ 2026-09-24 新增，修 K-126）
//
//  ═══════════════════════════════════════════════════════════════════════════
//  🔴🔴 **为什么需要它**（⭐ 上板实测，⛔ 不是推测）
//  ═══════════════════════════════════════════════════════════════════════════
//
//  ⭐ 原来的接法：`tx_req`（单拍脉冲）**直接**接到 `uart_tx.tx_start_i`
//     ⇒ 🔴 **`uart_tx` 忙时【直接忽略】新请求**（⭐ 它自己的注释也承认这点）
//
//  🔴 **实测后果**（⭐ 2026-09-24 上板）：
//     · 发 `'S'` ⇒ `top.v` 同时产生两个回包：
//         ① `'s'`（受理 span，⭐ 立即）
//         ② 轴号提示（⭐ `calib_span` 进 `S_PROMPT` 那一刻）
//       ⚠️ 而 ① 要发 **20 µs**（500 kbps × 10 bit）
//     · 🔴 而 ② 的 `need_press_o` **只高 1 拍 = 20 ns**（⭐ `S_PROMPT` 只待一拍）
//     ⇒ 🔴 **20 ns 的脉冲落在 20 µs 的发送窗口里 ⇒ 必然被丢，⛔ 永不重发**
//     ⇒ ⭐ 现象：⭐ **只收到 `s`，⭐ 之后没有任何轴号** ⇒ ⚠️ 操作者不知道该按哪一轴
//
//  ⭐⭐ **本模块的职责**：⭐ **把"忙就丢"改成"排队"**
//     ⇒ ⭐ 上游随时可推字节，⭐ 本模块负责**逐个**喂给 `uart_tx`
//
//  ═══════════════════════════════════════════════════════════════════════════
//  ⭐ 设计要点
//  ═══════════════════════════════════════════════════════════════════════════
//
//  ① ⭐ **深度 8**（⭐ 2 的幂 ⇒ 位与代替取模）
//     ⭐ 最坏情况是"一次 `'S'` 变 3 个回包"（`'s'` + 轴号 + …）⇒ ⭐ 8 足够
//
//  ② 🔴 **溢出【必须可观测】**（⭐ `K-106`：能失败的路径必须留下痕迹）
//     · ⭐ `ovf_o`：⭐ **sticky** —— 一旦丢过就置位，⭐ 读到才清
//     · ⭐ `drop_cnt_o`：⭐ **饱和计数** —— ⛔ 不回绕（⭐ 不会"丢 256 个显示 0"）
//     · 📌 **理由**：⭐ 如果只是"悄悄丢"，⭐ 那和改之前【没区别】
//
//  ③ ⭐ **Verilog-2001**（⭐ `K-91`）—— ⛔ 不用 SV 构造
//  ④ ⭐ **声明先于使用**（⭐ `L66`）—— ⚠️ 本项目踩过两次
//  ⑤ ⭐ **单时钟域**（⭐ 冻结表约定 1）· ⭐ **同步复位低有效**（⭐ 约定 2）
//
//  ═══════════════════════════════════════════════════════════════════════════
//  ⭐ 时序要点（⭐ 为什么它能接住那 1 拍脉冲）
//  ═══════════════════════════════════════════════════════════════════════════
//
//  ⭐ 上游 `push_i` **只要求"当拍有效"** ⇒ ⭐ 本模块**当拍就存进队列**
//     ⇒ ⚠️ 不再依赖"下游此刻空闲" ⇒ ✅ 那 1 拍（20 ns）**也能被接住**
//
//  🔴 **`sending` 的清零必须等 `busy` 【拉高过再落下】**：
//     ⚠️ 因为 `uart_tx.busy_o` 是在 `tx_start` 之后【下一拍】才拉高的
//     ⇒ ⚠️ 若当拍就判"`busy==0` ⇒ 完成" ⇒ 🔴 **会把"刚启动"误判成"已完成"**
//        ⇒ ⭐ 后果：⭐ 下一字节会在上一字节还没发完时就启动 ⇒ 🔴 **字节被吞**
//     📌 所以用 `busy_seen` 记住"这次发送确实已经开始过"
//
// ============================================================================

// Frozen public-boundary reference: d4f4c66 (clear/drop bug already fixed).
module uart_tx_fifo_reference #(
    // ⭐ 队列深度（⭐ 必须是 2 的幂 —— 用位与代替取模）
    parameter integer DEPTH = 8
) (
    input  wire       clk_i,
    input  wire       rst_n_i,

    // ── ⭐ 上游：推一个字节 ────────────────────────────────────────────────
    input  wire       push_i,       // ⭐ 当拍有效即入队（⭐ 脉冲/电平皆可）
    input  wire [7:0] data_i,
    output wire       ready_o,      // ⭐ 队列未满（⭐ 上游可据此判断）
    output wire       idle_o,       // ⭐ **队列空且发送器停**（⭐ 2026-09-24 新增）
                                    //   ⚠️ 与 `ready_o` 语义【不同】：
                                    //      · `ready_o` = "还能再塞"（⭐ 队列没满）
                                    //      · `idle_o`  = "上一个包【真的发完了】"
                                    //   ⇒ ⭐ 要"一包一包发"的上游（⭐ 如 `pos_probe`）
                                    //      **必须看 `idle_o`**，⛔ 不能看 `ready_o`

    // ── ⭐ 下游：喂给 `uart_tx` ───────────────────────────────────────────
    output reg        tx_start_o,   // ⭐ 单拍脉冲
    output reg  [7:0] tx_data_o,
    input  wire       busy_i,       // ⭐ 来自 `uart_tx.busy_o`

    // ── 🔴 可观测性（⭐ `K-106`）──────────────────────────────────────────
    output wire       ovf_o,        // ⭐ sticky：曾溢出
    output wire [7:0] drop_cnt_o,   // ⭐ 饱和计数：累计丢弃字节数
    input  wire       ovf_clr_i     // ⭐ 读走后清零（⭐ 1 拍脉冲或电平皆可）
);

    // ── ⭐ 常量（⛔ 不对 integer 参数做位选 —— `K-91`）──────────────────────
    localparam integer  AW   = 3;                    // ⭐ DEPTH=8 ⇒ 3 位地址
    localparam [AW:0]   DEPTHV = DEPTH[AW:0];        // ⭐ 先算，再赋值给定宽
    localparam [AW-1:0] ONE  = {{(AW-1){1'b0}}, 1'b1};

    // ── ⭐ 声明（⭐ 全部先于使用 —— `L66`）────────────────────────────────
    reg [7:0]    mem [0:DEPTH-1];
    reg [AW-1:0] wr_ptr;
    reg [AW-1:0] rd_ptr;
    reg [AW:0]   cnt;               // ⭐ 多一位 ⇒ 能表示 0..DEPTH

    reg          sending;           // ⭐ 正在等 `busy` 落下
    reg          busy_seen;         // ⭐ 本次发送确实开始过
    reg          ovf_r;
    reg  [7:0]   drop_r;

    // ── ⭐ 组合：满 / 空 / 可否启动 ───────────────────────────────────────
    wire full        = (cnt == DEPTHV);
    wire empty       = (cnt == {(AW+1){1'b0}});

    // 🔴🔴 **`can_launch` 必须【同时】看 `busy_i`**（⭐ 2026-09-24 踩坑修正）
    //   ⚠️ **原来只写 `(~empty) & (~sending)`** —— 🔴 **那是错的**：
    //      ⭐ 若 `sending=0` 但 `busy_i=1`（⭐ 下游还在发上一个字节，⭐ 例如上电时
    //         或 `uart_tx` 刚被别的路径启动）⇒ ⚠️ **FSM 照样"取出 + 拉 `tx_start`"**
    //      ⇒ 🔴 **那个字节被 `uart_tx` 忽略（它忙时不理新请求）**
    //      ⇒ 🔴 **本模块自己又引入了一条"静默丢字节"的路径** —— ⭐ 正是要修的东西！
    //   ✅ 修法：⭐ `~busy_i` 也进条件 ⇒ ⭐ **只在【下游真的空闲】时才取**
    //   📌 判据：⭐ `tb_uart_tx_fifo` 判据④（溢出时 `ovf` 置位）守的就是它
    wire can_launch  = (~empty) & (~sending) & (~busy_i);
    // ⭐⭐ 2026-09-24：⭐ cnt 的唯一两个增量（⭐ 见 always 里那句 case）
    wire take_now    = can_launch;              // ⭐ 本拍真的取走一个
    wire push_ok     = push_i & (~full);        // ⭐ 本拍真的推入一个

    // ⭐⭐ **`idle_o`：队列空【且】发送器完全停**（⭐ 2026-09-24 新增）
    //
    //   🔴 **为什么需要它**（⭐ 上板实测的真 bug）：
    //      ⭐ 发 `'P'` 诊断命令时，⭐ 回包**偶尔被切断**：
    //         · 有时先冒出一个【孤立数字】（⭐ 上一个包的尾巴）
    //         · 然后才跟下一个包
    //         eg. `0\n\nP217`
    //      🔴 根因：⭐ `pos_probe` 只看 `ready_i`（= **队列未满**）⇒
    //         ⚠️ 队列【还没排空】时它就开始推下一包的 7 个字节
    //         ⇒ ⭐ 两个包在 FIFO 里【首尾相接】，⭐ 而 PC 侧按行读 ⇒ 🔴 错位
    //      ⭐ `ready_i` 的语义是"**还能不能再塞**"，⛔ **不是"上一个包发完了没"**。
    //   ✅ 修法：⭐ 把"**真的空了**"也暴露出来 ⇒ ⭐ 上游据此判"能不能开新包"。
    //   📌 判据：⭐ `idle_o = 队列空 且 没有在等 busy 落下 且 下游不忙`
    assign idle_o    = empty & (~sending) & (~busy_i);

    assign ready_o    = ~full;
    assign ovf_o      = ovf_r;
    assign drop_cnt_o = drop_r;

    // ── ⭐ 时序 ───────────────────────────────────────────────────────────
    always @(posedge clk_i) begin
        if (!rst_n_i) begin
            wr_ptr     <= {AW{1'b0}};
            rd_ptr     <= {AW{1'b0}};
            cnt        <= {(AW+1){1'b0}};
            sending    <= 1'b0;
            busy_seen  <= 1'b0;
            tx_start_o <= 1'b0;
            tx_data_o  <= 8'd0;
            ovf_r      <= 1'b0;
            drop_r     <= 8'd0;
        end else begin
            // ⭐ 默认：`tx_start_o` 是单拍脉冲 ⇒ ⭐ 每拍先拉低
            tx_start_o <= 1'b0;

            // ═══════════════════════════════════════════════════════════════
            //  ⭐⭐ 2026-09-24 上板修：`cnt` 改成【单一组合表达式】
            //
            //  🔴 **原来的 bug**（⭐ 上板实测 + 仿真复现）：
            //     ⚠️ ①（取走）写 `cnt <= cnt - 1`、③（推入）写 `cnt <= cnt + 1`
            //     🔴 **同一拍两条非阻塞赋值 ⇒ 只有【后面那条】生效**
            //     ⇒ ⭐ `cnt` 计数【虚高/虚低】⇒ ⚠️ `empty` 判错
            //     ⇒ 🔴 **每个回包多 1 个字节、⭐ 且逐次累积**
            //        （⭐ 实测：发 3 次 'P' ⇒ 9 / 10 / 11 字节，
            //         那个尾巴会黏在下一次回包前面）
            //
            //  ✅ **修法**：⭐ 先把"这一拍 `cnt` 该怎么变"算成一个组合值
            //     `cnt_next`，⭐ 然后在 always 里**只写一次** `cnt <= cnt_next`。
            //     📌 这样"取 + 推同拍"就是**净 0**，⛔ 不会互相覆盖。
            // ═══════════════════════════════════════════════════════════════
            // ── ⭐ ① 启动发送（⭐ 有数据 且 没有在等）───────────────────────
            if (take_now) begin
                tx_data_o  <= mem[rd_ptr];
                tx_start_o <= 1'b1;                 // ⭐ 单拍
                rd_ptr     <= rd_ptr + ONE;
                sending    <= 1'b1;                 // ⚠️ 等 `busy` 落下再继续
            end

            // ── ⭐ ② `sending` 生命周期（⭐ 见文件头"时序要点"）─────────────
            if (sending) begin
                if (busy_i) begin
                    busy_seen <= 1'b1;              // ⭐ 发送确实开始了
                end else if (busy_seen) begin
                    sending   <= 1'b0;              // ⭐ 拉高过又落 ⇒ 真完成
                    busy_seen <= 1'b0;
                end
            end

            // ── ⭐ ③ 上游推入 ─────────────────────────────────────────────
            if (push_i) begin
                if (push_ok) begin
                    mem[wr_ptr] <= data_i;
                    wr_ptr      <= wr_ptr + ONE;
                end else begin
                    // 🔴 满 ⇒ 丢弃，⭐ 但**必须留痕**（`K-106`）
                    ovf_r <= 1'b1;
                    if (drop_r != 8'hFF) drop_r <= drop_r + 8'd1;
                end
            end

            // ── ⭐ ③b `cnt` 的【唯一】赋值（⭐ 见上面方框）─────────────────
            case ({take_now, push_ok})
                2'b10:   cnt <= cnt - {{AW{1'b0}}, 1'b1};      // ⭐ 只取
                2'b01:   cnt <= cnt + {{AW{1'b0}}, 1'b1};      // ⭐ 只推
                default: cnt <= cnt;                          // ⭐ 同拍 / 都不动 ⇒ 净 0
            endcase
            // ── ⭐ ④ 读走清零（⭐ 优先级最高 ⇒ ⚠️ 同拍"清 + 又丢"时【以丢为准】）
            //   📌 语义：⭐ 清掉的只是"已读走的那个标记"，
            //      ⭐ 同拍新丢的会【重新置位】⇒ ⚠️ 不丢信息
            if (ovf_clr_i) begin
                // Clear only historical losses; a new rejected push survives.
                ovf_r  <= push_i & ~push_ok;
                drop_r <= (push_i & ~push_ok) ? 8'd1 : 8'd0;
            end
        end
    end

endmodule
