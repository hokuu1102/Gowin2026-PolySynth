`timescale 1ns/1ps
// Fixture is generated by importing the real operator tool helpers.
module tb_board_acceptance_qh;
  reg clk=0;always #10 clk=~clk;
  reg rst_n=0,done=0;
  reg [7:0] data=0;
  reg [7:0] fixture[0:59];
  wire bpm_req,trans_req;
  wire [7:0] bpm_value,trans_value;
  wire [15:0] unknown,commands;
  integer bpms=0,transposes=0,i;
  reg [7:0] expected_bpm[0:2];
  reg [7:0] expected_trans[0:2];
  calib_cmd #(.BAUD(500000)) dut(.clk_i(clk),.rst_n_i(rst_n),.rx_done_i(done),.rx_data_i(data),
    .bpm_set_req_o(bpm_req),.bpm_val_o(bpm_value),
    .trans_abs_req_o(trans_req),.trans_abs_val_o(trans_value),
    .unknown_cnt_o(unknown),.cmd_cnt_o(commands));
  always @(negedge clk)if(rst_n)begin
    if(bpm_req)begin
      if(bpms>=3)$fatal(1,"extra BPM pulse");
      if(bpm_value!==expected_bpm[bpms])$fatal(1,"BPM[%0d] expected=%0d actual=%0d",bpms,expected_bpm[bpms],bpm_value);
      bpms=bpms+1;
    end
    if(trans_req)begin
      if(transposes>=3)$fatal(1,"extra transpose pulse");
      if(trans_value!==expected_trans[transposes])$fatal(1,"transpose[%0d] expected=%0d actual=%0d",transposes,expected_trans[transposes],trans_value);
      transposes=transposes+1;
    end
  end
  initial begin
    expected_bpm[0]=40;expected_bpm[1]=120;expected_bpm[2]=240;
    expected_trans[0]=0;expected_trans[1]=12;expected_trans[2]=24;
    $readmemh("tb/control/board_acceptance_qh.hex",fixture);
    repeat(3)@(negedge clk);rst_n=1;
    for(i=0;i<60;i=i+1)begin
      // 500 kbaud RX completion spacing: one byte every 1000 clocks.
      @(posedge clk);#1;data=fixture[i];done=1;
      @(posedge clk);#1;done=0;
      repeat(999)@(posedge clk);
    end
    repeat(4)@(negedge clk);
    if(bpms!=3||transposes!=3)$fatal(1,"missing Q/H consumption: BPM=%0d transpose=%0d",bpms,transposes);
    if(unknown!==0)$fatal(1,"helper frames generated unknown commands: %0d",unknown);
    $display("PASS: real board_acceptance Q/H bytes consumed by calib_cmd: BPM 40/120/240, transpose codes 0/12/24, exactly one pulse each");
    $finish;
  end
  initial begin #2000000;$fatal(1,"Q/H fixture deadline");end
endmodule
